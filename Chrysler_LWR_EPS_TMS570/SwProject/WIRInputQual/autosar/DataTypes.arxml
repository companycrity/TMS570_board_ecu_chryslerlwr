AUTOSAR XML (schema 314)
standard types defined: Boolean, SInt16, SInt32, SInt8, UInt16, UInt32, UInt8, Double, Float
package /DataType
  array type DT_SinTanLkpTbl_f32
    element DT_SinTanLkpTbl_f32: type=Float, max-number-of-elements=193
  4 x integer type:
    ManufModeType: compu {0=ProductionMode, 1=ManufacturingMode, 2=EngineeringMode}, lower-limit=0, upper-limit=2
    PinionCtrStateType: compu {0=HOLD, 1=POSANGVEL, 2=POSMTRTRQ, 3=NEGANGVEL, 4=NEGMTRTRQ, 5=MOVETO, 6=DONE, 7=TIMEOUT}, lower-limit=0, upper-limit=7
    SInt4: lower-limit=-8, upper-limit=7  # SInt4 represents integers with a minimum value of -8 and a maximum value of 7. The order-relation on SInt4 is: x < y if y - x is positive. SInt4 has a lexical representation consisting of an optional sign followed by a finite-length sequence of decimal digits (#x30-#x39). If the sign is omitted, "+" is assumed. For example: -1, 0, 2, +4.
    UInt4: lower-limit=0, upper-limit=15  # UInt4 represents integers with a minimum value of 0 and a maximum value of 15. The order-relation on UInt4 is: x < y if y - x is positive. UInt4 has a lexical representation consisting of a finite-length sequence of decimal digits (#x30-#x39). For example: 1, 0, 12, +10.
  record type DiagSettings_Str
    record element Threshold: type=UInt16
    record element PStep: type=UInt16
    record element NStep: type=UInt16
