/begin MEASUREMENT Ap_PAwTO.PAWhlPlsCntRRValid.Cnt_lgc "MICROSAR RTE" UBYTE RTE_CM_BOOLEAN 0 0 0 255 ECU_ADDRESS 0 SYMBOL_LINK "Rte_SrlComInput_PAWhlPlsCntRRValid_Cnt_lgc" 0 DISPLAY_IDENTIFIER Ap_PAwTO.ReceiverPorts.PAWhlPlsCntRRValid.Cnt_lgc /end MEASUREMENT
/begin MEASUREMENT Ap_PAwTO.PrkAssistActive.Cnt_lgc "MICROSAR RTE" UBYTE RTE_CM_BOOLEAN 0 0 0 255 ECU_ADDRESS 0 SYMBOL_LINK "Rte_Ap_PAwTO_PrkAssistActive_Cnt_lgc" 0 DISPLAY_IDENTIFIER Ap_PAwTO.SenderPorts.PrkAssistActive.Cnt_lgc /end MEASUREMENT
/begin MEASUREMENT Ap_PAwTO.PrkAssistState.Cnt_u08 "MICROSAR RTE" UBYTE NO_COMPU_METHOD 0 0 0 255 ECU_ADDRESS 0 SYMBOL_LINK "Rte_Ap_PAwTO_PrkAssistState_Cnt_u08" 0 DISPLAY_IDENTIFIER Ap_PAwTO.SenderPorts.PrkAssistState.Cnt_u08 /end MEASUREMENT
/begin MEASUREMENT Ap_PAwTO.PrkAssistSuspend.Cnt_lgc "MICROSAR RTE" UBYTE RTE_CM_BOOLEAN 0 0 0 255 ECU_ADDRESS 0 SYMBOL_LINK "Rte_Ap_PAwTO_PrkAssistSuspend_Cnt_lgc" 0 DISPLAY_IDENTIFIER Ap_PAwTO.SenderPorts.PrkAssistSuspend.Cnt_lgc /end MEASUREMENT
/begin MEASUREMENT Ap_PAwTO.PrkAsstFuncPresent.Cnt_lgc "MICROSAR RTE" UBYTE RTE_CM_BOOLEAN 0 0 0 255 ECU_ADDRESS 0 SYMBOL_LINK "Rte_SrlComInput_PrkAsstFuncPresent_Cnt_lgc" 0 DISPLAY_IDENTIFIER Ap_PAwTO.ReceiverPorts.PrkAsstFuncPresent.Cnt_lgc /end MEASUREMENT
/begin MEASUREMENT Ap_PAwTO.PrkAsstSlewComplete.Cnt_lgc "MICROSAR RTE" UBYTE RTE_CM_BOOLEAN 0 0 0 255 ECU_ADDRESS 0 SYMBOL_LINK "Rte_Ap_ArbLmt_PrkAsstSlewComplete_Cnt_lgc" 0 DISPLAY_IDENTIFIER Ap_PAwTO.ReceiverPorts.PrkAsstSlewComplete.Cnt_lgc /end MEASUREMENT
/begin MEASUREMENT Ap_PAwTO.SystemState.Mode "MICROSAR RTE" UBYTE RTE_CM_ENUM_StaMd_Mode 0 0 0 255 ECU_ADDRESS 0 SYMBOL_LINK "Rte_ModeMachine_StaMd_SystemState_Mode" 0 DISPLAY_IDENTIFIER Ap_PAwTO.ModeRequirePorts.SystemState.Mode /end MEASUREMENT
/begin MEASUREMENT Ap_PAwTO.TOEOLDisable.Cnt_lgc "MICROSAR RTE" UBYTE RTE_CM_BOOLEAN 0 0 0 255 ECU_ADDRESS 0 SYMBOL_LINK "Rte_CDDInterface_TOEOLDisable_Cnt_lgc" 0 DISPLAY_IDENTIFIER Ap_PAwTO.ReceiverPorts.TOEOLDisable.Cnt_lgc /end MEASUREMENT
/begin MEASUREMENT Ap_PAwTO.TrqOvReverseGearEngage.Cnt_lgc "MICROSAR RTE" UBYTE RTE_CM_BOOLEAN 0 0 0 255 ECU_ADDRESS 0 SYMBOL_LINK "Rte_SrlComInput_TrqOvReverseGearEngage_Cnt_lgc" 0 DISPLAY_IDENTIFIER Ap_PAwTO.ReceiverPorts.TrqOvReverseGearEngage.Cnt_lgc /end MEASUREMENT
/begin MEASUREMENT Ap_PAwTO.VehicleSpeed.Kph_f32 "MICROSAR RTE" FLOAT32_IEEE NO_COMPU_METHOD 0 0 1.175494351e-38 3.402823466e+38 ECU_ADDRESS 0 SYMBOL_LINK "Rte_Ap_SignlCondn_VehicleSpeed_Kph_f32" 0 DISPLAY_IDENTIFIER Ap_PAwTO.ReceiverPorts.VehicleSpeed.Kph_f32 /end MEASUREMENT
/begin MEASUREMENT Ap_PICurrCntrl.CorrMtrPosElec.Rev_f32 "MICROSAR RTE" FLOAT32_IEEE NO_COMPU_METHOD 0 0 1.175494351e-38 3.402823466e+38 ECU_ADDRESS 0 SYMBOL_LINK "Rte_CDDInterface_CorrMtrCurrPosition_Rev_f32" 0 DISPLAY_IDENTIFIER Ap_PICurrCntrl.ReceiverPorts.CorrMtrPosElec.Rev_f32 /end MEASUREMENT
/begin MEASUREMENT Ap_PICurrCntrl.DervLambdaAlphaDiag.Volt_f32 "This signal is intended to communicate any type voltage signal measured by the ecu.  This signal has a lower limit of 0 which reequires users of the signal to provide divide by 0 protection if it is used as a denominator in a calculation.  See Vecu port p" FLOAT32_IEEE NO_COMPU_METHOD 0 0 1.175494351e-38 3.402823466e+38 ECU_ADDRESS 0 SYMBOL_LINK "Rte_Ap_PICurrCntrl_DervLambdaAlphaDiag_Volt_f32" 0 DISPLAY_IDENTIFIER Ap_PICurrCntrl.SenderPorts.DervLambdaAlphaDiag.Volt_f32 /end MEASUREMENT
/begin MEASUREMENT Ap_PICurrCntrl.DervLambdaBetaDiag.Volt_f32 "This signal is intended to communicate any type voltage signal measured by the ecu.  This signal has a lower limit of 0 which reequires users of the signal to provide divide by 0 protection if it is used as a denominator in a calculation.  See Vecu port p" FLOAT32_IEEE NO_COMPU_METHOD 0 0 1.175494351e-38 3.402823466e+38 ECU_ADDRESS 0 SYMBOL_LINK "Rte_Ap_PICurrCntrl_DervLambdaBetaDiag_Volt_f32" 0 DISPLAY_IDENTIFIER Ap_PICurrCntrl.SenderPorts.DervLambdaBetaDiag.Volt_f32 /end MEASUREMENT
/begin MEASUREMENT Ap_PICurrCntrl.EstKe.VpRadpS_f32 "MICROSAR RTE" FLOAT32_IEEE NO_COMPU_METHOD 0 0 1.175494351e-38 3.402823466e+38 ECU_ADDRESS 0 SYMBOL_LINK "Rte_CurrParamComp_EstKe_VpRadpS_f32" 0 DISPLAY_IDENTIFIER Ap_PICurrCntrl.ReceiverPorts.EstKe.VpRadpS_f32 /end MEASUREMENT
/begin MEASUREMENT Ap_PICurrCntrl.EstR.Ohm_f32 "MICROSAR RTE" FLOAT32_IEEE NO_COMPU_METHOD 0 0 1.175494351e-38 3.402823466e+38 ECU_ADDRESS 0 SYMBOL_LINK "Rte_CurrParamComp_EstR_Ohm_f32" 0 DISPLAY_IDENTIFIER Ap_PICurrCntrl.ReceiverPorts.EstR.Ohm_f32 /end MEASUREMENT
/begin MEASUREMENT Ap_PICurrCntrl.MRFMtrVel.MtrRadpS_f32 "MICROSAR RTE" FLOAT32_IEEE NO_COMPU_METHOD 0 0 1.175494351e-38 3.402823466e+38 ECU_ADDRESS 0 SYMBOL_LINK "Rte_MtrVel_MRFMotorVel_MtrRadpS_f32" 0 DISPLAY_IDENTIFIER Ap_PICurrCntrl.ReceiverPorts.MRFMtrVel.MtrRadpS_f32 /end MEASUREMENT
/begin MEASUREMENT Ap_PICurrCntrl.MtrCurrDaxRef.Amp_f32 "MICROSAR RTE" FLOAT32_IEEE NO_COMPU_METHOD 0 0 1.175494351e-38 3.402823466e+38 ECU_ADDRESS 0 SYMBOL_LINK "Rte_CurrCmd_MtrCurrDaxRef_Amp_f32" 0 DISPLAY_IDENTIFIER Ap_PICurrCntrl.ReceiverPorts.MtrCurrDaxRef.Amp_f32 /end MEASUREMENT
/begin MEASUREMENT Ap_PICurrCntrl.SystemState.Mode "MICROSAR RTE" UBYTE RTE_CM_ENUM_StaMd_Mode 0 0 0 255 ECU_ADDRESS 0 SYMBOL_LINK "Rte_ModeMachine_StaMd_SystemState_Mode" 0 DISPLAY_IDENTIFIER Ap_PICurrCntrl.ModeRequirePorts.SystemState.Mode /end MEASUREMENT
/begin MEASUREMENT Ap_PwrLmtFuncCr.CntDisMtrTrqCmdMRF.MtrNm_f32 "MICROSAR RTE" FLOAT32_IEEE NO_COMPU_METHOD 0 0 1.175494351e-38 3.402823466e+38 ECU_ADDRESS 0 SYMBOL_LINK "Rte_CtrldDisShtdn_CntDisMtrTrqCmdMRF_MtrNm_f32" 0 DISPLAY_IDENTIFIER Ap_PwrLmtFuncCr.ReceiverPorts.CntDisMtrTrqCmdMRF.MtrNm_f32 /end MEASUREMENT
/begin MEASUREMENT Ap_PwrLmtFuncCr.EstKe.VpRadpS_f32 "MICROSAR RTE" FLOAT32_IEEE NO_COMPU_METHOD 0 0 1.175494351e-38 3.402823466e+38 ECU_ADDRESS 0 SYMBOL_LINK "Rte_CurrParamComp_EstKe_VpRadpS_f32" 0 DISPLAY_IDENTIFIER Ap_PwrLmtFuncCr.ReceiverPorts.EstKe.VpRadpS_f32 /end MEASUREMENT
/begin MEASUREMENT Ap_PwrLmtFuncCr.FltTrqLmt.Uls_f32 "MICROSAR RTE" FLOAT32_IEEE NO_COMPU_METHOD 0 0 1.175494351e-38 3.402823466e+38 ECU_ADDRESS 0 SYMBOL_LINK "Rte_Ap_PwrLmtFuncCr_FltTrqLmt_Uls_f32" 0 DISPLAY_IDENTIFIER Ap_PwrLmtFuncCr.SenderPorts.FltTrqLmt.Uls_f32 /end MEASUREMENT
/begin MEASUREMENT Ap_PwrLmtFuncCr.MRFMtrTrqCmd.MtrNm_f32 "MICROSAR RTE" FLOAT32_IEEE NO_COMPU_METHOD 0 0 1.175494351e-38 3.402823466e+38 ECU_ADDRESS 0 SYMBOL_LINK "Rte_Ap_PwrLmtFuncCr_MRFMtrTrqCmd_MtrNm_f32" 0 DISPLAY_IDENTIFIER Ap_PwrLmtFuncCr.SenderPorts.MRFMtrTrqCmd.MtrNm_f32 /end MEASUREMENT
/begin MEASUREMENT Ap_PwrLmtFuncCr.MotorVelMRF.MtrRadpS_f32 "MICROSAR RTE" FLOAT32_IEEE NO_COMPU_METHOD 0 0 1.175494351e-38 3.402823466e+38 ECU_ADDRESS 0 SYMBOL_LINK "Rte_MtrVel_MRFMotorVel_MtrRadpS_f32" 0 DISPLAY_IDENTIFIER Ap_PwrLmtFuncCr.ReceiverPorts.MotorVelMRF.MtrRadpS_f32 /end MEASUREMENT
/begin MEASUREMENT Ap_PwrLmtFuncCr.PosServEnable.Cnt_lgc "MICROSAR RTE" UBYTE RTE_CM_BOOLEAN 0 0 0 255 ECU_ADDRESS 0 SYMBOL_LINK "Rte_Ap_PwrLmtFuncCr_PosServEnable_Cnt_lgc" 0 DISPLAY_IDENTIFIER Ap_PwrLmtFuncCr.ReceiverPorts.PosServEnable.Cnt_lgc /end MEASUREMENT
/begin MEASUREMENT Ap_PwrLmtFuncCr.SystemState.Mode "MICROSAR RTE" UBYTE RTE_CM_ENUM_StaMd_Mode 0 0 0 255 ECU_ADDRESS 0 SYMBOL_LINK "Rte_ModeMachine_StaMd_SystemState_Mode" 0 DISPLAY_IDENTIFIER Ap_PwrLmtFuncCr.ModeRequirePorts.SystemState.Mode /end MEASUREMENT
/begin MEASUREMENT Ap_PwrLmtFuncCr.ThresholdExceeded.Cnt_lgc "MICROSAR RTE" UBYTE RTE_CM_BOOLEAN 0 0 0 255 ECU_ADDRESS 0 SYMBOL_LINK "Rte_Ap_PwrLmtFuncCr_ThresholdExceeded_Cnt_lgc" 0 DISPLAY_IDENTIFIER Ap_PwrLmtFuncCr.SenderPorts.ThresholdExceeded.Cnt_lgc /end MEASUREMENT
/begin MEASUREMENT Ap_PwrLmtFuncCr.Vecu.Volt_f32 "This port prototype is inteded to communicate voltage signals that represent the ecu supplied voltage.  This signal has a lower limit, which is non-zero, to allow users of the signal to use it as a denominator in an expression without requiring a divide b" FLOAT32_IEEE NO_COMPU_METHOD 0 0 1.175494351e-38 3.402823466e+38 ECU_ADDRESS 0 SYMBOL_LINK "Rte_BatteryVoltage_Vecu_Volt_f32" 0 DISPLAY_IDENTIFIER Ap_PwrLmtFuncCr.ReceiverPorts.Vecu.Volt_f32 /end MEASUREMENT
/begin MEASUREMENT Ap_ReturnFirewall.Defeat_Return_Svc.Cnt_lgc "MICROSAR RTE" UBYTE RTE_CM_BOOLEAN 0 0 0 255 ECU_ADDRESS 0 SYMBOL_LINK "Rte_CDDInterface_ReturnSrlComSvcDft_Cnt_lgc" 0 DISPLAY_IDENTIFIER Ap_ReturnFirewall.ReceiverPorts.Defeat_Return_Svc.Cnt_lgc /end MEASUREMENT
/begin MEASUREMENT Ap_ReturnFirewall.HandwheelPosition.HwDeg_f32 "MICROSAR RTE" FLOAT32_IEEE NO_COMPU_METHOD 0 0 1.175494351e-38 3.402823466e+38 ECU_ADDRESS 0 SYMBOL_LINK "Rte_Ap_AbsHwPosScom_HwPos_HwDeg_f32" 0 DISPLAY_IDENTIFIER Ap_ReturnFirewall.ReceiverPorts.HandwheelPosition.HwDeg_f32 /end MEASUREMENT
/begin MEASUREMENT Ap_ReturnFirewall.LimitedReturn.MtrNm_f32 "MICROSAR RTE" FLOAT32_IEEE NO_COMPU_METHOD 0 0 1.175494351e-38 3.402823466e+38 ECU_ADDRESS 0 SYMBOL_LINK "Rte_Ap_ReturnFirewall_LimitedReturn_MtrNm_f32" 0 DISPLAY_IDENTIFIER Ap_ReturnFirewall.SenderPorts.LimitedReturn.MtrNm_f32 /end MEASUREMENT
/begin MEASUREMENT Ap_ReturnFirewall.MEC_Counter.Cnt_enum "MICROSAR RTE" UBYTE RTE_CM_ENUM_ManufModeType 0 0 0 2 ECU_ADDRESS 0 SYMBOL_LINK "Rte_CDDInterface_MEC_Cnt_enum" 0 DISPLAY_IDENTIFIER Ap_ReturnFirewall.ReceiverPorts.MEC_Counter.Cnt_enum /end MEASUREMENT
/begin MEASUREMENT Ap_ReturnFirewall.ReturnCmd.MtrNm_f32 "MICROSAR RTE" FLOAT32_IEEE NO_COMPU_METHOD 0 0 1.175494351e-38 3.402823466e+38 ECU_ADDRESS 0 SYMBOL_LINK "Rte_Return_ReturnCmd_MtrNm_f32" 0 DISPLAY_IDENTIFIER Ap_ReturnFirewall.ReceiverPorts.ReturnCmd.MtrNm_f32 /end MEASUREMENT
/begin MEASUREMENT Ap_ReturnFirewall.VehicleSpeed.Kph_f32 "MICROSAR RTE" FLOAT32_IEEE NO_COMPU_METHOD 0 0 1.175494351e-38 3.402823466e+38 ECU_ADDRESS 0 SYMBOL_LINK "Rte_Ap_SignlCondn_VehicleSpeed_Kph_f32" 0 DISPLAY_IDENTIFIER Ap_ReturnFirewall.ReceiverPorts.VehicleSpeed.Kph_f32 /end MEASUREMENT
/begin MEASUREMENT Ap_SignlCondn.SrlComVehSpeed.Kph_f32 "MICROSAR RTE" FLOAT32_IEEE NO_COMPU_METHOD 0 0 1.175494351e-38 3.402823466e+38 ECU_ADDRESS 0 SYMBOL_LINK "Rte_SrlComInput_SrlComVehSpd_Kph_f32" 0 DISPLAY_IDENTIFIER Ap_SignlCondn.ReceiverPorts.SrlComVehSpeed.Kph_f32 /end MEASUREMENT
/begin MEASUREMENT Ap_SignlCondn.SrlCom_VehicleLonAccel.KphpS_f32 "MICROSAR RTE" FLOAT32_IEEE NO_COMPU_METHOD 0 0 1.175494351e-38 3.402823466e+38 ECU_ADDRESS 0 SYMBOL_LINK "Rte_SrlComInput_VehAccelX_KphpS_f32" 0 DISPLAY_IDENTIFIER Ap_SignlCondn.ReceiverPorts.SrlCom_VehicleLonAccel.KphpS_f32 /end MEASUREMENT
/begin MEASUREMENT Ap_SignlCondn.VehicleSpeed.Kph_f32 "MICROSAR RTE" FLOAT32_IEEE NO_COMPU_METHOD 0 0 1.175494351e-38 3.402823466e+38 ECU_ADDRESS 0 SYMBOL_LINK "Rte_Ap_SignlCondn_VehicleSpeed_Kph_f32" 0 DISPLAY_IDENTIFIER Ap_SignlCondn.SenderPorts.VehicleSpeed.Kph_f32 /end MEASUREMENT
/begin MEASUREMENT Ap_SignlCondn.Vehicle_LonAccel.KphpS_f32 "MICROSAR RTE" FLOAT32_IEEE NO_COMPU_METHOD 0 0 1.175494351e-38 3.402823466e+38 ECU_ADDRESS 0 SYMBOL_LINK "Rte_Ap_SignlCondn_Vehicle_LonAccel_KphpS_f32" 0 DISPLAY_IDENTIFIER Ap_SignlCondn.SenderPorts.Vehicle_LonAccel.KphpS_f32 /end MEASUREMENT
/begin MEASUREMENT Ap_StaMd8.SystemState8.Mode "MICROSAR RTE" UBYTE RTE_CM_ENUM_StaMd_Mode 0 0 0 255 ECU_ADDRESS 0 SYMBOL_LINK "Rte_ModeMachine_Ap_StaMd8_SystemState8_Mode" 0 DISPLAY_IDENTIFIER Ap_StaMd8.ModeProvidePorts.SystemState8.Mode /end MEASUREMENT
/begin MEASUREMENT Ap_StaMd9.SystemState9.Mode "MICROSAR RTE" UBYTE RTE_CM_ENUM_StaMd_Mode 0 0 0 255 ECU_ADDRESS 0 SYMBOL_LINK "Rte_ModeMachine_Ap_StaMd9_SystemState9_Mode" 0 DISPLAY_IDENTIFIER Ap_StaMd9.ModeProvidePorts.SystemState9.Mode /end MEASUREMENT
/begin MEASUREMENT Ap_StabilityComp2.AssistDDFactor.Uls_f32 "MICROSAR RTE" FLOAT32_IEEE NO_COMPU_METHOD 0 0 1.175494351e-38 3.402823466e+38 ECU_ADDRESS 0 SYMBOL_LINK "Rte_Ap_StabilityComp2_AssistDDFactor_Uls_f32" 0 DISPLAY_IDENTIFIER Ap_StabilityComp2.ReceiverPorts.AssistDDFactor.Uls_f32 /end MEASUREMENT
/begin MEASUREMENT Ap_StabilityComp2.AsstFWActive.Uls_f32 "MICROSAR RTE" FLOAT32_IEEE NO_COMPU_METHOD 0 0 1.175494351e-38 3.402823466e+38 ECU_ADDRESS 0 SYMBOL_LINK "Rte_Ap_AssistFirewall_AsstFirewallActive_Uls_f32" 0 DISPLAY_IDENTIFIER Ap_StabilityComp2.ReceiverPorts.AsstFWActive.Uls_f32 /end MEASUREMENT
/begin MEASUREMENT Ap_StabilityComp2.CombinedAssist.MtrNm_f32 "MICROSAR RTE" FLOAT32_IEEE NO_COMPU_METHOD 0 0 1.175494351e-38 3.402823466e+38 ECU_ADDRESS 0 SYMBOL_LINK "Rte_Ap_AssistFirewall_CombinedAssist_MtrNm_f32" 0 DISPLAY_IDENTIFIER Ap_StabilityComp2.ReceiverPorts.CombinedAssist.MtrNm_f32 /end MEASUREMENT
/begin MEASUREMENT Ap_StabilityComp2.HwTorque.HwNm_f32 "MICROSAR RTE" FLOAT32_IEEE NO_COMPU_METHOD 0 0 1.175494351e-38 3.402823466e+38 ECU_ADDRESS 0 SYMBOL_LINK "Rte_HwTrq_AnaHwTorque_HwNm_f32" 0 DISPLAY_IDENTIFIER Ap_StabilityComp2.ReceiverPorts.HwTorque.HwNm_f32 /end MEASUREMENT
/begin MEASUREMENT Ap_StabilityComp2.SysAssistCmd.MtrNm_f32 "MICROSAR RTE" FLOAT32_IEEE NO_COMPU_METHOD 0 0 1.175494351e-38 3.402823466e+38 ECU_ADDRESS 0 SYMBOL_LINK "Rte_Ap_StabilityComp2_SysAssistCmd_MtrNm_f32" 0 DISPLAY_IDENTIFIER Ap_StabilityComp2.SenderPorts.SysAssistCmd.MtrNm_f32 /end MEASUREMENT
/begin MEASUREMENT Ap_StabilityComp2.VehicleSpeed.Kph_f32 "MICROSAR RTE" FLOAT32_IEEE NO_COMPU_METHOD 0 0 1.175494351e-38 3.402823466e+38 ECU_ADDRESS 0 SYMBOL_LINK "Rte_Ap_SignlCondn_VehicleSpeed_Kph_f32" 0 DISPLAY_IDENTIFIER Ap_StabilityComp2.ReceiverPorts.VehicleSpeed.Kph_f32 /end MEASUREMENT
/begin MEASUREMENT Ap_StbCTO.DSTActive.Cnt_lgc "MICROSAR RTE" UBYTE RTE_CM_BOOLEAN 0 0 0 255 ECU_ADDRESS 0 SYMBOL_LINK "Rte_Ap_StbCTO_DSTActive_Cnt_lgc" 0 DISPLAY_IDENTIFIER Ap_StbCTO.SenderPorts.DSTActive.Cnt_lgc /end MEASUREMENT
/begin MEASUREMENT Ap_StbCTO.DSTEnableRqst.Cnt_lgc "MICROSAR RTE" UBYTE RTE_CM_BOOLEAN 0 0 0 255 ECU_ADDRESS 0 SYMBOL_LINK "Rte_SrlComInput_DSTEnableRqst_Cnt_lgc" 0 DISPLAY_IDENTIFIER Ap_StbCTO.ReceiverPorts.DSTEnableRqst.Cnt_lgc /end MEASUREMENT
/begin MEASUREMENT Ap_StbCTO.DSTErrCntrRecvLevel.Cnt_u08 "MICROSAR RTE" UBYTE NO_COMPU_METHOD 0 0 0 255 ECU_ADDRESS 0 SYMBOL_LINK "Rte_SrlComInput_DSTErrCntrRecvLevel_Cnt_u08" 0 DISPLAY_IDENTIFIER Ap_StbCTO.ReceiverPorts.DSTErrCntrRecvLevel.Cnt_u08 /end MEASUREMENT
/begin MEASUREMENT Ap_StbCTO.DSTExtSystemFltActive.Cnt_lgc "MICROSAR RTE" UBYTE RTE_CM_BOOLEAN 0 0 0 255 ECU_ADDRESS 0 SYMBOL_LINK "Rte_SrlComInput_DSTExtSystemFltActive_Cnt_lgc" 0 DISPLAY_IDENTIFIER Ap_StbCTO.ReceiverPorts.DSTExtSystemFltActive.Cnt_lgc /end MEASUREMENT
/begin MEASUREMENT Ap_StbCTO.DSTFuncPresent.Cnt_lgc "MICROSAR RTE" UBYTE RTE_CM_BOOLEAN 0 0 0 255 ECU_ADDRESS 0 SYMBOL_LINK "Rte_SrlComInput_DSTFuncPresent_Cnt_lgc" 0 DISPLAY_IDENTIFIER Ap_StbCTO.ReceiverPorts.DSTFuncPresent.Cnt_lgc /end MEASUREMENT
/begin MEASUREMENT Ap_StbCTO.DSTRevGearValid.Cnt_lgc "MICROSAR RTE" UBYTE RTE_CM_BOOLEAN 0 0 0 255 ECU_ADDRESS 0 SYMBOL_LINK "Rte_SrlComInput_DSTRevGearValid_Cnt_lgc" 0 DISPLAY_IDENTIFIER Ap_StbCTO.ReceiverPorts.DSTRevGearValid.Cnt_lgc /end MEASUREMENT
/begin MEASUREMENT Ap_StbCTO.DSTSlewComplete.Cnt_lgc "MICROSAR RTE" UBYTE RTE_CM_BOOLEAN 0 0 0 255 ECU_ADDRESS 0 SYMBOL_LINK "Rte_Ap_ArbLmt_DSTSlewComplete_Cnt_lgc" 0 DISPLAY_IDENTIFIER Ap_StbCTO.ReceiverPorts.DSTSlewComplete.Cnt_lgc /end MEASUREMENT
/begin MEASUREMENT Ap_StbCTO.DSTSlewStart.Cnt_lgc "MICROSAR RTE" UBYTE RTE_CM_BOOLEAN 0 0 0 255 ECU_ADDRESS 0 SYMBOL_LINK "Rte_Ap_StbCTO_DSTSlewStart_Cnt_lgc" 0 DISPLAY_IDENTIFIER Ap_StbCTO.SenderPorts.DSTSlewStart.Cnt_lgc /end MEASUREMENT
/begin MEASUREMENT Ap_StbCTO.DSTState.Cnt_u08 "MICROSAR RTE" UBYTE NO_COMPU_METHOD 0 0 0 255 ECU_ADDRESS 0 SYMBOL_LINK "Rte_Ap_StbCTO_DSTState_Cnt_u08" 0 DISPLAY_IDENTIFIER Ap_StbCTO.SenderPorts.DSTState.Cnt_u08 /end MEASUREMENT
/begin MEASUREMENT Ap_StbCTO.DSTTOCState.Uls_enum "MICROSAR RTE" UBYTE RTE_CM_ENUM_TOC_STATE 0 0 0 255 ECU_ADDRESS 0 SYMBOL_LINK "Rte_SrlComInput_DSTTOCState_Uls_enum" 0 DISPLAY_IDENTIFIER Ap_StbCTO.ReceiverPorts.DSTTOCState.Uls_enum /end MEASUREMENT
/begin MEASUREMENT Ap_StbCTO.DSTTrqOvCmdRqst.HwNm_f32 "MICROSAR RTE" FLOAT32_IEEE NO_COMPU_METHOD 0 0 1.175494351e-38 3.402823466e+38 ECU_ADDRESS 0 SYMBOL_LINK "Rte_SrlComInput_DSTTrqOvCmdRqst_HwNm_f32" 0 DISPLAY_IDENTIFIER Ap_StbCTO.ReceiverPorts.DSTTrqOvCmdRqst.HwNm_f32 /end MEASUREMENT
/begin MEASUREMENT Ap_StbCTO.DSTTrqOvRqstValid.Cnt_lgc "MICROSAR RTE" UBYTE RTE_CM_BOOLEAN 0 0 0 255 ECU_ADDRESS 0 SYMBOL_LINK "Rte_SrlComInput_DSTTrqOvRqstValid_Cnt_lgc" 0 DISPLAY_IDENTIFIER Ap_StbCTO.ReceiverPorts.DSTTrqOvRqstValid.Cnt_lgc /end MEASUREMENT
/begin MEASUREMENT Ap_StbCTO.DiagRedAssistLowVoltageActive.Cnt_lgc "MICROSAR RTE" UBYTE RTE_CM_BOOLEAN 0 0 0 255 ECU_ADDRESS 0 SYMBOL_LINK "Rte_Ap_StbCTO_DiagRedAssistLowVoltageActive_Cnt_lgc" 0 DISPLAY_IDENTIFIER Ap_StbCTO.ReceiverPorts.DiagRedAssistLowVoltageActive.Cnt_lgc /end MEASUREMENT
/begin MEASUREMENT Ap_StbCTO.DiagStsNonRecRmpToZeroFltPres.Cnt_lgc "MICROSAR RTE" UBYTE RTE_CM_BOOLEAN 0 0 0 255 ECU_ADDRESS 0 SYMBOL_LINK "Rte_DiagMgr_DiagStsNonRecRmpToZeroFltPres_Cnt_lgc" 0 DISPLAY_IDENTIFIER Ap_StbCTO.ReceiverPorts.DiagStsNonRecRmpToZeroFltPres.Cnt_lgc /end MEASUREMENT
/begin MEASUREMENT Ap_StbCTO.DiagStsRecRmpToZeroFltPres.Cnt_lgc "MICROSAR RTE" UBYTE RTE_CM_BOOLEAN 0 0 0 255 ECU_ADDRESS 0 SYMBOL_LINK "Rte_DiagMgr_DiagStsRecRmpToZeroFltPres_Cnt_lgc" 0 DISPLAY_IDENTIFIER Ap_StbCTO.ReceiverPorts.DiagStsRecRmpToZeroFltPres.Cnt_lgc /end MEASUREMENT
/begin MEASUREMENT Ap_StbCTO.LimitPercentFiltered.Uls_f32 "MICROSAR RTE" FLOAT32_IEEE NO_COMPU_METHOD 0 0 1.175494351e-38 3.402823466e+38 ECU_ADDRESS 0 SYMBOL_LINK "Rte_Ap_AstLmt_LimitPercentFiltered_Uls_f32" 0 DISPLAY_IDENTIFIER Ap_StbCTO.ReceiverPorts.LimitPercentFiltered.Uls_f32 /end MEASUREMENT
/begin MEASUREMENT Ap_StbCTO.SystemState.Mode "MICROSAR RTE" UBYTE RTE_CM_ENUM_StaMd_Mode 0 0 0 255 ECU_ADDRESS 0 SYMBOL_LINK "Rte_ModeMachine_StaMd_SystemState_Mode" 0 DISPLAY_IDENTIFIER Ap_StbCTO.ModeRequirePorts.SystemState.Mode /end MEASUREMENT
/begin MEASUREMENT Ap_StbCTO.TOEOLDisable.Cnt_lgc "MICROSAR RTE" UBYTE RTE_CM_BOOLEAN 0 0 0 255 ECU_ADDRESS 0 SYMBOL_LINK "Rte_CDDInterface_TOEOLDisable_Cnt_lgc" 0 DISPLAY_IDENTIFIER Ap_StbCTO.ReceiverPorts.TOEOLDisable.Cnt_lgc /end MEASUREMENT
/begin MEASUREMENT Ap_StbCTO.TrqOvReverseGearEngage.Cnt_lgc "MICROSAR RTE" UBYTE RTE_CM_BOOLEAN 0 0 0 255 ECU_ADDRESS 0 SYMBOL_LINK "Rte_SrlComInput_TrqOvReverseGearEngage_Cnt_lgc" 0 DISPLAY_IDENTIFIER Ap_StbCTO.ReceiverPorts.TrqOvReverseGearEngage.Cnt_lgc /end MEASUREMENT
/begin MEASUREMENT Ap_StbCTO.VehicleSpeed.Kph_f32 "MICROSAR RTE" FLOAT32_IEEE NO_COMPU_METHOD 0 0 1.175494351e-38 3.402823466e+38 ECU_ADDRESS 0 SYMBOL_LINK "Rte_Ap_SignlCondn_VehicleSpeed_Kph_f32" 0 DISPLAY_IDENTIFIER Ap_StbCTO.ReceiverPorts.VehicleSpeed.Kph_f32 /end MEASUREMENT
/begin MEASUREMENT Ap_StbCTO.VehicleSpeedValid.Cnt_lgc "MICROSAR RTE" UBYTE RTE_CM_BOOLEAN 0 0 0 255 ECU_ADDRESS 0 SYMBOL_LINK "Rte_SrlComInput_SrlComVehSpdValid_Cnt_lgc" 0 DISPLAY_IDENTIFIER Ap_StbCTO.ReceiverPorts.VehicleSpeedValid.Cnt_lgc /end MEASUREMENT
/begin MEASUREMENT Ap_ThrmlDutyCycle.CuTempEst.DegC_f32 "MICROSAR RTE" FLOAT32_IEEE NO_COMPU_METHOD 0 0 1.175494351e-38 3.402823466e+38 ECU_ADDRESS 0 SYMBOL_LINK "Rte_Ap_MtrTempEst_CuTempEst_DegC_f32" 0 DISPLAY_IDENTIFIER Ap_ThrmlDutyCycle.ReceiverPorts.CuTempEst.DegC_f32 /end MEASUREMENT
/begin MEASUREMENT Ap_ThrmlDutyCycle.DefeatDutySvc.Cnt_lgc "MICROSAR RTE" UBYTE RTE_CM_BOOLEAN 0 0 0 255 ECU_ADDRESS 0 SYMBOL_LINK "Rte_CDDInterface_ThermalDCSrlComSvcDft_Cnt_lgc" 0 DISPLAY_IDENTIFIER Ap_ThrmlDutyCycle.ReceiverPorts.DefeatDutySvc.Cnt_lgc /end MEASUREMENT
/begin MEASUREMENT Ap_ThrmlDutyCycle.DutyCycleLevel.Uls_f32 "MICROSAR RTE" FLOAT32_IEEE NO_COMPU_METHOD 0 0 1.175494351e-38 3.402823466e+38 ECU_ADDRESS 0 SYMBOL_LINK "Rte_Ap_ThrmlDutyCycle_DutyCycleLevel_Uls_f32" 0 DISPLAY_IDENTIFIER Ap_ThrmlDutyCycle.SenderPorts.DutyCycleLevel.Uls_f32 /end MEASUREMENT
/begin MEASUREMENT Ap_ThrmlDutyCycle.FiltMeasTemp.DegC_f32 "MICROSAR RTE" FLOAT32_IEEE NO_COMPU_METHOD 0 0 1.175494351e-38 3.402823466e+38 ECU_ADDRESS 0 SYMBOL_LINK "Rte_CtrlTemp_FiltMeasTemp_DegC_f32" 0 DISPLAY_IDENTIFIER Ap_ThrmlDutyCycle.ReceiverPorts.FiltMeasTemp.DegC_f32 /end MEASUREMENT
/begin MEASUREMENT Ap_ThrmlDutyCycle.FilteredPkCurr.AmpSq_f32 "MICROSAR RTE" FLOAT32_IEEE NO_COMPU_METHOD 0 0 1.175494351e-38 3.402823466e+38 ECU_ADDRESS 0 SYMBOL_LINK "Rte_PeakCurrEst_FiltEstPkCurr_AmpSq_f32" 0 DISPLAY_IDENTIFIER Ap_ThrmlDutyCycle.ReceiverPorts.FilteredPkCurr.AmpSq_f32 /end MEASUREMENT
/begin MEASUREMENT Ap_ThrmlDutyCycle.IgnTimeOff.Cnt_u32 "MICROSAR RTE" ULONG NO_COMPU_METHOD 0 0 0 4294967295 ECU_ADDRESS 0 SYMBOL_LINK "Rte_Ap_ThrmlDutyCycle_IgnTimeOff_Cnt_u32" 0 DISPLAY_IDENTIFIER Ap_ThrmlDutyCycle.ReceiverPorts.IgnTimeOff.Cnt_u32 /end MEASUREMENT
/begin MEASUREMENT Ap_ThrmlDutyCycle.MagTempEst.DegC_f32 "MICROSAR RTE" FLOAT32_IEEE NO_COMPU_METHOD 0 0 1.175494351e-38 3.402823466e+38 ECU_ADDRESS 0 SYMBOL_LINK "Rte_Ap_MtrTempEst_MagTempEst_DegC_f32" 0 DISPLAY_IDENTIFIER Ap_ThrmlDutyCycle.ReceiverPorts.MagTempEst.DegC_f32 /end MEASUREMENT
/begin MEASUREMENT Ap_ThrmlDutyCycle.MotorVelCRF.MtrRadpS_f32 "MICROSAR RTE" FLOAT32_IEEE NO_COMPU_METHOD 0 0 1.175494351e-38 3.402823466e+38 ECU_ADDRESS 0 SYMBOL_LINK "Rte_MtrVel_CRFMotorVel_MtrRadpS_f32" 0 DISPLAY_IDENTIFIER Ap_ThrmlDutyCycle.ReceiverPorts.MotorVelCRF.MtrRadpS_f32 /end MEASUREMENT
/begin MEASUREMENT Ap_ThrmlDutyCycle.MtrPkCurr.AmpSq_f32 "MICROSAR RTE" FLOAT32_IEEE NO_COMPU_METHOD 0 0 1.175494351e-38 3.402823466e+38 ECU_ADDRESS 0 SYMBOL_LINK "Rte_PeakCurrEst_EstPkCurr_AmpSq_f32" 0 DISPLAY_IDENTIFIER Ap_ThrmlDutyCycle.ReceiverPorts.MtrPkCurr.AmpSq_f32 /end MEASUREMENT
/begin MEASUREMENT Ap_ThrmlDutyCycle.SiTempEst.DegC_f32 "MICROSAR RTE" FLOAT32_IEEE NO_COMPU_METHOD 0 0 1.175494351e-38 3.402823466e+38 ECU_ADDRESS 0 SYMBOL_LINK "Rte_Ap_MtrTempEst_SiTempEst_DegC_f32" 0 DISPLAY_IDENTIFIER Ap_ThrmlDutyCycle.ReceiverPorts.SiTempEst.DegC_f32 /end MEASUREMENT
/begin MEASUREMENT Ap_ThrmlDutyCycle.ThermLimitPerc.Uls_f32 "MICROSAR RTE" FLOAT32_IEEE NO_COMPU_METHOD 0 0 1.175494351e-38 3.402823466e+38 ECU_ADDRESS 0 SYMBOL_LINK "Rte_Ap_ThrmlDutyCycle_ThermLimitPerc_Uls_f32" 0 DISPLAY_IDENTIFIER Ap_ThrmlDutyCycle.SenderPorts.ThermLimitPerc.Uls_f32 /end MEASUREMENT
/begin MEASUREMENT Ap_ThrmlDutyCycle.ThermalLimit.MtrNm_f32 "MICROSAR RTE" FLOAT32_IEEE NO_COMPU_METHOD 0 0 1.175494351e-38 3.402823466e+38 ECU_ADDRESS 0 SYMBOL_LINK "Rte_Ap_ThrmlDutyCycle_ThermalLimit_MtrNm_f32" 0 DISPLAY_IDENTIFIER Ap_ThrmlDutyCycle.SenderPorts.ThermalLimit.MtrNm_f32 /end MEASUREMENT
/begin MEASUREMENT Ap_ThrmlDutyCycle.VehTimeValid.Cnt_lgc "MICROSAR RTE" UBYTE RTE_CM_BOOLEAN 0 0 0 255 ECU_ADDRESS 0 SYMBOL_LINK "Rte_Ap_ThrmlDutyCycle_VehTimeValid_Cnt_lgc" 0 DISPLAY_IDENTIFIER Ap_ThrmlDutyCycle.ReceiverPorts.VehTimeValid.Cnt_lgc /end MEASUREMENT
/begin MEASUREMENT Ap_TqRsDg.DervLambdaAlphaDiag.Volt_f32 "This signal is intended to communicate any type voltage signal measured by the ecu.  This signal has a lower limit of 0 which reequires users of the signal to provide divide by 0 protection if it is used as a denominator in a calculation.  See Vecu port p" FLOAT32_IEEE NO_COMPU_METHOD 0 0 1.175494351e-38 3.402823466e+38 ECU_ADDRESS 0 SYMBOL_LINK "Rte_Ap_PICurrCntrl_DervLambdaAlphaDiag_Volt_f32" 0 DISPLAY_IDENTIFIER Ap_TqRsDg.ReceiverPorts.DervLambdaAlphaDiag.Volt_f32 /end MEASUREMENT
/begin MEASUREMENT Ap_TqRsDg.DervLambdaBetaDiag.Volt_f32 "This signal is intended to communicate any type voltage signal measured by the ecu.  This signal has a lower limit of 0 which reequires users of the signal to provide divide by 0 protection if it is used as a denominator in a calculation.  See Vecu port p" FLOAT32_IEEE NO_COMPU_METHOD 0 0 1.175494351e-38 3.402823466e+38 ECU_ADDRESS 0 SYMBOL_LINK "Rte_Ap_PICurrCntrl_DervLambdaBetaDiag_Volt_f32" 0 DISPLAY_IDENTIFIER Ap_TqRsDg.ReceiverPorts.DervLambdaBetaDiag.Volt_f32 /end MEASUREMENT
/begin MEASUREMENT Ap_TqRsDg.OutputRampMult.Uls_f32 "MICROSAR RTE" FLOAT32_IEEE NO_COMPU_METHOD 0 0 1.175494351e-38 3.402823466e+38 ECU_ADDRESS 0 SYMBOL_LINK "Rte_StOpCtrl_OutputRampMult_Uls_f32" 0 DISPLAY_IDENTIFIER Ap_TqRsDg.ReceiverPorts.OutputRampMult.Uls_f32 /end MEASUREMENT
/begin MEASUREMENT Ap_TqRsDg.SystemState.Mode "MICROSAR RTE" UBYTE RTE_CM_ENUM_StaMd_Mode 0 0 0 255 ECU_ADDRESS 0 SYMBOL_LINK "Rte_ModeMachine_StaMd_SystemState_Mode" 0 DISPLAY_IDENTIFIER Ap_TqRsDg.ModeRequirePorts.SystemState.Mode /end MEASUREMENT
/begin MEASUREMENT Ap_TqRsDg.TrqLimitMin.MtrNm_f32 "MICROSAR RTE" FLOAT32_IEEE NO_COMPU_METHOD 0 0 1.175494351e-38 3.402823466e+38 ECU_ADDRESS 0 SYMBOL_LINK "Rte_Ap_AstLmt_TrqLimitMin_MtrNm_f32" 0 DISPLAY_IDENTIFIER Ap_TqRsDg.ReceiverPorts.TrqLimitMin.MtrNm_f32 /end MEASUREMENT
/begin MEASUREMENT Ap_TrqCanc.CogTrqCal "MICROSAR RTE" UWORD NO_COMPU_METHOD 0 0 0 65535 MATRIX_DIM 512 1 1 ECU_ADDRESS 0 SYMBOL_LINK "Rte_Ap_TrqCanc_CogTrqCal" 0 DISPLAY_IDENTIFIER Ap_TrqCanc.PerInstanceMemories.CogTrqCal READ_WRITE /end MEASUREMENT
/begin MEASUREMENT Ap_TrqCanc.CogTrqRplComp "MICROSAR RTE" UWORD NO_COMPU_METHOD 0 0 0 65535 MATRIX_DIM 9 1 1 ECU_ADDRESS 0 SYMBOL_LINK "Rte_Ap_TrqCanc_CogTrqRplComp" 0 DISPLAY_IDENTIFIER Ap_TrqCanc.PerInstanceMemories.CogTrqRplComp READ_WRITE /end MEASUREMENT
/begin MEASUREMENT Ap_TrqCanc.EstKe.VpRadpS_f32 "MICROSAR RTE" FLOAT32_IEEE NO_COMPU_METHOD 0 0 1.175494351e-38 3.402823466e+38 ECU_ADDRESS 0 SYMBOL_LINK "Rte_CurrParamComp_EstKe_VpRadpS_f32" 0 DISPLAY_IDENTIFIER Ap_TrqCanc.ReceiverPorts.EstKe.VpRadpS_f32 /end MEASUREMENT
/begin MEASUREMENT Ap_TrqCanc.MRFMtrVel.MtrRadpS_f32 "MICROSAR RTE" FLOAT32_IEEE NO_COMPU_METHOD 0 0 1.175494351e-38 3.402823466e+38 ECU_ADDRESS 0 SYMBOL_LINK "Rte_MtrVel_MRFMotorVel_MtrRadpS_f32" 0 DISPLAY_IDENTIFIER Ap_TrqCanc.ReceiverPorts.MRFMtrVel.MtrRadpS_f32 /end MEASUREMENT
/begin MEASUREMENT Ap_TrqCanc.MtrCurrDaxRef.Amp_f32 "MICROSAR RTE" FLOAT32_IEEE NO_COMPU_METHOD 0 0 1.175494351e-38 3.402823466e+38 ECU_ADDRESS 0 SYMBOL_LINK "Rte_CurrCmd_MtrCurrDaxRef_Amp_f32" 0 DISPLAY_IDENTIFIER Ap_TrqCanc.ReceiverPorts.MtrCurrDaxRef.Amp_f32 /end MEASUREMENT
/begin MEASUREMENT Ap_TrqCanc.MtrCurrQaxRef.Amp_f32 "MICROSAR RTE" FLOAT32_IEEE NO_COMPU_METHOD 0 0 1.175494351e-38 3.402823466e+38 ECU_ADDRESS 0 SYMBOL_LINK "Rte_CurrCmd_MtrCurrQaxRef_Amp_f32" 0 DISPLAY_IDENTIFIER Ap_TrqCanc.ReceiverPorts.MtrCurrQaxRef.Amp_f32 /end MEASUREMENT
/begin MEASUREMENT Ap_TuningSelAuth.ActiveTunPers.Cnt_u16 "MICROSAR RTE" UWORD NO_COMPU_METHOD 0 0 0 65535 ECU_ADDRESS 0 SYMBOL_LINK "Rte_Ap_TuningSelAuth_ActiveTunPers_Cnt_u16" 0 DISPLAY_IDENTIFIER Ap_TuningSelAuth.SenderPorts.ActiveTunPers.Cnt_u16 /end MEASUREMENT
/begin MEASUREMENT Ap_TuningSelAuth.ActiveTunSet.Cnt_u16 "MICROSAR RTE" UWORD NO_COMPU_METHOD 0 0 0 65535 ECU_ADDRESS 0 SYMBOL_LINK "Rte_Ap_TuningSelAuth_ActiveTunSet_Cnt_u16" 0 DISPLAY_IDENTIFIER Ap_TuningSelAuth.SenderPorts.ActiveTunSet.Cnt_u16 /end MEASUREMENT
/begin MEASUREMENT Ap_TuningSelAuth.DesiredTunPers.Cnt_u16 "MICROSAR RTE" UWORD NO_COMPU_METHOD 0 0 0 65535 ECU_ADDRESS 0 SYMBOL_LINK "Rte_SrlComInput_DesiredTunPers_Cnt_u16" 0 DISPLAY_IDENTIFIER Ap_TuningSelAuth.ReceiverPorts.DesiredTunPers.Cnt_u16 /end MEASUREMENT
/begin MEASUREMENT Ap_TuningSelAuth.DesiredTunSet.Cnt_u16 "MICROSAR RTE" UWORD NO_COMPU_METHOD 0 0 0 65535 ECU_ADDRESS 0 SYMBOL_LINK "Rte_SrlComInput_DesiredTunSet_Cnt_u16" 0 DISPLAY_IDENTIFIER Ap_TuningSelAuth.ReceiverPorts.DesiredTunSet.Cnt_u16 /end MEASUREMENT
/begin MEASUREMENT Ap_TuningSelAuth.HwTorque.HwNm_f32 "MICROSAR RTE" FLOAT32_IEEE NO_COMPU_METHOD 0 0 1.175494351e-38 3.402823466e+38 ECU_ADDRESS 0 SYMBOL_LINK "Rte_HwTrq_AnaHwTorque_HwNm_f32" 0 DISPLAY_IDENTIFIER Ap_TuningSelAuth.ReceiverPorts.HwTorque.HwNm_f32 /end MEASUREMENT
/begin MEASUREMENT Ap_TuningSelAuth.VehicleSpeed.Kph_f32 "MICROSAR RTE" FLOAT32_IEEE NO_COMPU_METHOD 0 0 1.175494351e-38 3.402823466e+38 ECU_ADDRESS 0 SYMBOL_LINK "Rte_Ap_SignlCondn_VehicleSpeed_Kph_f32" 0 DISPLAY_IDENTIFIER Ap_TuningSelAuth.ReceiverPorts.VehicleSpeed.Kph_f32 /end MEASUREMENT
/begin MEASUREMENT Ap_WIRInputQual.QualWhlFreqL.Hz_f32 "MICROSAR RTE" FLOAT32_IEEE NO_COMPU_METHOD 0 0 1.175494351e-38 3.402823466e+38 ECU_ADDRESS 0 SYMBOL_LINK "Rte_Ap_WIRInputQual_QualWhlFreqL_Hz_f32" 0 DISPLAY_IDENTIFIER Ap_WIRInputQual.SenderPorts.QualWhlFreqL.Hz_f32 /end MEASUREMENT
/begin MEASUREMENT Ap_WIRInputQual.QualWhlFreqR.Hz_f32 "MICROSAR RTE" FLOAT32_IEEE NO_COMPU_METHOD 0 0 1.175494351e-38 3.402823466e+38 ECU_ADDRESS 0 SYMBOL_LINK "Rte_Ap_WIRInputQual_QualWhlFreqR_Hz_f32" 0 DISPLAY_IDENTIFIER Ap_WIRInputQual.SenderPorts.QualWhlFreqR.Hz_f32 /end MEASUREMENT
/begin MEASUREMENT Ap_WIRInputQual.SrlComLWhlSpd.Hz_f32 "MICROSAR RTE" FLOAT32_IEEE NO_COMPU_METHOD 0 0 1.175494351e-38 3.402823466e+38 ECU_ADDRESS 0 SYMBOL_LINK "Rte_SrlComInput_SrlComLWhlSpd_Hz_f32" 0 DISPLAY_IDENTIFIER Ap_WIRInputQual.ReceiverPorts.SrlComLWhlSpd.Hz_f32 /end MEASUREMENT
/begin MEASUREMENT Ap_WIRInputQual.SrlComLWhlSpdVld.Cnt_lgc "MICROSAR RTE" UBYTE RTE_CM_BOOLEAN 0 0 0 255 ECU_ADDRESS 0 SYMBOL_LINK "Rte_SrlComInput_SrlComLWhlSpdVld_Cnt_lgc" 0 DISPLAY_IDENTIFIER Ap_WIRInputQual.ReceiverPorts.SrlComLWhlSpdVld.Cnt_lgc /end MEASUREMENT
/begin MEASUREMENT Ap_WIRInputQual.SrlComRWhlSpd.Hz_f32 "MICROSAR RTE" FLOAT32_IEEE NO_COMPU_METHOD 0 0 1.175494351e-38 3.402823466e+38 ECU_ADDRESS 0 SYMBOL_LINK "Rte_SrlComInput_SrlComRWhlSpd_Hz_f32" 0 DISPLAY_IDENTIFIER Ap_WIRInputQual.ReceiverPorts.SrlComRWhlSpd.Hz_f32 /end MEASUREMENT
/begin MEASUREMENT Ap_WIRInputQual.SrlComRWhlSpdVld.Cnt_lgc "MICROSAR RTE" UBYTE RTE_CM_BOOLEAN 0 0 0 255 ECU_ADDRESS 0 SYMBOL_LINK "Rte_SrlComInput_SrlComRWhlSpdVld_Cnt_lgc" 0 DISPLAY_IDENTIFIER Ap_WIRInputQual.ReceiverPorts.SrlComRWhlSpdVld.Cnt_lgc /end MEASUREMENT
/begin MEASUREMENT Ap_WIRInputQual.WhlFreqQualified.Cnt_lgc "MICROSAR RTE" UBYTE RTE_CM_BOOLEAN 0 0 0 255 ECU_ADDRESS 0 SYMBOL_LINK "Rte_Ap_WIRInputQual_WhlFreqQualified_Cnt_lgc" 0 DISPLAY_IDENTIFIER Ap_WIRInputQual.SenderPorts.WhlFreqQualified.Cnt_lgc /end MEASUREMENT
/begin MEASUREMENT Ap_WhlImbRej.DiagStsWIRDisable.Cnt_lgc "MICROSAR RTE" UBYTE RTE_CM_BOOLEAN 0 0 0 255 ECU_ADDRESS 0 SYMBOL_LINK "Rte_DiagMgr_DiagStsWIRDisable_Cnt_lgc" 0 DISPLAY_IDENTIFIER Ap_WhlImbRej.ReceiverPorts.DiagStsWIRDisable.Cnt_lgc /end MEASUREMENT
/begin MEASUREMENT Ap_WhlImbRej.HwTrq.HwNm_f32 "MICROSAR RTE" FLOAT32_IEEE NO_COMPU_METHOD 0 0 1.175494351e-38 3.402823466e+38 ECU_ADDRESS 0 SYMBOL_LINK "Rte_HwTrq_AnaHwTorque_HwNm_f32" 0 DISPLAY_IDENTIFIER Ap_WhlImbRej.ReceiverPorts.HwTrq.HwNm_f32 /end MEASUREMENT
/begin MEASUREMENT Ap_WhlImbRej.QualWhlFreqL.Hz_f32 "MICROSAR RTE" FLOAT32_IEEE NO_COMPU_METHOD 0 0 1.175494351e-38 3.402823466e+38 ECU_ADDRESS 0 SYMBOL_LINK "Rte_Ap_WIRInputQual_QualWhlFreqL_Hz_f32" 0 DISPLAY_IDENTIFIER Ap_WhlImbRej.ReceiverPorts.QualWhlFreqL.Hz_f32 /end MEASUREMENT
/begin MEASUREMENT Ap_WhlImbRej.QualWhlFreqR.Hz_f32 "MICROSAR RTE" FLOAT32_IEEE NO_COMPU_METHOD 0 0 1.175494351e-38 3.402823466e+38 ECU_ADDRESS 0 SYMBOL_LINK "Rte_Ap_WIRInputQual_QualWhlFreqR_Hz_f32" 0 DISPLAY_IDENTIFIER Ap_WhlImbRej.ReceiverPorts.QualWhlFreqR.Hz_f32 /end MEASUREMENT
/begin MEASUREMENT Ap_WhlImbRej.SystemState.Mode "MICROSAR RTE" UBYTE RTE_CM_ENUM_StaMd_Mode 0 0 0 255 ECU_ADDRESS 0 SYMBOL_LINK "Rte_ModeMachine_StaMd_SystemState_Mode" 0 DISPLAY_IDENTIFIER Ap_WhlImbRej.ModeRequirePorts.SystemState.Mode /end MEASUREMENT
/begin MEASUREMENT Ap_WhlImbRej.VehSpd.Kph_f32 "MICROSAR RTE" FLOAT32_IEEE NO_COMPU_METHOD 0 0 1.175494351e-38 3.402823466e+38 ECU_ADDRESS 0 SYMBOL_LINK "Rte_Ap_SignlCondn_VehicleSpeed_Kph_f32" 0 DISPLAY_IDENTIFIER Ap_WhlImbRej.ReceiverPorts.VehSpd.Kph_f32 /end MEASUREMENT
/begin MEASUREMENT Ap_WhlImbRej.VehSpdValid.Cnt_lgc "MICROSAR RTE" UBYTE RTE_CM_BOOLEAN 0 0 0 255 ECU_ADDRESS 0 SYMBOL_LINK "Rte_SrlComInput_SrlComVehSpdValid_Cnt_lgc" 0 DISPLAY_IDENTIFIER Ap_WhlImbRej.ReceiverPorts.VehSpdValid.Cnt_lgc /end MEASUREMENT
/begin MEASUREMENT Ap_WhlImbRej.WIRCmdAmpBlnd.MtrNm_f32 "MICROSAR RTE" FLOAT32_IEEE NO_COMPU_METHOD 0 0 1.175494351e-38 3.402823466e+38 ECU_ADDRESS 0 SYMBOL_LINK "Rte_Ap_WhlImbRej_WIRCmdAmpBlnd_MtrNm_f32" 0 DISPLAY_IDENTIFIER Ap_WhlImbRej.SenderPorts.WIRCmdAmpBlnd.MtrNm_f32 /end MEASUREMENT
/begin MEASUREMENT Ap_WhlImbRej.WIRMfgEnable.Cnt_lgc "MICROSAR RTE" UBYTE RTE_CM_BOOLEAN 0 0 0 255 ECU_ADDRESS 0 SYMBOL_LINK "Rte_CDDInterface_WIREnabled_Cnt_lgc" 0 DISPLAY_IDENTIFIER Ap_WhlImbRej.ReceiverPorts.WIRMfgEnable.Cnt_lgc /end MEASUREMENT
/begin MEASUREMENT Ap_WhlImbRej.WhlFreqQualified.Cnt_lgc "MICROSAR RTE" UBYTE RTE_CM_BOOLEAN 0 0 0 255 ECU_ADDRESS 0 SYMBOL_LINK "Rte_Ap_WIRInputQual_WhlFreqQualified_Cnt_lgc" 0 DISPLAY_IDENTIFIER Ap_WhlImbRej.ReceiverPorts.WhlFreqQualified.Cnt_lgc /end MEASUREMENT
/begin MEASUREMENT Ap_WhlImbRej.WhlImbRejCmd.MtrNm_f32 "MICROSAR RTE" FLOAT32_IEEE NO_COMPU_METHOD 0 0 1.175494351e-38 3.402823466e+38 ECU_ADDRESS 0 SYMBOL_LINK "Rte_Ap_WhlImbRej_WhlImbRejCmd_MtrNm_f32" 0 DISPLAY_IDENTIFIER Ap_WhlImbRej.SenderPorts.WhlImbRejCmd.MtrNm_f32 /end MEASUREMENT
/begin MEASUREMENT Ap_ePWM2.SystemState.Mode "MICROSAR RTE" UBYTE RTE_CM_ENUM_StaMd_Mode 0 0 0 255 ECU_ADDRESS 0 SYMBOL_LINK "Rte_ModeMachine_StaMd_SystemState_Mode" 0 DISPLAY_IDENTIFIER Ap_ePWM2.ModeRequirePorts.SystemState.Mode /end MEASUREMENT
/begin MEASUREMENT Assist.AssistDDFactor.Uls_f32 "MICROSAR RTE" FLOAT32_IEEE NO_COMPU_METHOD 0 0 1.175494351e-38 3.402823466e+38 ECU_ADDRESS 0 SYMBOL_LINK "Rte_Assist_AssistDDFactor_Uls_f32" 0 DISPLAY_IDENTIFIER Assist.ReceiverPorts.AssistDDFactor.Uls_f32 /end MEASUREMENT
/begin MEASUREMENT Assist.BaseAssistCmd.MtrNm_f32 "MICROSAR RTE" FLOAT32_IEEE NO_COMPU_METHOD 0 0 1.175494351e-38 3.402823466e+38 ECU_ADDRESS 0 SYMBOL_LINK "Rte_Assist_BaseAssistCmd_MtrNm_f32" 0 DISPLAY_IDENTIFIER Assist.SenderPorts.BaseAssistCmd.MtrNm_f32 /end MEASUREMENT
/begin MEASUREMENT Assist.DftAsstTbl.Cnt_lgc "MICROSAR RTE" UBYTE RTE_CM_BOOLEAN 0 0 0 255 ECU_ADDRESS 0 SYMBOL_LINK "Rte_CDDInterface_DftAsstTbl_Cnt_lgc" 0 DISPLAY_IDENTIFIER Assist.ReceiverPorts.DftAsstTbl.Cnt_lgc /end MEASUREMENT
/begin MEASUREMENT Assist.DutyCycleLevel.Uls_f32 "MICROSAR RTE" FLOAT32_IEEE NO_COMPU_METHOD 0 0 1.175494351e-38 3.402823466e+38 ECU_ADDRESS 0 SYMBOL_LINK "Rte_Ap_ThrmlDutyCycle_DutyCycleLevel_Uls_f32" 0 DISPLAY_IDENTIFIER Assist.ReceiverPorts.DutyCycleLevel.Uls_f32 /end MEASUREMENT
/begin MEASUREMENT Assist.DwnldAsstGain.Uls_f32 "MICROSAR RTE" FLOAT32_IEEE NO_COMPU_METHOD 0 0 1.175494351e-38 3.402823466e+38 ECU_ADDRESS 0 SYMBOL_LINK "Rte_CDDInterface_DwnldAsstGain_Uls_f32" 0 DISPLAY_IDENTIFIER Assist.ReceiverPorts.DwnldAsstGain.Uls_f32 /end MEASUREMENT
/begin MEASUREMENT Assist.HwTrq.HwNm_f32 "MICROSAR RTE" FLOAT32_IEEE NO_COMPU_METHOD 0 0 1.175494351e-38 3.402823466e+38 ECU_ADDRESS 0 SYMBOL_LINK "Rte_HwTrq_AnaHwTorque_HwNm_f32" 0 DISPLAY_IDENTIFIER Assist.ReceiverPorts.HwTrq.HwNm_f32 /end MEASUREMENT
/begin MEASUREMENT Assist.HwTrqHysAdd.HwNm_f32 "MICROSAR RTE" FLOAT32_IEEE NO_COMPU_METHOD 0 0 1.175494351e-38 3.402823466e+38 ECU_ADDRESS 0 SYMBOL_LINK "Rte_Assist_HwTrqHysAdd_HwNm_f32" 0 DISPLAY_IDENTIFIER Assist.ReceiverPorts.HwTrqHysAdd.HwNm_f32 /end MEASUREMENT
/begin MEASUREMENT Assist.IpTrqOvr.HwNm_f32 "MICROSAR RTE" FLOAT32_IEEE NO_COMPU_METHOD 0 0 1.175494351e-38 3.402823466e+38 ECU_ADDRESS 0 SYMBOL_LINK "Rte_Ap_ArbLmt_IpTrqOvr_HwNm_f32" 0 DISPLAY_IDENTIFIER Assist.ReceiverPorts.IpTrqOvr.HwNm_f32 /end MEASUREMENT
/begin MEASUREMENT Assist.VehSpd.Kph_f32 "MICROSAR RTE" FLOAT32_IEEE NO_COMPU_METHOD 0 0 1.175494351e-38 3.402823466e+38 ECU_ADDRESS 0 SYMBOL_LINK "Rte_Ap_SignlCondn_VehicleSpeed_Kph_f32" 0 DISPLAY_IDENTIFIER Assist.ReceiverPorts.VehSpd.Kph_f32 /end MEASUREMENT
/begin MEASUREMENT Assist.WIRCmdAmpBlnd.MtrNm_f32 "MICROSAR RTE" FLOAT32_IEEE NO_COMPU_METHOD 0 0 1.175494351e-38 3.402823466e+38 ECU_ADDRESS 0 SYMBOL_LINK "Rte_Ap_WhlImbRej_WIRCmdAmpBlnd_MtrNm_f32" 0 DISPLAY_IDENTIFIER Assist.ReceiverPorts.WIRCmdAmpBlnd.MtrNm_f32 /end MEASUREMENT
/begin MEASUREMENT BatteryVoltage.Batt.Volt_f32 "This signal is intended to communicate any type voltage signal measured by the ecu.  This signal has a lower limit of 0 which reequires users of the signal to provide divide by 0 protection if it is used as a denominator in a calculation.  See Vecu port p" FLOAT32_IEEE NO_COMPU_METHOD 0 0 1.175494351e-38 3.402823466e+38 ECU_ADDRESS 0 SYMBOL_LINK "Rte_IoHwAbstractionUsr_Batt_Volt_f32" 0 DISPLAY_IDENTIFIER BatteryVoltage.ReceiverPorts.Batt.Volt_f32 /end MEASUREMENT
/begin MEASUREMENT BatteryVoltage.BattSwitched.Volt_f32 "This signal is intended to communicate any type voltage signal measured by the ecu.  This signal has a lower limit of 0 which reequires users of the signal to provide divide by 0 protection if it is used as a denominator in a calculation.  See Vecu port p" FLOAT32_IEEE NO_COMPU_METHOD 0 0 1.175494351e-38 3.402823466e+38 ECU_ADDRESS 0 SYMBOL_LINK "Rte_IoHwAbstractionUsr_BattSwitched_Volt_f32" 0 DISPLAY_IDENTIFIER BatteryVoltage.ReceiverPorts.BattSwitched.Volt_f32 /end MEASUREMENT
/begin MEASUREMENT BatteryVoltage.OvervoltageData.MaxBattVoltage_Volts_f32 "MICROSAR RTE" FLOAT32_IEEE NO_COMPU_METHOD 0 0 1.175494351e-38 3.402823466e+38 ECU_ADDRESS 0 SYMBOL_LINK "Rte_BatteryVoltage_OvervoltageData.MaxBattVoltage_Volts_f32" 0 DISPLAY_IDENTIFIER BatteryVoltage.PerInstanceMemories.OvervoltageData.MaxBattVoltage_Volts_f32 READ_WRITE /end MEASUREMENT
/begin MEASUREMENT BatteryVoltage.OvervoltageData.OvervoltageCounter_Cnt_u16 "MICROSAR RTE" UWORD NO_COMPU_METHOD 0 0 0 65535 ECU_ADDRESS 0 SYMBOL_LINK "Rte_BatteryVoltage_OvervoltageData.OvervoltageCounter_Cnt_u16" 0 DISPLAY_IDENTIFIER BatteryVoltage.PerInstanceMemories.OvervoltageData.OvervoltageCounter_Cnt_u16 READ_WRITE /end MEASUREMENT
/begin MEASUREMENT BatteryVoltage.SysCVSwitch.Volt_f32 "This signal is intended to communicate any type voltage signal measured by the ecu.  This signal has a lower limit of 0 which reequires users of the signal to provide divide by 0 protection if it is used as a denominator in a calculation.  See Vecu port p" FLOAT32_IEEE NO_COMPU_METHOD 0 0 1.175494351e-38 3.402823466e+38 ECU_ADDRESS 0 SYMBOL_LINK "Rte_IoHwAbstractionUsr_SysCVSwitch_Volt_f32" 0 DISPLAY_IDENTIFIER BatteryVoltage.ReceiverPorts.SysCVSwitch.Volt_f32 /end MEASUREMENT
/begin MEASUREMENT BatteryVoltage.SysC_Vecu.Volt_f32 "This port prototype is inteded to communicate voltage signals that represent the ecu supplied voltage.  This signal has a lower limit, which is non-zero, to allow users of the signal to use it as a denominator in an expression without requiring a divide b" FLOAT32_IEEE NO_COMPU_METHOD 0 0 1.175494351e-38 3.402823466e+38 ECU_ADDRESS 0 SYMBOL_LINK "Rte_BatteryVoltage_SysC_Vecu_Volt_f32" 0 DISPLAY_IDENTIFIER BatteryVoltage.SenderPorts.SysC_Vecu.Volt_f32 /end MEASUREMENT
/begin MEASUREMENT BatteryVoltage.SystemState.Mode "MICROSAR RTE" UBYTE RTE_CM_ENUM_StaMd_Mode 0 0 0 255 ECU_ADDRESS 0 SYMBOL_LINK "Rte_ModeMachine_Ap_StaMd9_SystemState9_Mode" 0 DISPLAY_IDENTIFIER BatteryVoltage.ModeRequirePorts.SystemState.Mode /end MEASUREMENT
/begin MEASUREMENT BatteryVoltage.Vecu.Volt_f32 "This port prototype is inteded to communicate voltage signals that represent the ecu supplied voltage.  This signal has a lower limit, which is non-zero, to allow users of the signal to use it as a denominator in an expression without requiring a divide b" FLOAT32_IEEE NO_COMPU_METHOD 0 0 1.175494351e-38 3.402823466e+38 ECU_ADDRESS 0 SYMBOL_LINK "Rte_BatteryVoltage_Vecu_Volt_f32" 0 DISPLAY_IDENTIFIER BatteryVoltage.SenderPorts.Vecu.Volt_f32 /end MEASUREMENT
/begin MEASUREMENT BatteryVoltage.VswitchClosed.Cnt_lgc "MICROSAR RTE" UBYTE RTE_CM_BOOLEAN 0 0 0 255 ECU_ADDRESS 0 SYMBOL_LINK "Rte_BatteryVoltage_VswitchClosed_Cnt_lgc" 0 DISPLAY_IDENTIFIER BatteryVoltage.SenderPorts.VswitchClosed.Cnt_lgc /end MEASUREMENT
/begin MEASUREMENT CDDInterface.ADCMtrCurr1.Volts_f32 "MICROSAR RTE" FLOAT32_IEEE NO_COMPU_METHOD 0 0 1.175494351e-38 3.402823466e+38 ECU_ADDRESS 0 SYMBOL_LINK "Rte_CDDInterface_ADCMtrCurr1_Volts_f32" 0 DISPLAY_IDENTIFIER CDDInterface.SenderPorts.ADCMtrCurr1.Volts_f32 /end MEASUREMENT
/begin MEASUREMENT CDDInterface.ADCMtrCurr2.Volts_f32 "MICROSAR RTE" FLOAT32_IEEE NO_COMPU_METHOD 0 0 1.175494351e-38 3.402823466e+38 ECU_ADDRESS 0 SYMBOL_LINK "Rte_CDDInterface_ADCMtrCurr2_Volts_f32" 0 DISPLAY_IDENTIFIER CDDInterface.SenderPorts.ADCMtrCurr2.Volts_f32 /end MEASUREMENT
/begin MEASUREMENT CDDInterface.CommOffset.Cnt_u16 "MICROSAR RTE" UWORD NO_COMPU_METHOD 0 0 0 65535 ECU_ADDRESS 0 SYMBOL_LINK "Rte_CmMtrCurr_ComOffset_Cnt_u16" 0 DISPLAY_IDENTIFIER CDDInterface.ReceiverPorts.CommOffset.Cnt_u16 /end MEASUREMENT
/begin MEASUREMENT CDDInterface.CorrMtrCurrPosition.Rev_f32 "MICROSAR RTE" FLOAT32_IEEE NO_COMPU_METHOD 0 0 1.175494351e-38 3.402823466e+38 ECU_ADDRESS 0 SYMBOL_LINK "Rte_CDDInterface_CorrMtrCurrPosition_Rev_f32" 0 DISPLAY_IDENTIFIER CDDInterface.SenderPorts.CorrMtrCurrPosition.Rev_f32 /end MEASUREMENT
/begin MEASUREMENT CDDInterface.CorrMtrPosElec.Rev_f32 "MICROSAR RTE" FLOAT32_IEEE NO_COMPU_METHOD 0 0 1.175494351e-38 3.402823466e+38 ECU_ADDRESS 0 SYMBOL_LINK "Rte_CDDInterface_CorrMtrPosElec_Rev_f32" 0 DISPLAY_IDENTIFIER CDDInterface.SenderPorts.CorrMtrPosElec.Rev_f32 /end MEASUREMENT
/begin MEASUREMENT CDDInterface.Cos1Theta.Volts_f32 "MICROSAR RTE" FLOAT32_IEEE NO_COMPU_METHOD 0 0 1.175494351e-38 3.402823466e+38 ECU_ADDRESS 0 SYMBOL_LINK "Rte_CDDInterface_Cos1Theta_Volts_f32" 0 DISPLAY_IDENTIFIER CDDInterface.SenderPorts.Cos1Theta.Volts_f32 /end MEASUREMENT
/begin MEASUREMENT CDDInterface.DampingSrlComSvcDft.Cnt_lgc "MICROSAR RTE" UBYTE RTE_CM_BOOLEAN 0 0 0 255 ECU_ADDRESS 0 SYMBOL_LINK "Rte_CDDInterface_DampingSrlComSvcDft_Cnt_lgc" 0 DISPLAY_IDENTIFIER CDDInterface.SenderPorts.DampingSrlComSvcDft.Cnt_lgc /end MEASUREMENT
/begin MEASUREMENT CDDInterface.DaxIntegralGain_IPM.Uls_f32 "MICROSAR RTE" FLOAT32_IEEE NO_COMPU_METHOD 0 0 1.175494351e-38 3.402823466e+38 ECU_ADDRESS 0 SYMBOL_LINK "Rte_CDDInterface_DaxIntegralGain_IPM_Uls_f32" 0 DISPLAY_IDENTIFIER CDDInterface.ReceiverPorts.DaxIntegralGain_IPM.Uls_f32 /end MEASUREMENT
/begin MEASUREMENT CDDInterface.DaxIntegralGain_SPM.Uls_f32 "MICROSAR RTE" FLOAT32_IEEE NO_COMPU_METHOD 0 0 1.175494351e-38 3.402823466e+38 ECU_ADDRESS 0 SYMBOL_LINK "Rte_CDDInterface_DaxIntegralGain_SPM_Uls_f32" 0 DISPLAY_IDENTIFIER CDDInterface.ReceiverPorts.DaxIntegralGain_SPM.Uls_f32 /end MEASUREMENT
/begin MEASUREMENT CDDInterface.DaxPropotionalGain_IPM.Uls_f32 "MICROSAR RTE" FLOAT32_IEEE NO_COMPU_METHOD 0 0 1.175494351e-38 3.402823466e+38 ECU_ADDRESS 0 SYMBOL_LINK "Rte_CDDInterface_DaxPropotionalGain_IPM_Uls_f32" 0 DISPLAY_IDENTIFIER CDDInterface.ReceiverPorts.DaxPropotionalGain_IPM.Uls_f32 /end MEASUREMENT
/begin MEASUREMENT CDDInterface.DaxPropotionalGain_SPM.Uls_f32 "MICROSAR RTE" FLOAT32_IEEE NO_COMPU_METHOD 0 0 1.175494351e-38 3.402823466e+38 ECU_ADDRESS 0 SYMBOL_LINK "Rte_CDDInterface_DaxPropotionalGain_SPM_Uls_f32" 0 DISPLAY_IDENTIFIER CDDInterface.ReceiverPorts.DaxPropotionalGain_SPM.Uls_f32 /end MEASUREMENT
/begin MEASUREMENT CDDInterface.DftAsstTbl.Cnt_lgc "MICROSAR RTE" UBYTE RTE_CM_BOOLEAN 0 0 0 255 ECU_ADDRESS 0 SYMBOL_LINK "Rte_CDDInterface_DftAsstTbl_Cnt_lgc" 0 DISPLAY_IDENTIFIER CDDInterface.SenderPorts.DftAsstTbl.Cnt_lgc /end MEASUREMENT
/begin MEASUREMENT CDDInterface.DrivingDynSrlComSvcDft.Cnt_lgc "MICROSAR RTE" UBYTE RTE_CM_BOOLEAN 0 0 0 255 ECU_ADDRESS 0 SYMBOL_LINK "Rte_CDDInterface_DrivingDynSrlComSvcDft_Cnt_lgc" 0 DISPLAY_IDENTIFIER CDDInterface.SenderPorts.DrivingDynSrlComSvcDft.Cnt_lgc /end MEASUREMENT
/begin MEASUREMENT CDDInterface.DutyCycleSmall.Cnt_u16 "MICROSAR RTE" UWORD NO_COMPU_METHOD 0 0 0 65535 ECU_ADDRESS 0 SYMBOL_LINK "Rte_CDDInterface_DutyCycleSmall_Cnt_u16" 0 DISPLAY_IDENTIFIER CDDInterface.SenderPorts.DutyCycleSmall.Cnt_u16 /end MEASUREMENT
/begin MEASUREMENT CDDInterface.DwnldAsstGain.Uls_f32 "MICROSAR RTE" FLOAT32_IEEE NO_COMPU_METHOD 0 0 1.175494351e-38 3.402823466e+38 ECU_ADDRESS 0 SYMBOL_LINK "Rte_CDDInterface_DwnldAsstGain_Uls_f32" 0 DISPLAY_IDENTIFIER CDDInterface.SenderPorts.DwnldAsstGain.Uls_f32 /end MEASUREMENT
/begin MEASUREMENT CDDInterface.EOTImpactSrlComSvcDft.Cnt_lgc "MICROSAR RTE" UBYTE RTE_CM_BOOLEAN 0 0 0 255 ECU_ADDRESS 0 SYMBOL_LINK "Rte_CDDInterface_EOTImpactSrlComSvcDft_Cnt_lgc" 0 DISPLAY_IDENTIFIER CDDInterface.SenderPorts.EOTImpactSrlComSvcDft.Cnt_lgc /end MEASUREMENT
/begin MEASUREMENT CDDInterface.EOTThermalSrlComSvcDft.Cnt_lgc "MICROSAR RTE" UBYTE RTE_CM_BOOLEAN 0 0 0 255 ECU_ADDRESS 0 SYMBOL_LINK "Rte_CDDInterface_EOTThermalSrlComSvcDft_Cnt_lgc" 0 DISPLAY_IDENTIFIER CDDInterface.SenderPorts.EOTThermalSrlComSvcDft.Cnt_lgc /end MEASUREMENT
/begin MEASUREMENT CDDInterface.EngONSrlComSvcDft.Cnt_lgc "MICROSAR RTE" UBYTE RTE_CM_BOOLEAN 0 0 0 255 ECU_ADDRESS 0 SYMBOL_LINK "Rte_CDDInterface_EngONSrlComSvcDft_Cnt_lgc" 0 DISPLAY_IDENTIFIER CDDInterface.SenderPorts.EngONSrlComSvcDft.Cnt_lgc /end MEASUREMENT
/begin MEASUREMENT CDDInterface.EstKe.VpRadpS_f32 "MICROSAR RTE" FLOAT32_IEEE NO_COMPU_METHOD 0 0 1.175494351e-38 3.402823466e+38 ECU_ADDRESS 0 SYMBOL_LINK "Rte_CurrParamComp_EstKe_VpRadpS_f32" 0 DISPLAY_IDENTIFIER CDDInterface.ReceiverPorts.EstKe.VpRadpS_f32 /end MEASUREMENT
/begin MEASUREMENT CDDInterface.ExpectedOnTimeA.Cnt_u32 "MICROSAR RTE" ULONG NO_COMPU_METHOD 0 0 0 4294967295 ECU_ADDRESS 0 SYMBOL_LINK "Rte_CDDInterface_ExpectedOnTimeA_Cnt_u32" 0 DISPLAY_IDENTIFIER CDDInterface.SenderPorts.ExpectedOnTimeA.Cnt_u32 /end MEASUREMENT
/begin MEASUREMENT CDDInterface.ExpectedOnTimeB.Cnt_u32 "MICROSAR RTE" ULONG NO_COMPU_METHOD 0 0 0 4294967295 ECU_ADDRESS 0 SYMBOL_LINK "Rte_CDDInterface_ExpectedOnTimeB_Cnt_u32" 0 DISPLAY_IDENTIFIER CDDInterface.SenderPorts.ExpectedOnTimeB.Cnt_u32 /end MEASUREMENT
/begin MEASUREMENT CDDInterface.ExpectedOnTimeC.Cnt_u32 "MICROSAR RTE" ULONG NO_COMPU_METHOD 0 0 0 4294967295 ECU_ADDRESS 0 SYMBOL_LINK "Rte_CDDInterface_ExpectedOnTimeC_Cnt_u32" 0 DISPLAY_IDENTIFIER CDDInterface.SenderPorts.ExpectedOnTimeC.Cnt_u32 /end MEASUREMENT
/begin MEASUREMENT CDDInterface.FETFaultPhase.Cnt_enum "MICROSAR RTE" UBYTE RTE_CM_ENUM_FETPHASETYPE_ENUM 0 0 0 255 ECU_ADDRESS 0 SYMBOL_LINK "Rte_MtrDrvDiag_FETFaultPhase_Cnt_enum" 0 DISPLAY_IDENTIFIER CDDInterface.ReceiverPorts.FETFaultPhase.Cnt_enum /end MEASUREMENT
/begin MEASUREMENT CDDInterface.FETFaultType.Cnt_enum "MICROSAR RTE" UBYTE RTE_CM_ENUM_FETFAULTTYPE_ENUM 0 0 0 255 ECU_ADDRESS 0 SYMBOL_LINK "Rte_MtrDrvDiag_FETFaultType_Cnt_enum" 0 DISPLAY_IDENTIFIER CDDInterface.ReceiverPorts.FETFaultType.Cnt_enum /end MEASUREMENT
/begin MEASUREMENT CDDInterface.FreqDepDmpSrlComSvcDft.Cnt_lgc "MICROSAR RTE" UBYTE RTE_CM_BOOLEAN 0 0 0 255 ECU_ADDRESS 0 SYMBOL_LINK "Rte_CDDInterface_FreqDepDmpSrlComSvcDft_Cnt_lgc" 0 DISPLAY_IDENTIFIER CDDInterface.SenderPorts.FreqDepDmpSrlComSvcDft.Cnt_lgc /end MEASUREMENT
/begin MEASUREMENT CDDInterface.FricLrnSrlComSvcDft.Cnt_lgc "MICROSAR RTE" UBYTE RTE_CM_BOOLEAN 0 0 0 255 ECU_ADDRESS 0 SYMBOL_LINK "Rte_CDDInterface_FricLrnSrlComSvcDft_Cnt_lgc" 0 DISPLAY_IDENTIFIER CDDInterface.SenderPorts.FricLrnSrlComSvcDft.Cnt_lgc /end MEASUREMENT
/begin MEASUREMENT CDDInterface.HysAddSrlComSvcDft.Cnt_lgc "MICROSAR RTE" UBYTE RTE_CM_BOOLEAN 0 0 0 255 ECU_ADDRESS 0 SYMBOL_LINK "Rte_CDDInterface_HysAddSrlComSvcDft_Cnt_lgc" 0 DISPLAY_IDENTIFIER CDDInterface.SenderPorts.HysAddSrlComSvcDft.Cnt_lgc /end MEASUREMENT
/begin MEASUREMENT CDDInterface.HystCompSrlComSvcDft.Cnt_lgc "MICROSAR RTE" UBYTE RTE_CM_BOOLEAN 0 0 0 255 ECU_ADDRESS 0 SYMBOL_LINK "Rte_CDDInterface_HystCompSrlComSvcDft_Cnt_lgc" 0 DISPLAY_IDENTIFIER CDDInterface.SenderPorts.HystCompSrlComSvcDft.Cnt_lgc /end MEASUREMENT
/begin MEASUREMENT CDDInterface.IgnCnt.Cnt_u16 "MICROSAR RTE" UWORD NO_COMPU_METHOD 0 0 0 65535 ECU_ADDRESS 0 SYMBOL_LINK "Rte_CDDInterface_IgnCnt_Cnt_u16" 0 DISPLAY_IDENTIFIER CDDInterface.SenderPorts.IgnCnt.Cnt_u16 /end MEASUREMENT
/begin MEASUREMENT CDDInterface.KinIntDiagSrlComSvcDft.Cnt_lgc "MICROSAR RTE" UBYTE RTE_CM_BOOLEAN 0 0 0 255 ECU_ADDRESS 0 SYMBOL_LINK "Rte_CDDInterface_KinIntDiagSrlComSvcDft_Cnt_lgc" 0 DISPLAY_IDENTIFIER CDDInterface.SenderPorts.KinIntDiagSrlComSvcDft.Cnt_lgc /end MEASUREMENT
/begin MEASUREMENT CDDInterface.LRPRPhaseadvanceCaptured.Cnt_s16 "MICROSAR RTE" SWORD NO_COMPU_METHOD 0 0 -32768 32767 ECU_ADDRESS 0 SYMBOL_LINK "Rte_CDDInterface_LRPRPhaseadvanceCaptured_Cnt_s16" 0 DISPLAY_IDENTIFIER CDDInterface.SenderPorts.LRPRPhaseadvanceCaptured.Cnt_s16 /end MEASUREMENT
/begin MEASUREMENT CDDInterface.LimitSrlComSvcDft.Cnt_lgc "MICROSAR RTE" UBYTE RTE_CM_BOOLEAN 0 0 0 255 ECU_ADDRESS 0 SYMBOL_LINK "Rte_CDDInterface_LimitSrlComSvcDft_Cnt_lgc" 0 DISPLAY_IDENTIFIER CDDInterface.SenderPorts.LimitSrlComSvcDft.Cnt_lgc /end MEASUREMENT
/begin MEASUREMENT CDDInterface.MEC.Cnt_enum "MICROSAR RTE" UBYTE RTE_CM_ENUM_ManufModeType 0 0 0 2 ECU_ADDRESS 0 SYMBOL_LINK "Rte_CDDInterface_MEC_Cnt_enum" 0 DISPLAY_IDENTIFIER CDDInterface.SenderPorts.MEC.Cnt_enum /end MEASUREMENT
/begin MEASUREMENT CDDInterface.MRFMtrVel.MtrRadpS_f32 "MICROSAR RTE" FLOAT32_IEEE NO_COMPU_METHOD 0 0 1.175494351e-38 3.402823466e+38 ECU_ADDRESS 0 SYMBOL_LINK "Rte_MtrVel_MRFMotorVel_MtrRadpS_f32" 0 DISPLAY_IDENTIFIER CDDInterface.ReceiverPorts.MRFMtrVel.MtrRadpS_f32 /end MEASUREMENT
/begin MEASUREMENT CDDInterface.MeasuredOnTimeA.Cnt_u32 "MICROSAR RTE" ULONG NO_COMPU_METHOD 0 0 0 4294967295 ECU_ADDRESS 0 SYMBOL_LINK "Rte_CDDInterface_MeasuredOnTimeA_Cnt_u32" 0 DISPLAY_IDENTIFIER CDDInterface.SenderPorts.MeasuredOnTimeA.Cnt_u32 /end MEASUREMENT
/begin MEASUREMENT CDDInterface.MeasuredOnTimeB.Cnt_u32 "MICROSAR RTE" ULONG NO_COMPU_METHOD 0 0 0 4294967295 ECU_ADDRESS 0 SYMBOL_LINK "Rte_CDDInterface_MeasuredOnTimeB_Cnt_u32" 0 DISPLAY_IDENTIFIER CDDInterface.SenderPorts.MeasuredOnTimeB.Cnt_u32 /end MEASUREMENT
/begin MEASUREMENT CDDInterface.MeasuredOnTimeC.Cnt_u32 "MICROSAR RTE" ULONG NO_COMPU_METHOD 0 0 0 4294967295 ECU_ADDRESS 0 SYMBOL_LINK "Rte_CDDInterface_MeasuredOnTimeC_Cnt_u32" 0 DISPLAY_IDENTIFIER CDDInterface.SenderPorts.MeasuredOnTimeC.Cnt_u32 /end MEASUREMENT
/begin MEASUREMENT CDDInterface.MfgDiagInhibit.Cnt_lgc "MICROSAR RTE" UBYTE RTE_CM_BOOLEAN 0 0 0 255 ECU_ADDRESS 0 SYMBOL_LINK "Rte_CDDInterface_MfgDiagInhibit_Cnt_lgc" 0 DISPLAY_IDENTIFIER CDDInterface.SenderPorts.MfgDiagInhibit.Cnt_lgc /end MEASUREMENT
/begin MEASUREMENT CDDInterface.ModIdxFinal.Uls_f32 "MICROSAR RTE" FLOAT32_IEEE NO_COMPU_METHOD 0 0 1.175494351e-38 3.402823466e+38 ECU_ADDRESS 0 SYMBOL_LINK "Rte_CDDInterface_ModIdxFinal_Uls_f32" 0 DISPLAY_IDENTIFIER CDDInterface.SenderPorts.ModIdxFinal.Uls_f32 /end MEASUREMENT
/begin MEASUREMENT CDDInterface.ModIdxSrlComSvcDft.Cnt_lgc "MICROSAR RTE" UBYTE RTE_CM_BOOLEAN 0 0 0 255 ECU_ADDRESS 0 SYMBOL_LINK "Rte_CDDInterface_ModIdxSrlComSvcDft_Cnt_lgc" 0 DISPLAY_IDENTIFIER CDDInterface.SenderPorts.ModIdxSrlComSvcDft.Cnt_lgc /end MEASUREMENT
/begin MEASUREMENT CDDInterface.MtrCurr1TempOffset.Volt_f32 "This signal is intended to communicate any type voltage signal measured by the ecu.  This signal has a lower limit of 0 which reequires users of the signal to provide divide by 0 protection if it is used as a denominator in a calculation.  See Vecu port p" FLOAT32_IEEE NO_COMPU_METHOD 0 0 1.175494351e-38 3.402823466e+38 ECU_ADDRESS 0 SYMBOL_LINK "Rte_CmMtrCurr_MtrCurr1TempOffset_Volt_f32" 0 DISPLAY_IDENTIFIER CDDInterface.ReceiverPorts.MtrCurr1TempOffset.Volt_f32 /end MEASUREMENT
/begin MEASUREMENT CDDInterface.MtrCurr2TempOffset.Volt_f32 "This signal is intended to communicate any type voltage signal measured by the ecu.  This signal has a lower limit of 0 which reequires users of the signal to provide divide by 0 protection if it is used as a denominator in a calculation.  See Vecu port p" FLOAT32_IEEE NO_COMPU_METHOD 0 0 1.175494351e-38 3.402823466e+38 ECU_ADDRESS 0 SYMBOL_LINK "Rte_CmMtrCurr_MtrCurr2TempOffset_Volt_f32" 0 DISPLAY_IDENTIFIER CDDInterface.ReceiverPorts.MtrCurr2TempOffset.Volt_f32 /end MEASUREMENT
/begin MEASUREMENT CDDInterface.MtrCurrDax.Amp_f32 "MICROSAR RTE" FLOAT32_IEEE NO_COMPU_METHOD 0 0 1.175494351e-38 3.402823466e+38 ECU_ADDRESS 0 SYMBOL_LINK "Rte_CDDInterface_MtrCurrDax_Amp_f32" 0 DISPLAY_IDENTIFIER CDDInterface.SenderPorts.MtrCurrDax.Amp_f32 /end MEASUREMENT
/begin MEASUREMENT CDDInterface.MtrCurrDaxRef.Amp_f32 "MICROSAR RTE" FLOAT32_IEEE NO_COMPU_METHOD 0 0 1.175494351e-38 3.402823466e+38 ECU_ADDRESS 0 SYMBOL_LINK "Rte_CDDInterface_MtrCurrDaxRef_Amp_f32" 0 DISPLAY_IDENTIFIER CDDInterface.SenderPorts.MtrCurrDaxRef.Amp_f32 /end MEASUREMENT
/begin MEASUREMENT CDDInterface.MtrCurrDaxRef_IPM.Amp_f32 "MICROSAR RTE" FLOAT32_IEEE NO_COMPU_METHOD 0 0 1.175494351e-38 3.402823466e+38 ECU_ADDRESS 0 SYMBOL_LINK "Rte_CDDInterface_MtrCurrDaxRef_IPM_Amp_f32" 0 DISPLAY_IDENTIFIER CDDInterface.ReceiverPorts.MtrCurrDaxRef_IPM.Amp_f32 /end MEASUREMENT
/begin MEASUREMENT CDDInterface.MtrCurrDaxRef_SPM.Amp_f32 "MICROSAR RTE" FLOAT32_IEEE NO_COMPU_METHOD 0 0 1.175494351e-38 3.402823466e+38 ECU_ADDRESS 0 SYMBOL_LINK "Rte_CurrCmd_MtrCurrDaxRef_Amp_f32" 0 DISPLAY_IDENTIFIER CDDInterface.ReceiverPorts.MtrCurrDaxRef_SPM.Amp_f32 /end MEASUREMENT
/begin MEASUREMENT CDDInterface.MtrCurrK1.Amp_f32 "MICROSAR RTE" FLOAT32_IEEE NO_COMPU_METHOD 0 0 1.175494351e-38 3.402823466e+38 ECU_ADDRESS 0 SYMBOL_LINK "Rte_CDDInterface_MtrCurrK1_Amp_f32" 0 DISPLAY_IDENTIFIER CDDInterface.SenderPorts.MtrCurrK1.Amp_f32 /end MEASUREMENT
/begin MEASUREMENT CDDInterface.MtrCurrK2.Amp_f32 "MICROSAR RTE" FLOAT32_IEEE NO_COMPU_METHOD 0 0 1.175494351e-38 3.402823466e+38 ECU_ADDRESS 0 SYMBOL_LINK "Rte_CDDInterface_MtrCurrK2_Amp_f32" 0 DISPLAY_IDENTIFIER CDDInterface.SenderPorts.MtrCurrK2.Amp_f32 /end MEASUREMENT
/begin MEASUREMENT CDDInterface.MtrCurrQax.Amp_f32 "MICROSAR RTE" FLOAT32_IEEE NO_COMPU_METHOD 0 0 1.175494351e-38 3.402823466e+38 ECU_ADDRESS 0 SYMBOL_LINK "Rte_CDDInterface_MtrCurrQax_Amp_f32" 0 DISPLAY_IDENTIFIER CDDInterface.SenderPorts.MtrCurrQax.Amp_f32 /end MEASUREMENT
/begin MEASUREMENT CDDInterface.MtrCurrQax12Mag.Amp_f32 "MICROSAR RTE" FLOAT32_IEEE NO_COMPU_METHOD 0 0 1.175494351e-38 3.402823466e+38 ECU_ADDRESS 0 SYMBOL_LINK "Rte_CDDInterface_MtrCurrQax12Mag_Amp_f32" 0 DISPLAY_IDENTIFIER CDDInterface.ReceiverPorts.MtrCurrQax12Mag.Amp_f32 /end MEASUREMENT
/begin MEASUREMENT CDDInterface.MtrCurrQax12Ph.Rev_f32 "MICROSAR RTE" FLOAT32_IEEE NO_COMPU_METHOD 0 0 1.175494351e-38 3.402823466e+38 ECU_ADDRESS 0 SYMBOL_LINK "Rte_CDDInterface_MtrCurrQax12Ph_Rev_f32" 0 DISPLAY_IDENTIFIER CDDInterface.ReceiverPorts.MtrCurrQax12Ph.Rev_f32 /end MEASUREMENT
/begin MEASUREMENT CDDInterface.MtrCurrQax6Mag.Amp_f32 "MICROSAR RTE" FLOAT32_IEEE NO_COMPU_METHOD 0 0 1.175494351e-38 3.402823466e+38 ECU_ADDRESS 0 SYMBOL_LINK "Rte_CDDInterface_MtrCurrQax6Mag_Amp_f32" 0 DISPLAY_IDENTIFIER CDDInterface.ReceiverPorts.MtrCurrQax6Mag.Amp_f32 /end MEASUREMENT
/begin MEASUREMENT CDDInterface.MtrCurrQax6Ph.Rev_f32 "MICROSAR RTE" FLOAT32_IEEE NO_COMPU_METHOD 0 0 1.175494351e-38 3.402823466e+38 ECU_ADDRESS 0 SYMBOL_LINK "Rte_CDDInterface_MtrCurrQax6Ph_Rev_f32" 0 DISPLAY_IDENTIFIER CDDInterface.ReceiverPorts.MtrCurrQax6Ph.Rev_f32 /end MEASUREMENT
/begin MEASUREMENT CDDInterface.MtrCurrQaxFinalRef.Amp_f32 "MICROSAR RTE" FLOAT32_IEEE NO_COMPU_METHOD 0 0 1.175494351e-38 3.402823466e+38 ECU_ADDRESS 0 SYMBOL_LINK "Rte_CDDInterface_MtrCurrQaxFinalRef_Amp_f32" 0 DISPLAY_IDENTIFIER CDDInterface.SenderPorts.MtrCurrQaxFinalRef.Amp_f32 /end MEASUREMENT
/begin MEASUREMENT CDDInterface.MtrCurrQaxRef_IPM.Amp_f32 "MICROSAR RTE" FLOAT32_IEEE NO_COMPU_METHOD 0 0 1.175494351e-38 3.402823466e+38 ECU_ADDRESS 0 SYMBOL_LINK "Rte_CDDInterface_MtrCurrQaxRef_IPM_Amp_f32" 0 DISPLAY_IDENTIFIER CDDInterface.ReceiverPorts.MtrCurrQaxRef_IPM.Amp_f32 /end MEASUREMENT
/begin MEASUREMENT CDDInterface.MtrCurrQaxRef_SPM.Amp_f32 "MICROSAR RTE" FLOAT32_IEEE NO_COMPU_METHOD 0 0 1.175494351e-38 3.402823466e+38 ECU_ADDRESS 0 SYMBOL_LINK "Rte_CurrCmd_MtrCurrQaxRef_Amp_f32" 0 DISPLAY_IDENTIFIER CDDInterface.ReceiverPorts.MtrCurrQaxRef_SPM.Amp_f32 /end MEASUREMENT
/begin MEASUREMENT CDDInterface.MtrElecMechPolarity.Cnt_s08 "MICROSAR RTE" SBYTE NO_COMPU_METHOD 0 0 -128 127 ECU_ADDRESS 0 SYMBOL_LINK "Rte_Polarity_MtrElecMechPolarity_Cnt_s08" 0 DISPLAY_IDENTIFIER CDDInterface.ReceiverPorts.MtrElecMechPolarity.Cnt_s08 /end MEASUREMENT
/begin MEASUREMENT CDDInterface.MtrParmNrmLrnSrlComSvcDft.Cnt_lgc "MICROSAR RTE" UBYTE RTE_CM_BOOLEAN 0 0 0 255 ECU_ADDRESS 0 SYMBOL_LINK "Rte_CDDInterface_MtrParmNrmLrnSrlComSvcDft_Cnt_lgc" 0 DISPLAY_IDENTIFIER CDDInterface.SenderPorts.MtrParmNrmLrnSrlComSvcDft.Cnt_lgc /end MEASUREMENT
/begin MEASUREMENT CDDInterface.MtrPosComputationDelay_IPM.Deg_f32 "MICROSAR RTE" FLOAT32_IEEE NO_COMPU_METHOD 0 0 1.175494351e-38 3.402823466e+38 ECU_ADDRESS 0 SYMBOL_LINK "Rte_CDDInterface_MtrPosComputationDelay_IPM_Deg_f32" 0 DISPLAY_IDENTIFIER CDDInterface.ReceiverPorts.MtrPosComputationDelay_IPM.Deg_f32 /end MEASUREMENT
/begin MEASUREMENT CDDInterface.MtrPosComputationDelay_SPM.Deg_f32 "MICROSAR RTE" FLOAT32_IEEE NO_COMPU_METHOD 0 0 1.175494351e-38 3.402823466e+38 ECU_ADDRESS 0 SYMBOL_LINK "Rte_CDDInterface_MtrPosComputationDelay_SPM_Deg_f32" 0 DISPLAY_IDENTIFIER CDDInterface.ReceiverPorts.MtrPosComputationDelay_SPM.Deg_f32 /end MEASUREMENT
/begin MEASUREMENT CDDInterface.MtrPosElec.Rev_f32 "MICROSAR RTE" FLOAT32_IEEE NO_COMPU_METHOD 0 0 1.175494351e-38 3.402823466e+38 ECU_ADDRESS 0 SYMBOL_LINK "Rte_CDDInterface_MtrPosElec_Rev_f32" 0 DISPLAY_IDENTIFIER CDDInterface.SenderPorts.MtrPosElec.Rev_f32 /end MEASUREMENT
/begin MEASUREMENT CDDInterface.MtrPosMech.Rev_f32 "MICROSAR RTE" FLOAT32_IEEE NO_COMPU_METHOD 0 0 1.175494351e-38 3.402823466e+38 ECU_ADDRESS 0 SYMBOL_LINK "Rte_CDDInterface_MtrPosMech_Rev_f32" 0 DISPLAY_IDENTIFIER CDDInterface.SenderPorts.MtrPosMech.Rev_f32 /end MEASUREMENT
/begin MEASUREMENT CDDInterface.MtrRevCntr.Cnt_s16 "MICROSAR RTE" SWORD NO_COMPU_METHOD 0 0 -32768 32767 ECU_ADDRESS 0 SYMBOL_LINK "Rte_CDDInterface_MtrRevCntr_Cnt_s16" 0 DISPLAY_IDENTIFIER CDDInterface.SenderPorts.MtrRevCntr.Cnt_s16 /end MEASUREMENT
/begin MEASUREMENT CDDInterface.MtrTrqCmdSign_IPM.Cnt_s16 "MICROSAR RTE" SWORD NO_COMPU_METHOD 0 0 -32768 32767 ECU_ADDRESS 0 SYMBOL_LINK "Rte_CDDInterface_MtrTrqCmdSign_IPM_Cnt_s16" 0 DISPLAY_IDENTIFIER CDDInterface.ReceiverPorts.MtrTrqCmdSign_IPM.Cnt_s16 /end MEASUREMENT
/begin MEASUREMENT CDDInterface.MtrTrqCmdSign_SPM.Cnt_s16 "MICROSAR RTE" SWORD NO_COMPU_METHOD 0 0 -32768 32767 ECU_ADDRESS 0 SYMBOL_LINK "Rte_CurrCmd_MtrTrqCmdSign_Cnt_s16" 0 DISPLAY_IDENTIFIER CDDInterface.ReceiverPorts.MtrTrqCmdSign_SPM.Cnt_s16 /end MEASUREMENT
/begin MEASUREMENT CDDInterface.MtrVelNrmLrnSrlComSvcDft.Cnt_lgc "MICROSAR RTE" UBYTE RTE_CM_BOOLEAN 0 0 0 255 ECU_ADDRESS 0 SYMBOL_LINK "Rte_CDDInterface_MtrVelNrmLrnSrlComSvcDft_Cnt_lgc" 0 DISPLAY_IDENTIFIER CDDInterface.SenderPorts.MtrVelNrmLrnSrlComSvcDft.Cnt_lgc /end MEASUREMENT
/begin MEASUREMENT CDDInterface.MtrVoltDax.Volt_f32 "This signal is intended to communicate any type voltage signal measured by the ecu.  This signal has a lower limit of 0 which reequires users of the signal to provide divide by 0 protection if it is used as a denominator in a calculation.  See Vecu port p" FLOAT32_IEEE NO_COMPU_METHOD 0 0 1.175494351e-38 3.402823466e+38 ECU_ADDRESS 0 SYMBOL_LINK "Rte_CDDInterface_MtrVoltDax_Volt_f32" 0 DISPLAY_IDENTIFIER CDDInterface.SenderPorts.MtrVoltDax.Volt_f32 /end MEASUREMENT
/begin MEASUREMENT CDDInterface.MtrVoltDaxFF_IPM.Volt_f32 "This signal is intended to communicate any type voltage signal measured by the ecu.  This signal has a lower limit of 0 which reequires users of the signal to provide divide by 0 protection if it is used as a denominator in a calculation.  See Vecu port p" FLOAT32_IEEE NO_COMPU_METHOD 0 0 1.175494351e-38 3.402823466e+38 ECU_ADDRESS 0 SYMBOL_LINK "Rte_CDDInterface_MtrVoltDaxFF_IPM_Volt_f32" 0 DISPLAY_IDENTIFIER CDDInterface.ReceiverPorts.MtrVoltDaxFF_IPM.Volt_f32 /end MEASUREMENT
/begin MEASUREMENT CDDInterface.MtrVoltDaxFF_SPM.Volt_f32 "This signal is intended to communicate any type voltage signal measured by the ecu.  This signal has a lower limit of 0 which reequires users of the signal to provide divide by 0 protection if it is used as a denominator in a calculation.  See Vecu port p" FLOAT32_IEEE NO_COMPU_METHOD 0 0 1.175494351e-38 3.402823466e+38 ECU_ADDRESS 0 SYMBOL_LINK "Rte_CurrCmd_MtrVoltDaxFF_Volt_f32" 0 DISPLAY_IDENTIFIER CDDInterface.ReceiverPorts.MtrVoltDaxFF_SPM.Volt_f32 /end MEASUREMENT
/begin MEASUREMENT CDDInterface.MtrVoltQax.Volt_f32 "This signal is intended to communicate any type voltage signal measured by the ecu.  This signal has a lower limit of 0 which reequires users of the signal to provide divide by 0 protection if it is used as a denominator in a calculation.  See Vecu port p" FLOAT32_IEEE NO_COMPU_METHOD 0 0 1.175494351e-38 3.402823466e+38 ECU_ADDRESS 0 SYMBOL_LINK "Rte_CDDInterface_MtrVoltQax_Volt_f32" 0 DISPLAY_IDENTIFIER CDDInterface.SenderPorts.MtrVoltQax.Volt_f32 /end MEASUREMENT
/begin MEASUREMENT CDDInterface.MtrVoltQaxFF_IPM.Volt_f32 "This signal is intended to communicate any type voltage signal measured by the ecu.  This signal has a lower limit of 0 which reequires users of the signal to provide divide by 0 protection if it is used as a denominator in a calculation.  See Vecu port p" FLOAT32_IEEE NO_COMPU_METHOD 0 0 1.175494351e-38 3.402823466e+38 ECU_ADDRESS 0 SYMBOL_LINK "Rte_CDDInterface_MtrVoltQaxFF_IPM_Volt_f32" 0 DISPLAY_IDENTIFIER CDDInterface.ReceiverPorts.MtrVoltQaxFF_IPM.Volt_f32 /end MEASUREMENT
/begin MEASUREMENT CDDInterface.MtrVoltQaxFF_SPM.Volt_f32 "This signal is intended to communicate any type voltage signal measured by the ecu.  This signal has a lower limit of 0 which reequires users of the signal to provide divide by 0 protection if it is used as a denominator in a calculation.  See Vecu port p" FLOAT32_IEEE NO_COMPU_METHOD 0 0 1.175494351e-38 3.402823466e+38 ECU_ADDRESS 0 SYMBOL_LINK "Rte_CurrCmd_MtrVoltQaxFF_Volt_f32" 0 DISPLAY_IDENTIFIER CDDInterface.ReceiverPorts.MtrVoltQaxFF_SPM.Volt_f32 /end MEASUREMENT
/begin MEASUREMENT CDDInterface.MultIgnSrlComSvcDft.Cnt_lgc "MICROSAR RTE" UBYTE RTE_CM_BOOLEAN 0 0 0 255 ECU_ADDRESS 0 SYMBOL_LINK "Rte_CDDInterface_MultIgnSrlComSvcDft_Cnt_lgc" 0 DISPLAY_IDENTIFIER CDDInterface.SenderPorts.MultIgnSrlComSvcDft.Cnt_lgc /end MEASUREMENT
/begin MEASUREMENT CDDInterface.ParkAstSrlComSvcDft.Cnt_lgc "MICROSAR RTE" UBYTE RTE_CM_BOOLEAN 0 0 0 255 ECU_ADDRESS 0 SYMBOL_LINK "Rte_CDDInterface_ParkAstSrlComSvcDft_Cnt_lgc" 0 DISPLAY_IDENTIFIER CDDInterface.SenderPorts.ParkAstSrlComSvcDft.Cnt_lgc /end MEASUREMENT
/begin MEASUREMENT CDDInterface.PhsReasA.Volts_f32 "MICROSAR RTE" FLOAT32_IEEE NO_COMPU_METHOD 0 0 1.175494351e-38 3.402823466e+38 ECU_ADDRESS 0 SYMBOL_LINK "Rte_CDDInterface_PhsReasA_Volts_f32" 0 DISPLAY_IDENTIFIER CDDInterface.SenderPorts.PhsReasA.Volts_f32 /end MEASUREMENT
/begin MEASUREMENT CDDInterface.PhsReasB.Volts_f32 "MICROSAR RTE" FLOAT32_IEEE NO_COMPU_METHOD 0 0 1.175494351e-38 3.402823466e+38 ECU_ADDRESS 0 SYMBOL_LINK "Rte_CDDInterface_PhsReasB_Volts_f32" 0 DISPLAY_IDENTIFIER CDDInterface.SenderPorts.PhsReasB.Volts_f32 /end MEASUREMENT
/begin MEASUREMENT CDDInterface.PhsReasC.Volts_f32 "MICROSAR RTE" FLOAT32_IEEE NO_COMPU_METHOD 0 0 1.175494351e-38 3.402823466e+38 ECU_ADDRESS 0 SYMBOL_LINK "Rte_CDDInterface_PhsReasC_Volts_f32" 0 DISPLAY_IDENTIFIER CDDInterface.SenderPorts.PhsReasC.Volts_f32 /end MEASUREMENT
/begin MEASUREMENT CDDInterface.PullCompSrlComSvcDft.Cnt_lgc "MICROSAR RTE" UBYTE RTE_CM_BOOLEAN 0 0 0 255 ECU_ADDRESS 0 SYMBOL_LINK "Rte_CDDInterface_PullCompSrlComSvcDft_Cnt_lgc" 0 DISPLAY_IDENTIFIER CDDInterface.SenderPorts.PullCompSrlComSvcDft.Cnt_lgc /end MEASUREMENT
/begin MEASUREMENT CDDInterface.QaxIntegralGain_IPM.Uls_f32 "MICROSAR RTE" FLOAT32_IEEE NO_COMPU_METHOD 0 0 1.175494351e-38 3.402823466e+38 ECU_ADDRESS 0 SYMBOL_LINK "Rte_CDDInterface_QaxIntegralGain_IPM_Uls_f32" 0 DISPLAY_IDENTIFIER CDDInterface.ReceiverPorts.QaxIntegralGain_IPM.Uls_f32 /end MEASUREMENT
/begin MEASUREMENT CDDInterface.QaxIntegralGain_SPM.Uls_f32 "MICROSAR RTE" FLOAT32_IEEE NO_COMPU_METHOD 0 0 1.175494351e-38 3.402823466e+38 ECU_ADDRESS 0 SYMBOL_LINK "Rte_CDDInterface_QaxIntegralGain_SPM_Uls_f32" 0 DISPLAY_IDENTIFIER CDDInterface.ReceiverPorts.QaxIntegralGain_SPM.Uls_f32 /end MEASUREMENT
/begin MEASUREMENT CDDInterface.QaxPropotionalGain_IPM.Uls_f32 "MICROSAR RTE" FLOAT32_IEEE NO_COMPU_METHOD 0 0 1.175494351e-38 3.402823466e+38 ECU_ADDRESS 0 SYMBOL_LINK "Rte_CDDInterface_QaxPropotionalGain_IPM_Uls_f32" 0 DISPLAY_IDENTIFIER CDDInterface.ReceiverPorts.QaxPropotionalGain_IPM.Uls_f32 /end MEASUREMENT
/begin MEASUREMENT CDDInterface.QaxPropotionalGain_SPM.Uls_f32 "MICROSAR RTE" FLOAT32_IEEE NO_COMPU_METHOD 0 0 1.175494351e-38 3.402823466e+38 ECU_ADDRESS 0 SYMBOL_LINK "Rte_CDDInterface_QaxPropotionalGain_SPM_Uls_f32" 0 DISPLAY_IDENTIFIER CDDInterface.ReceiverPorts.QaxPropotionalGain_SPM.Uls_f32 /end MEASUREMENT
/begin MEASUREMENT CDDInterface.ReturnSrlComSvcDft.Cnt_lgc "MICROSAR RTE" UBYTE RTE_CM_BOOLEAN 0 0 0 255 ECU_ADDRESS 0 SYMBOL_LINK "Rte_CDDInterface_ReturnSrlComSvcDft_Cnt_lgc" 0 DISPLAY_IDENTIFIER CDDInterface.SenderPorts.ReturnSrlComSvcDft.Cnt_lgc /end MEASUREMENT
/begin MEASUREMENT CDDInterface.RxMsgsSrlComSvcDft.Cnt_lgc "MICROSAR RTE" UBYTE RTE_CM_BOOLEAN 0 0 0 255 ECU_ADDRESS 0 SYMBOL_LINK "Rte_CDDInterface_RxMsgsSrlComSvcDft_Cnt_lgc" 0 DISPLAY_IDENTIFIER CDDInterface.SenderPorts.RxMsgsSrlComSvcDft.Cnt_lgc /end MEASUREMENT
/begin MEASUREMENT CDDInterface.Sin1Theta.Volts_f32 "MICROSAR RTE" FLOAT32_IEEE NO_COMPU_METHOD 0 0 1.175494351e-38 3.402823466e+38 ECU_ADDRESS 0 SYMBOL_LINK "Rte_CDDInterface_Sin1Theta_Volts_f32" 0 DISPLAY_IDENTIFIER CDDInterface.SenderPorts.Sin1Theta.Volts_f32 /end MEASUREMENT
/begin MEASUREMENT CDDInterface.SrlComSvcDft.Cnt_b32 "MICROSAR RTE" ULONG NO_COMPU_METHOD 0 0 0 4294967295 ECU_ADDRESS 0 SYMBOL_LINK "Rte_CDDInterface_SrlComSvcDft_Cnt_b32" 0 DISPLAY_IDENTIFIER CDDInterface.SenderPorts.SrlComSvcDft.Cnt_b32 /end MEASUREMENT
/begin GROUP Ap_PAwTO.PAWhlPlsCntRRValid.Cnt_lgc "MICROSAR RTE" /begin SUB_GROUP /end SUB_GROUP /begin FUNCTION_LIST /end FUNCTION_LIST /begin REF_CHARACTERISTIC /end REF_CHARACTERISTIC /begin REF_MEASUREMENT Ap_PAwTO.PAWhlPlsCntRRValid.Cnt_lgc /end REF_MEASUREMENT /end GROUP
/begin GROUP Ap_PAwTO.PrkAssistActive.Cnt_lgc "MICROSAR RTE" /begin SUB_GROUP /end SUB_GROUP /begin FUNCTION_LIST /end FUNCTION_LIST /begin REF_CHARACTERISTIC /end REF_CHARACTERISTIC /begin REF_MEASUREMENT Ap_PAwTO.PrkAssistActive.Cnt_lgc /end REF_MEASUREMENT /end GROUP
/begin GROUP Ap_PAwTO.PrkAssistState.Cnt_u08 "MICROSAR RTE" /begin SUB_GROUP /end SUB_GROUP /begin FUNCTION_LIST /end FUNCTION_LIST /begin REF_CHARACTERISTIC /end REF_CHARACTERISTIC /begin REF_MEASUREMENT Ap_PAwTO.PrkAssistState.Cnt_u08 /end REF_MEASUREMENT /end GROUP
/begin GROUP Ap_PAwTO.PrkAssistSuspend.Cnt_lgc "MICROSAR RTE" /begin SUB_GROUP /end SUB_GROUP /begin FUNCTION_LIST /end FUNCTION_LIST /begin REF_CHARACTERISTIC /end REF_CHARACTERISTIC /begin REF_MEASUREMENT Ap_PAwTO.PrkAssistSuspend.Cnt_lgc /end REF_MEASUREMENT /end GROUP
/begin GROUP Ap_PAwTO.PrkAsstFuncPresent.Cnt_lgc "MICROSAR RTE" /begin SUB_GROUP /end SUB_GROUP /begin FUNCTION_LIST /end FUNCTION_LIST /begin REF_CHARACTERISTIC /end REF_CHARACTERISTIC /begin REF_MEASUREMENT Ap_PAwTO.PrkAsstFuncPresent.Cnt_lgc /end REF_MEASUREMENT /end GROUP
/begin GROUP Ap_PAwTO.PrkAsstSlewComplete.Cnt_lgc "MICROSAR RTE" /begin SUB_GROUP /end SUB_GROUP /begin FUNCTION_LIST /end FUNCTION_LIST /begin REF_CHARACTERISTIC /end REF_CHARACTERISTIC /begin REF_MEASUREMENT Ap_PAwTO.PrkAsstSlewComplete.Cnt_lgc /end REF_MEASUREMENT /end GROUP
/begin GROUP Ap_PAwTO.ReceiverPorts "MICROSAR RTE"
 /begin SUB_GROUP Ap_PAwTO.DiagStsNonRecRmpToZeroFltPres.Cnt_lgc Ap_PAwTO.DiagStsRecRmpToZeroFltPres.Cnt_lgc Ap_PAwTO.HwTorque.HwNm_f32 Ap_PAwTO.IWSSCalcVspd.Kph_f32 Ap_PAwTO.LimitPercentFiltered.Uls_f32 Ap_PAwTO.PAEnableRqst.Cnt_lgc Ap_PAwTO.PAErrInterfaceActive.Cnt_lgc Ap_PAwTO.PAExtSystemFltActive.Cnt_lgc Ap_PAwTO.PAIntSystemFltActive.Cnt_lgc Ap_PAwTO.PAManoeuvrePhase.Cnt_u08 Ap_PAwTO.PATrqOvCmdRqst.HwNm_f32 Ap_PAwTO.PAWheelCriteriaMet.Cnt_lgc Ap_PAwTO.PAWhlDirRLStat.Cnt_u08 Ap_PAwTO.PAWhlDirRRStat.Cnt_u08 Ap_PAwTO.PAWhlPlsCntRLValid.Cnt_lgc Ap_PAwTO.PAWhlPlsCntRRValid.Cnt_lgc Ap_PAwTO.PrkAsstFuncPresent.Cnt_lgc Ap_PAwTO.PrkAsstSlewComplete.Cnt_lgc Ap_PAwTO.TOEOLDisable.Cnt_lgc Ap_PAwTO.TrqOvReverseGearEngage.Cnt_lgc Ap_PAwTO.VehicleSpeed.Kph_f32 /end SUB_GROUP
 /begin FUNCTION_LIST /end FUNCTION_LIST
 /begin REF_CHARACTERISTIC /end REF_CHARACTERISTIC
 /begin REF_MEASUREMENT /end REF_MEASUREMENT
/end GROUP
/begin GROUP Ap_PAwTO.SenderPorts "MICROSAR RTE"
 /begin SUB_GROUP Ap_PAwTO.HandsOnDetect.Cnt_lgc Ap_PAwTO.PABoostCurveSwitch.Cnt_lgc Ap_PAwTO.PrkAssistActive.Cnt_lgc Ap_PAwTO.PrkAssistState.Cnt_u08 Ap_PAwTO.PrkAssistSuspend.Cnt_lgc /end SUB_GROUP
 /begin FUNCTION_LIST /end FUNCTION_LIST
 /begin REF_CHARACTERISTIC /end REF_CHARACTERISTIC
 /begin REF_MEASUREMENT /end REF_MEASUREMENT
/end GROUP
/begin GROUP Ap_PAwTO.SystemState.Mode "MICROSAR RTE" /begin SUB_GROUP /end SUB_GROUP /begin FUNCTION_LIST /end FUNCTION_LIST /begin REF_CHARACTERISTIC /end REF_CHARACTERISTIC /begin REF_MEASUREMENT Ap_PAwTO.SystemState.Mode /end REF_MEASUREMENT /end GROUP
/begin GROUP Ap_PAwTO.TOEOLDisable.Cnt_lgc "MICROSAR RTE" /begin SUB_GROUP /end SUB_GROUP /begin FUNCTION_LIST /end FUNCTION_LIST /begin REF_CHARACTERISTIC /end REF_CHARACTERISTIC /begin REF_MEASUREMENT Ap_PAwTO.TOEOLDisable.Cnt_lgc /end REF_MEASUREMENT /end GROUP
/begin GROUP Ap_PAwTO.TrqOvReverseGearEngage.Cnt_lgc "MICROSAR RTE" /begin SUB_GROUP /end SUB_GROUP /begin FUNCTION_LIST /end FUNCTION_LIST /begin REF_CHARACTERISTIC /end REF_CHARACTERISTIC /begin REF_MEASUREMENT Ap_PAwTO.TrqOvReverseGearEngage.Cnt_lgc /end REF_MEASUREMENT /end GROUP
/begin GROUP Ap_PAwTO.VehicleSpeed.Kph_f32 "MICROSAR RTE" /begin SUB_GROUP /end SUB_GROUP /begin FUNCTION_LIST /end FUNCTION_LIST /begin REF_CHARACTERISTIC /end REF_CHARACTERISTIC /begin REF_MEASUREMENT Ap_PAwTO.VehicleSpeed.Kph_f32 /end REF_MEASUREMENT /end GROUP
/begin GROUP Ap_PICurrCntrl "MICROSAR RTE"
 /begin SUB_GROUP Ap_PICurrCntrl.ModeRequirePorts Ap_PICurrCntrl.ReceiverPorts Ap_PICurrCntrl.SenderPorts /end SUB_GROUP
 /begin FUNCTION_LIST /end FUNCTION_LIST
 /begin REF_CHARACTERISTIC /end REF_CHARACTERISTIC
 /begin REF_MEASUREMENT /end REF_MEASUREMENT
/end GROUP
/begin GROUP Ap_PICurrCntrl.CorrMtrPosElec.Rev_f32 "MICROSAR RTE" /begin SUB_GROUP /end SUB_GROUP /begin FUNCTION_LIST /end FUNCTION_LIST /begin REF_CHARACTERISTIC /end REF_CHARACTERISTIC /begin REF_MEASUREMENT Ap_PICurrCntrl.CorrMtrPosElec.Rev_f32 /end REF_MEASUREMENT /end GROUP
/begin GROUP Ap_PICurrCntrl.DervLambdaAlphaDiag.Volt_f32 "MICROSAR RTE" /begin SUB_GROUP /end SUB_GROUP /begin FUNCTION_LIST /end FUNCTION_LIST /begin REF_CHARACTERISTIC /end REF_CHARACTERISTIC /begin REF_MEASUREMENT Ap_PICurrCntrl.DervLambdaAlphaDiag.Volt_f32 /end REF_MEASUREMENT /end GROUP
/begin GROUP Ap_PICurrCntrl.DervLambdaBetaDiag.Volt_f32 "MICROSAR RTE" /begin SUB_GROUP /end SUB_GROUP /begin FUNCTION_LIST /end FUNCTION_LIST /begin REF_CHARACTERISTIC /end REF_CHARACTERISTIC /begin REF_MEASUREMENT Ap_PICurrCntrl.DervLambdaBetaDiag.Volt_f32 /end REF_MEASUREMENT /end GROUP
/begin GROUP Ap_PICurrCntrl.EstKe.VpRadpS_f32 "MICROSAR RTE" /begin SUB_GROUP /end SUB_GROUP /begin FUNCTION_LIST /end FUNCTION_LIST /begin REF_CHARACTERISTIC /end REF_CHARACTERISTIC /begin REF_MEASUREMENT Ap_PICurrCntrl.EstKe.VpRadpS_f32 /end REF_MEASUREMENT /end GROUP
/begin GROUP Ap_PICurrCntrl.EstR.Ohm_f32 "MICROSAR RTE" /begin SUB_GROUP /end SUB_GROUP /begin FUNCTION_LIST /end FUNCTION_LIST /begin REF_CHARACTERISTIC /end REF_CHARACTERISTIC /begin REF_MEASUREMENT Ap_PICurrCntrl.EstR.Ohm_f32 /end REF_MEASUREMENT /end GROUP
/begin GROUP Ap_PICurrCntrl.MRFMtrVel.MtrRadpS_f32 "MICROSAR RTE" /begin SUB_GROUP /end SUB_GROUP /begin FUNCTION_LIST /end FUNCTION_LIST /begin REF_CHARACTERISTIC /end REF_CHARACTERISTIC /begin REF_MEASUREMENT Ap_PICurrCntrl.MRFMtrVel.MtrRadpS_f32 /end REF_MEASUREMENT /end GROUP
/begin GROUP Ap_PICurrCntrl.ModeRequirePorts "MICROSAR RTE" /begin SUB_GROUP Ap_PICurrCntrl.SystemState.Mode /end SUB_GROUP /begin FUNCTION_LIST /end FUNCTION_LIST /begin REF_CHARACTERISTIC /end REF_CHARACTERISTIC /begin REF_MEASUREMENT /end REF_MEASUREMENT /end GROUP
/begin GROUP Ap_PICurrCntrl.MtrCurrDaxRef.Amp_f32 "MICROSAR RTE" /begin SUB_GROUP /end SUB_GROUP /begin FUNCTION_LIST /end FUNCTION_LIST /begin REF_CHARACTERISTIC /end REF_CHARACTERISTIC /begin REF_MEASUREMENT Ap_PICurrCntrl.MtrCurrDaxRef.Amp_f32 /end REF_MEASUREMENT /end GROUP
/begin GROUP Ap_PICurrCntrl.ReceiverPorts "MICROSAR RTE"
 /begin SUB_GROUP Ap_PICurrCntrl.CorrMtrPosElec.Rev_f32 Ap_PICurrCntrl.EstKe.VpRadpS_f32 Ap_PICurrCntrl.EstR.Ohm_f32 Ap_PICurrCntrl.MRFMtrVel.MtrRadpS_f32 Ap_PICurrCntrl.MtrCurrDaxRef.Amp_f32 /end SUB_GROUP
 /begin FUNCTION_LIST /end FUNCTION_LIST
 /begin REF_CHARACTERISTIC /end REF_CHARACTERISTIC
 /begin REF_MEASUREMENT /end REF_MEASUREMENT
/end GROUP
/begin GROUP Ap_PICurrCntrl.SenderPorts "MICROSAR RTE"
 /begin SUB_GROUP Ap_PICurrCntrl.DervLambdaAlphaDiag.Volt_f32 Ap_PICurrCntrl.DervLambdaBetaDiag.Volt_f32 /end SUB_GROUP
 /begin FUNCTION_LIST /end FUNCTION_LIST
 /begin REF_CHARACTERISTIC /end REF_CHARACTERISTIC
 /begin REF_MEASUREMENT /end REF_MEASUREMENT
/end GROUP
/begin GROUP Ap_PICurrCntrl.SystemState.Mode "MICROSAR RTE" /begin SUB_GROUP /end SUB_GROUP /begin FUNCTION_LIST /end FUNCTION_LIST /begin REF_CHARACTERISTIC /end REF_CHARACTERISTIC /begin REF_MEASUREMENT Ap_PICurrCntrl.SystemState.Mode /end REF_MEASUREMENT /end GROUP
/begin GROUP Ap_PwrLmtFuncCr "MICROSAR RTE"
 /begin SUB_GROUP Ap_PwrLmtFuncCr.ModeRequirePorts Ap_PwrLmtFuncCr.ReceiverPorts Ap_PwrLmtFuncCr.SenderPorts /end SUB_GROUP
 /begin FUNCTION_LIST /end FUNCTION_LIST
 /begin REF_CHARACTERISTIC /end REF_CHARACTERISTIC
 /begin REF_MEASUREMENT /end REF_MEASUREMENT
/end GROUP
/begin GROUP Ap_PwrLmtFuncCr.CntDisMtrTrqCmdMRF.MtrNm_f32 "MICROSAR RTE" /begin SUB_GROUP /end SUB_GROUP /begin FUNCTION_LIST /end FUNCTION_LIST /begin REF_CHARACTERISTIC /end REF_CHARACTERISTIC /begin REF_MEASUREMENT Ap_PwrLmtFuncCr.CntDisMtrTrqCmdMRF.MtrNm_f32 /end REF_MEASUREMENT /end GROUP
/begin GROUP Ap_PwrLmtFuncCr.EstKe.VpRadpS_f32 "MICROSAR RTE" /begin SUB_GROUP /end SUB_GROUP /begin FUNCTION_LIST /end FUNCTION_LIST /begin REF_CHARACTERISTIC /end REF_CHARACTERISTIC /begin REF_MEASUREMENT Ap_PwrLmtFuncCr.EstKe.VpRadpS_f32 /end REF_MEASUREMENT /end GROUP
/begin GROUP Ap_PwrLmtFuncCr.FltTrqLmt.Uls_f32 "MICROSAR RTE" /begin SUB_GROUP /end SUB_GROUP /begin FUNCTION_LIST /end FUNCTION_LIST /begin REF_CHARACTERISTIC /end REF_CHARACTERISTIC /begin REF_MEASUREMENT Ap_PwrLmtFuncCr.FltTrqLmt.Uls_f32 /end REF_MEASUREMENT /end GROUP
/begin GROUP Ap_PwrLmtFuncCr.MRFMtrTrqCmd.MtrNm_f32 "MICROSAR RTE" /begin SUB_GROUP /end SUB_GROUP /begin FUNCTION_LIST /end FUNCTION_LIST /begin REF_CHARACTERISTIC /end REF_CHARACTERISTIC /begin REF_MEASUREMENT Ap_PwrLmtFuncCr.MRFMtrTrqCmd.MtrNm_f32 /end REF_MEASUREMENT /end GROUP
/begin GROUP Ap_PwrLmtFuncCr.ModeRequirePorts "MICROSAR RTE" /begin SUB_GROUP Ap_PwrLmtFuncCr.SystemState.Mode /end SUB_GROUP /begin FUNCTION_LIST /end FUNCTION_LIST /begin REF_CHARACTERISTIC /end REF_CHARACTERISTIC /begin REF_MEASUREMENT /end REF_MEASUREMENT /end GROUP
/begin GROUP Ap_PwrLmtFuncCr.MotorVelMRF.MtrRadpS_f32 "MICROSAR RTE" /begin SUB_GROUP /end SUB_GROUP /begin FUNCTION_LIST /end FUNCTION_LIST /begin REF_CHARACTERISTIC /end REF_CHARACTERISTIC /begin REF_MEASUREMENT Ap_PwrLmtFuncCr.MotorVelMRF.MtrRadpS_f32 /end REF_MEASUREMENT /end GROUP
/begin GROUP Ap_PwrLmtFuncCr.PosServEnable.Cnt_lgc "MICROSAR RTE" /begin SUB_GROUP /end SUB_GROUP /begin FUNCTION_LIST /end FUNCTION_LIST /begin REF_CHARACTERISTIC /end REF_CHARACTERISTIC /begin REF_MEASUREMENT Ap_PwrLmtFuncCr.PosServEnable.Cnt_lgc /end REF_MEASUREMENT /end GROUP
/begin GROUP Ap_PwrLmtFuncCr.ReceiverPorts "MICROSAR RTE"
 /begin SUB_GROUP Ap_PwrLmtFuncCr.CntDisMtrTrqCmdMRF.MtrNm_f32 Ap_PwrLmtFuncCr.EstKe.VpRadpS_f32 Ap_PwrLmtFuncCr.MotorVelMRF.MtrRadpS_f32 Ap_PwrLmtFuncCr.PosServEnable.Cnt_lgc Ap_PwrLmtFuncCr.Vecu.Volt_f32 /end SUB_GROUP
 /begin FUNCTION_LIST /end FUNCTION_LIST
 /begin REF_CHARACTERISTIC /end REF_CHARACTERISTIC
 /begin REF_MEASUREMENT /end REF_MEASUREMENT
/end GROUP
/begin GROUP Ap_PwrLmtFuncCr.SenderPorts "MICROSAR RTE"
 /begin SUB_GROUP Ap_PwrLmtFuncCr.FltTrqLmt.Uls_f32 Ap_PwrLmtFuncCr.MRFMtrTrqCmd.MtrNm_f32 Ap_PwrLmtFuncCr.ThresholdExceeded.Cnt_lgc /end SUB_GROUP
 /begin FUNCTION_LIST /end FUNCTION_LIST
 /begin REF_CHARACTERISTIC /end REF_CHARACTERISTIC
 /begin REF_MEASUREMENT /end REF_MEASUREMENT
/end GROUP
/begin GROUP Ap_PwrLmtFuncCr.SystemState.Mode "MICROSAR RTE" /begin SUB_GROUP /end SUB_GROUP /begin FUNCTION_LIST /end FUNCTION_LIST /begin REF_CHARACTERISTIC /end REF_CHARACTERISTIC /begin REF_MEASUREMENT Ap_PwrLmtFuncCr.SystemState.Mode /end REF_MEASUREMENT /end GROUP
/begin GROUP Ap_PwrLmtFuncCr.ThresholdExceeded.Cnt_lgc "MICROSAR RTE" /begin SUB_GROUP /end SUB_GROUP /begin FUNCTION_LIST /end FUNCTION_LIST /begin REF_CHARACTERISTIC /end REF_CHARACTERISTIC /begin REF_MEASUREMENT Ap_PwrLmtFuncCr.ThresholdExceeded.Cnt_lgc /end REF_MEASUREMENT /end GROUP
/begin GROUP Ap_PwrLmtFuncCr.Vecu.Volt_f32 "MICROSAR RTE" /begin SUB_GROUP /end SUB_GROUP /begin FUNCTION_LIST /end FUNCTION_LIST /begin REF_CHARACTERISTIC /end REF_CHARACTERISTIC /begin REF_MEASUREMENT Ap_PwrLmtFuncCr.Vecu.Volt_f32 /end REF_MEASUREMENT /end GROUP
/begin GROUP Ap_ReturnFirewall "MICROSAR RTE"
 /begin SUB_GROUP Ap_ReturnFirewall.ReceiverPorts Ap_ReturnFirewall.SenderPorts /end SUB_GROUP
 /begin FUNCTION_LIST /end FUNCTION_LIST
 /begin REF_CHARACTERISTIC /end REF_CHARACTERISTIC
 /begin REF_MEASUREMENT /end REF_MEASUREMENT
/end GROUP
/begin GROUP Ap_ReturnFirewall.Defeat_Return_Svc.Cnt_lgc "MICROSAR RTE" /begin SUB_GROUP /end SUB_GROUP /begin FUNCTION_LIST /end FUNCTION_LIST /begin REF_CHARACTERISTIC /end REF_CHARACTERISTIC /begin REF_MEASUREMENT Ap_ReturnFirewall.Defeat_Return_Svc.Cnt_lgc /end REF_MEASUREMENT /end GROUP
/begin GROUP Ap_ReturnFirewall.HandwheelPosition.HwDeg_f32 "MICROSAR RTE" /begin SUB_GROUP /end SUB_GROUP /begin FUNCTION_LIST /end FUNCTION_LIST /begin REF_CHARACTERISTIC /end REF_CHARACTERISTIC /begin REF_MEASUREMENT Ap_ReturnFirewall.HandwheelPosition.HwDeg_f32 /end REF_MEASUREMENT /end GROUP
/begin GROUP Ap_ReturnFirewall.LimitedReturn.MtrNm_f32 "MICROSAR RTE" /begin SUB_GROUP /end SUB_GROUP /begin FUNCTION_LIST /end FUNCTION_LIST /begin REF_CHARACTERISTIC /end REF_CHARACTERISTIC /begin REF_MEASUREMENT Ap_ReturnFirewall.LimitedReturn.MtrNm_f32 /end REF_MEASUREMENT /end GROUP
/begin GROUP Ap_ReturnFirewall.MEC_Counter.Cnt_enum "MICROSAR RTE" /begin SUB_GROUP /end SUB_GROUP /begin FUNCTION_LIST /end FUNCTION_LIST /begin REF_CHARACTERISTIC /end REF_CHARACTERISTIC /begin REF_MEASUREMENT Ap_ReturnFirewall.MEC_Counter.Cnt_enum /end REF_MEASUREMENT /end GROUP
/begin GROUP Ap_ReturnFirewall.ReceiverPorts "MICROSAR RTE"
 /begin SUB_GROUP Ap_ReturnFirewall.Defeat_Return_Svc.Cnt_lgc Ap_ReturnFirewall.HandwheelPosition.HwDeg_f32 Ap_ReturnFirewall.MEC_Counter.Cnt_enum Ap_ReturnFirewall.ReturnCmd.MtrNm_f32 Ap_ReturnFirewall.VehicleSpeed.Kph_f32 /end SUB_GROUP
 /begin FUNCTION_LIST /end FUNCTION_LIST
 /begin REF_CHARACTERISTIC /end REF_CHARACTERISTIC
 /begin REF_MEASUREMENT /end REF_MEASUREMENT
/end GROUP
/begin GROUP Ap_ReturnFirewall.ReturnCmd.MtrNm_f32 "MICROSAR RTE" /begin SUB_GROUP /end SUB_GROUP /begin FUNCTION_LIST /end FUNCTION_LIST /begin REF_CHARACTERISTIC /end REF_CHARACTERISTIC /begin REF_MEASUREMENT Ap_ReturnFirewall.ReturnCmd.MtrNm_f32 /end REF_MEASUREMENT /end GROUP
/begin GROUP Ap_ReturnFirewall.SenderPorts "MICROSAR RTE" /begin SUB_GROUP Ap_ReturnFirewall.LimitedReturn.MtrNm_f32 /end SUB_GROUP /begin FUNCTION_LIST /end FUNCTION_LIST /begin REF_CHARACTERISTIC /end REF_CHARACTERISTIC /begin REF_MEASUREMENT /end REF_MEASUREMENT /end GROUP
/begin GROUP Ap_ReturnFirewall.VehicleSpeed.Kph_f32 "MICROSAR RTE" /begin SUB_GROUP /end SUB_GROUP /begin FUNCTION_LIST /end FUNCTION_LIST /begin REF_CHARACTERISTIC /end REF_CHARACTERISTIC /begin REF_MEASUREMENT Ap_ReturnFirewall.VehicleSpeed.Kph_f32 /end REF_MEASUREMENT /end GROUP
/begin GROUP Ap_SignlCondn "MICROSAR RTE" /begin SUB_GROUP Ap_SignlCondn.ReceiverPorts Ap_SignlCondn.SenderPorts /end SUB_GROUP /begin FUNCTION_LIST /end FUNCTION_LIST /begin REF_CHARACTERISTIC /end REF_CHARACTERISTIC /begin REF_MEASUREMENT /end REF_MEASUREMENT /end GROUP
/begin GROUP Ap_SignlCondn.ReceiverPorts "MICROSAR RTE"
 /begin SUB_GROUP Ap_SignlCondn.SrlComVehSpeed.Kph_f32 Ap_SignlCondn.SrlCom_VehicleLonAccel.KphpS_f32 /end SUB_GROUP
 /begin FUNCTION_LIST /end FUNCTION_LIST
 /begin REF_CHARACTERISTIC /end REF_CHARACTERISTIC
 /begin REF_MEASUREMENT /end REF_MEASUREMENT
/end GROUP
/begin GROUP Ap_SignlCondn.SenderPorts "MICROSAR RTE"
 /begin SUB_GROUP Ap_SignlCondn.VehicleSpeed.Kph_f32 Ap_SignlCondn.Vehicle_LonAccel.KphpS_f32 /end SUB_GROUP
 /begin FUNCTION_LIST /end FUNCTION_LIST
 /begin REF_CHARACTERISTIC /end REF_CHARACTERISTIC
 /begin REF_MEASUREMENT /end REF_MEASUREMENT
/end GROUP
/begin GROUP Ap_SignlCondn.SrlComVehSpeed.Kph_f32 "MICROSAR RTE" /begin SUB_GROUP /end SUB_GROUP /begin FUNCTION_LIST /end FUNCTION_LIST /begin REF_CHARACTERISTIC /end REF_CHARACTERISTIC /begin REF_MEASUREMENT Ap_SignlCondn.SrlComVehSpeed.Kph_f32 /end REF_MEASUREMENT /end GROUP
/begin GROUP Ap_SignlCondn.SrlCom_VehicleLonAccel.KphpS_f32 "MICROSAR RTE" /begin SUB_GROUP /end SUB_GROUP /begin FUNCTION_LIST /end FUNCTION_LIST /begin REF_CHARACTERISTIC /end REF_CHARACTERISTIC /begin REF_MEASUREMENT Ap_SignlCondn.SrlCom_VehicleLonAccel.KphpS_f32 /end REF_MEASUREMENT /end GROUP
/begin GROUP Ap_SignlCondn.VehicleSpeed.Kph_f32 "MICROSAR RTE" /begin SUB_GROUP /end SUB_GROUP /begin FUNCTION_LIST /end FUNCTION_LIST /begin REF_CHARACTERISTIC /end REF_CHARACTERISTIC /begin REF_MEASUREMENT Ap_SignlCondn.VehicleSpeed.Kph_f32 /end REF_MEASUREMENT /end GROUP
/begin GROUP Ap_SignlCondn.Vehicle_LonAccel.KphpS_f32 "MICROSAR RTE" /begin SUB_GROUP /end SUB_GROUP /begin FUNCTION_LIST /end FUNCTION_LIST /begin REF_CHARACTERISTIC /end REF_CHARACTERISTIC /begin REF_MEASUREMENT Ap_SignlCondn.Vehicle_LonAccel.KphpS_f32 /end REF_MEASUREMENT /end GROUP
/begin GROUP Ap_StaMd8 "MICROSAR RTE" /begin SUB_GROUP Ap_StaMd8.ModeProvidePorts /end SUB_GROUP /begin FUNCTION_LIST /end FUNCTION_LIST /begin REF_CHARACTERISTIC /end REF_CHARACTERISTIC /begin REF_MEASUREMENT /end REF_MEASUREMENT /end GROUP
/begin GROUP Ap_StaMd8.ModeProvidePorts "MICROSAR RTE" /begin SUB_GROUP Ap_StaMd8.SystemState8.Mode /end SUB_GROUP /begin FUNCTION_LIST /end FUNCTION_LIST /begin REF_CHARACTERISTIC /end REF_CHARACTERISTIC /begin REF_MEASUREMENT /end REF_MEASUREMENT /end GROUP
/begin GROUP Ap_StaMd8.SystemState8.Mode "MICROSAR RTE" /begin SUB_GROUP /end SUB_GROUP /begin FUNCTION_LIST /end FUNCTION_LIST /begin REF_CHARACTERISTIC /end REF_CHARACTERISTIC /begin REF_MEASUREMENT Ap_StaMd8.SystemState8.Mode /end REF_MEASUREMENT /end GROUP
/begin GROUP Ap_StaMd9 "MICROSAR RTE" /begin SUB_GROUP Ap_StaMd9.ModeProvidePorts /end SUB_GROUP /begin FUNCTION_LIST /end FUNCTION_LIST /begin REF_CHARACTERISTIC /end REF_CHARACTERISTIC /begin REF_MEASUREMENT /end REF_MEASUREMENT /end GROUP
/begin GROUP Ap_StaMd9.ModeProvidePorts "MICROSAR RTE" /begin SUB_GROUP Ap_StaMd9.SystemState9.Mode /end SUB_GROUP /begin FUNCTION_LIST /end FUNCTION_LIST /begin REF_CHARACTERISTIC /end REF_CHARACTERISTIC /begin REF_MEASUREMENT /end REF_MEASUREMENT /end GROUP
/begin GROUP Ap_StaMd9.SystemState9.Mode "MICROSAR RTE" /begin SUB_GROUP /end SUB_GROUP /begin FUNCTION_LIST /end FUNCTION_LIST /begin REF_CHARACTERISTIC /end REF_CHARACTERISTIC /begin REF_MEASUREMENT Ap_StaMd9.SystemState9.Mode /end REF_MEASUREMENT /end GROUP
/begin GROUP Ap_StabilityComp2 "MICROSAR RTE"
 /begin SUB_GROUP Ap_StabilityComp2.ReceiverPorts Ap_StabilityComp2.SenderPorts /end SUB_GROUP
 /begin FUNCTION_LIST /end FUNCTION_LIST
 /begin REF_CHARACTERISTIC /end REF_CHARACTERISTIC
 /begin REF_MEASUREMENT /end REF_MEASUREMENT
/end GROUP
/begin GROUP Ap_StabilityComp2.AssistDDFactor.Uls_f32 "MICROSAR RTE" /begin SUB_GROUP /end SUB_GROUP /begin FUNCTION_LIST /end FUNCTION_LIST /begin REF_CHARACTERISTIC /end REF_CHARACTERISTIC /begin REF_MEASUREMENT Ap_StabilityComp2.AssistDDFactor.Uls_f32 /end REF_MEASUREMENT /end GROUP
/begin GROUP Ap_StabilityComp2.AsstFWActive.Uls_f32 "MICROSAR RTE" /begin SUB_GROUP /end SUB_GROUP /begin FUNCTION_LIST /end FUNCTION_LIST /begin REF_CHARACTERISTIC /end REF_CHARACTERISTIC /begin REF_MEASUREMENT Ap_StabilityComp2.AsstFWActive.Uls_f32 /end REF_MEASUREMENT /end GROUP
/begin GROUP Ap_StabilityComp2.CombinedAssist.MtrNm_f32 "MICROSAR RTE" /begin SUB_GROUP /end SUB_GROUP /begin FUNCTION_LIST /end FUNCTION_LIST /begin REF_CHARACTERISTIC /end REF_CHARACTERISTIC /begin REF_MEASUREMENT Ap_StabilityComp2.CombinedAssist.MtrNm_f32 /end REF_MEASUREMENT /end GROUP
/begin GROUP Ap_StabilityComp2.HwTorque.HwNm_f32 "MICROSAR RTE" /begin SUB_GROUP /end SUB_GROUP /begin FUNCTION_LIST /end FUNCTION_LIST /begin REF_CHARACTERISTIC /end REF_CHARACTERISTIC /begin REF_MEASUREMENT Ap_StabilityComp2.HwTorque.HwNm_f32 /end REF_MEASUREMENT /end GROUP
/begin GROUP Ap_StabilityComp2.ReceiverPorts "MICROSAR RTE"
 /begin SUB_GROUP Ap_StabilityComp2.AssistDDFactor.Uls_f32 Ap_StabilityComp2.AsstFWActive.Uls_f32 Ap_StabilityComp2.CombinedAssist.MtrNm_f32 Ap_StabilityComp2.HwTorque.HwNm_f32 Ap_StabilityComp2.VehicleSpeed.Kph_f32 /end SUB_GROUP
 /begin FUNCTION_LIST /end FUNCTION_LIST
 /begin REF_CHARACTERISTIC /end REF_CHARACTERISTIC
 /begin REF_MEASUREMENT /end REF_MEASUREMENT
/end GROUP
/begin GROUP Ap_StabilityComp2.SenderPorts "MICROSAR RTE" /begin SUB_GROUP Ap_StabilityComp2.SysAssistCmd.MtrNm_f32 /end SUB_GROUP /begin FUNCTION_LIST /end FUNCTION_LIST /begin REF_CHARACTERISTIC /end REF_CHARACTERISTIC /begin REF_MEASUREMENT /end REF_MEASUREMENT /end GROUP
/begin GROUP Ap_StabilityComp2.SysAssistCmd.MtrNm_f32 "MICROSAR RTE" /begin SUB_GROUP /end SUB_GROUP /begin FUNCTION_LIST /end FUNCTION_LIST /begin REF_CHARACTERISTIC /end REF_CHARACTERISTIC /begin REF_MEASUREMENT Ap_StabilityComp2.SysAssistCmd.MtrNm_f32 /end REF_MEASUREMENT /end GROUP
/begin GROUP Ap_StabilityComp2.VehicleSpeed.Kph_f32 "MICROSAR RTE" /begin SUB_GROUP /end SUB_GROUP /begin FUNCTION_LIST /end FUNCTION_LIST /begin REF_CHARACTERISTIC /end REF_CHARACTERISTIC /begin REF_MEASUREMENT Ap_StabilityComp2.VehicleSpeed.Kph_f32 /end REF_MEASUREMENT /end GROUP
/begin GROUP Ap_StbCTO "MICROSAR RTE"
 /begin SUB_GROUP Ap_StbCTO.ModeRequirePorts Ap_StbCTO.ReceiverPorts Ap_StbCTO.SenderPorts /end SUB_GROUP
 /begin FUNCTION_LIST /end FUNCTION_LIST
 /begin REF_CHARACTERISTIC /end REF_CHARACTERISTIC
 /begin REF_MEASUREMENT /end REF_MEASUREMENT
/end GROUP
/begin GROUP Ap_StbCTO.DSTActive.Cnt_lgc "MICROSAR RTE" /begin SUB_GROUP /end SUB_GROUP /begin FUNCTION_LIST /end FUNCTION_LIST /begin REF_CHARACTERISTIC /end REF_CHARACTERISTIC /begin REF_MEASUREMENT Ap_StbCTO.DSTActive.Cnt_lgc /end REF_MEASUREMENT /end GROUP
/begin GROUP Ap_StbCTO.DSTEnableRqst.Cnt_lgc "MICROSAR RTE" /begin SUB_GROUP /end SUB_GROUP /begin FUNCTION_LIST /end FUNCTION_LIST /begin REF_CHARACTERISTIC /end REF_CHARACTERISTIC /begin REF_MEASUREMENT Ap_StbCTO.DSTEnableRqst.Cnt_lgc /end REF_MEASUREMENT /end GROUP
/begin GROUP Ap_StbCTO.DSTErrCntrRecvLevel.Cnt_u08 "MICROSAR RTE" /begin SUB_GROUP /end SUB_GROUP /begin FUNCTION_LIST /end FUNCTION_LIST /begin REF_CHARACTERISTIC /end REF_CHARACTERISTIC /begin REF_MEASUREMENT Ap_StbCTO.DSTErrCntrRecvLevel.Cnt_u08 /end REF_MEASUREMENT /end GROUP
/begin GROUP Ap_StbCTO.DSTExtSystemFltActive.Cnt_lgc "MICROSAR RTE" /begin SUB_GROUP /end SUB_GROUP /begin FUNCTION_LIST /end FUNCTION_LIST /begin REF_CHARACTERISTIC /end REF_CHARACTERISTIC /begin REF_MEASUREMENT Ap_StbCTO.DSTExtSystemFltActive.Cnt_lgc /end REF_MEASUREMENT /end GROUP
/begin GROUP Ap_StbCTO.DSTFuncPresent.Cnt_lgc "MICROSAR RTE" /begin SUB_GROUP /end SUB_GROUP /begin FUNCTION_LIST /end FUNCTION_LIST /begin REF_CHARACTERISTIC /end REF_CHARACTERISTIC /begin REF_MEASUREMENT Ap_StbCTO.DSTFuncPresent.Cnt_lgc /end REF_MEASUREMENT /end GROUP
/begin GROUP Ap_StbCTO.DSTRevGearValid.Cnt_lgc "MICROSAR RTE" /begin SUB_GROUP /end SUB_GROUP /begin FUNCTION_LIST /end FUNCTION_LIST /begin REF_CHARACTERISTIC /end REF_CHARACTERISTIC /begin REF_MEASUREMENT Ap_StbCTO.DSTRevGearValid.Cnt_lgc /end REF_MEASUREMENT /end GROUP
/begin GROUP Ap_StbCTO.DSTSlewComplete.Cnt_lgc "MICROSAR RTE" /begin SUB_GROUP /end SUB_GROUP /begin FUNCTION_LIST /end FUNCTION_LIST /begin REF_CHARACTERISTIC /end REF_CHARACTERISTIC /begin REF_MEASUREMENT Ap_StbCTO.DSTSlewComplete.Cnt_lgc /end REF_MEASUREMENT /end GROUP
/begin GROUP Ap_StbCTO.DSTSlewStart.Cnt_lgc "MICROSAR RTE" /begin SUB_GROUP /end SUB_GROUP /begin FUNCTION_LIST /end FUNCTION_LIST /begin REF_CHARACTERISTIC /end REF_CHARACTERISTIC /begin REF_MEASUREMENT Ap_StbCTO.DSTSlewStart.Cnt_lgc /end REF_MEASUREMENT /end GROUP
/begin GROUP Ap_StbCTO.DSTState.Cnt_u08 "MICROSAR RTE" /begin SUB_GROUP /end SUB_GROUP /begin FUNCTION_LIST /end FUNCTION_LIST /begin REF_CHARACTERISTIC /end REF_CHARACTERISTIC /begin REF_MEASUREMENT Ap_StbCTO.DSTState.Cnt_u08 /end REF_MEASUREMENT /end GROUP
/begin GROUP Ap_StbCTO.DSTTOCState.Uls_enum "MICROSAR RTE" /begin SUB_GROUP /end SUB_GROUP /begin FUNCTION_LIST /end FUNCTION_LIST /begin REF_CHARACTERISTIC /end REF_CHARACTERISTIC /begin REF_MEASUREMENT Ap_StbCTO.DSTTOCState.Uls_enum /end REF_MEASUREMENT /end GROUP
/begin GROUP Ap_StbCTO.DSTTrqOvCmdRqst.HwNm_f32 "MICROSAR RTE" /begin SUB_GROUP /end SUB_GROUP /begin FUNCTION_LIST /end FUNCTION_LIST /begin REF_CHARACTERISTIC /end REF_CHARACTERISTIC /begin REF_MEASUREMENT Ap_StbCTO.DSTTrqOvCmdRqst.HwNm_f32 /end REF_MEASUREMENT /end GROUP
/begin GROUP Ap_StbCTO.DSTTrqOvRqstValid.Cnt_lgc "MICROSAR RTE" /begin SUB_GROUP /end SUB_GROUP /begin FUNCTION_LIST /end FUNCTION_LIST /begin REF_CHARACTERISTIC /end REF_CHARACTERISTIC /begin REF_MEASUREMENT Ap_StbCTO.DSTTrqOvRqstValid.Cnt_lgc /end REF_MEASUREMENT /end GROUP
/begin GROUP Ap_StbCTO.DiagRedAssistLowVoltageActive.Cnt_lgc "MICROSAR RTE" /begin SUB_GROUP /end SUB_GROUP /begin FUNCTION_LIST /end FUNCTION_LIST /begin REF_CHARACTERISTIC /end REF_CHARACTERISTIC /begin REF_MEASUREMENT Ap_StbCTO.DiagRedAssistLowVoltageActive.Cnt_lgc /end REF_MEASUREMENT /end GROUP
/begin GROUP Ap_StbCTO.DiagStsNonRecRmpToZeroFltPres.Cnt_lgc "MICROSAR RTE" /begin SUB_GROUP /end SUB_GROUP /begin FUNCTION_LIST /end FUNCTION_LIST /begin REF_CHARACTERISTIC /end REF_CHARACTERISTIC /begin REF_MEASUREMENT Ap_StbCTO.DiagStsNonRecRmpToZeroFltPres.Cnt_lgc /end REF_MEASUREMENT /end GROUP
/begin GROUP Ap_StbCTO.DiagStsRecRmpToZeroFltPres.Cnt_lgc "MICROSAR RTE" /begin SUB_GROUP /end SUB_GROUP /begin FUNCTION_LIST /end FUNCTION_LIST /begin REF_CHARACTERISTIC /end REF_CHARACTERISTIC /begin REF_MEASUREMENT Ap_StbCTO.DiagStsRecRmpToZeroFltPres.Cnt_lgc /end REF_MEASUREMENT /end GROUP
/begin GROUP Ap_StbCTO.LimitPercentFiltered.Uls_f32 "MICROSAR RTE" /begin SUB_GROUP /end SUB_GROUP /begin FUNCTION_LIST /end FUNCTION_LIST /begin REF_CHARACTERISTIC /end REF_CHARACTERISTIC /begin REF_MEASUREMENT Ap_StbCTO.LimitPercentFiltered.Uls_f32 /end REF_MEASUREMENT /end GROUP
/begin GROUP Ap_StbCTO.ModeRequirePorts "MICROSAR RTE" /begin SUB_GROUP Ap_StbCTO.SystemState.Mode /end SUB_GROUP /begin FUNCTION_LIST /end FUNCTION_LIST /begin REF_CHARACTERISTIC /end REF_CHARACTERISTIC /begin REF_MEASUREMENT /end REF_MEASUREMENT /end GROUP
/begin GROUP Ap_StbCTO.ReceiverPorts "MICROSAR RTE"
 /begin SUB_GROUP Ap_StbCTO.DSTEnableRqst.Cnt_lgc Ap_StbCTO.DSTErrCntrRecvLevel.Cnt_u08 Ap_StbCTO.DSTExtSystemFltActive.Cnt_lgc Ap_StbCTO.DSTFuncPresent.Cnt_lgc Ap_StbCTO.DSTRevGearValid.Cnt_lgc Ap_StbCTO.DSTSlewComplete.Cnt_lgc Ap_StbCTO.DSTTOCState.Uls_enum Ap_StbCTO.DSTTrqOvCmdRqst.HwNm_f32 Ap_StbCTO.DSTTrqOvRqstValid.Cnt_lgc Ap_StbCTO.DiagRedAssistLowVoltageActive.Cnt_lgc Ap_StbCTO.DiagStsNonRecRmpToZeroFltPres.Cnt_lgc Ap_StbCTO.DiagStsRecRmpToZeroFltPres.Cnt_lgc Ap_StbCTO.LimitPercentFiltered.Uls_f32 Ap_StbCTO.TOEOLDisable.Cnt_lgc Ap_StbCTO.TrqOvReverseGearEngage.Cnt_lgc Ap_StbCTO.VehicleSpeed.Kph_f32 Ap_StbCTO.VehicleSpeedValid.Cnt_lgc /end SUB_GROUP
 /begin FUNCTION_LIST /end FUNCTION_LIST
 /begin REF_CHARACTERISTIC /end REF_CHARACTERISTIC
 /begin REF_MEASUREMENT /end REF_MEASUREMENT
/end GROUP
/begin GROUP Ap_StbCTO.SenderPorts "MICROSAR RTE"
 /begin SUB_GROUP Ap_StbCTO.DSTActive.Cnt_lgc Ap_StbCTO.DSTSlewStart.Cnt_lgc Ap_StbCTO.DSTState.Cnt_u08 /end SUB_GROUP
 /begin FUNCTION_LIST /end FUNCTION_LIST
 /begin REF_CHARACTERISTIC /end REF_CHARACTERISTIC
 /begin REF_MEASUREMENT /end REF_MEASUREMENT
/end GROUP
/begin GROUP Ap_StbCTO.SystemState.Mode "MICROSAR RTE" /begin SUB_GROUP /end SUB_GROUP /begin FUNCTION_LIST /end FUNCTION_LIST /begin REF_CHARACTERISTIC /end REF_CHARACTERISTIC /begin REF_MEASUREMENT Ap_StbCTO.SystemState.Mode /end REF_MEASUREMENT /end GROUP
/begin GROUP Ap_StbCTO.TOEOLDisable.Cnt_lgc "MICROSAR RTE" /begin SUB_GROUP /end SUB_GROUP /begin FUNCTION_LIST /end FUNCTION_LIST /begin REF_CHARACTERISTIC /end REF_CHARACTERISTIC /begin REF_MEASUREMENT Ap_StbCTO.TOEOLDisable.Cnt_lgc /end REF_MEASUREMENT /end GROUP
/begin GROUP Ap_StbCTO.TrqOvReverseGearEngage.Cnt_lgc "MICROSAR RTE" /begin SUB_GROUP /end SUB_GROUP /begin FUNCTION_LIST /end FUNCTION_LIST /begin REF_CHARACTERISTIC /end REF_CHARACTERISTIC /begin REF_MEASUREMENT Ap_StbCTO.TrqOvReverseGearEngage.Cnt_lgc /end REF_MEASUREMENT /end GROUP
/begin GROUP Ap_StbCTO.VehicleSpeed.Kph_f32 "MICROSAR RTE" /begin SUB_GROUP /end SUB_GROUP /begin FUNCTION_LIST /end FUNCTION_LIST /begin REF_CHARACTERISTIC /end REF_CHARACTERISTIC /begin REF_MEASUREMENT Ap_StbCTO.VehicleSpeed.Kph_f32 /end REF_MEASUREMENT /end GROUP
/begin GROUP Ap_StbCTO.VehicleSpeedValid.Cnt_lgc "MICROSAR RTE" /begin SUB_GROUP /end SUB_GROUP /begin FUNCTION_LIST /end FUNCTION_LIST /begin REF_CHARACTERISTIC /end REF_CHARACTERISTIC /begin REF_MEASUREMENT Ap_StbCTO.VehicleSpeedValid.Cnt_lgc /end REF_MEASUREMENT /end GROUP
/begin GROUP Ap_ThrmlDutyCycle "MICROSAR RTE"
 /begin SUB_GROUP Ap_ThrmlDutyCycle.ReceiverPorts Ap_ThrmlDutyCycle.SenderPorts /end SUB_GROUP
 /begin FUNCTION_LIST /end FUNCTION_LIST
 /begin REF_CHARACTERISTIC /end REF_CHARACTERISTIC
 /begin REF_MEASUREMENT /end REF_MEASUREMENT
/end GROUP
/begin GROUP Ap_ThrmlDutyCycle.CuTempEst.DegC_f32 "MICROSAR RTE" /begin SUB_GROUP /end SUB_GROUP /begin FUNCTION_LIST /end FUNCTION_LIST /begin REF_CHARACTERISTIC /end REF_CHARACTERISTIC /begin REF_MEASUREMENT Ap_ThrmlDutyCycle.CuTempEst.DegC_f32 /end REF_MEASUREMENT /end GROUP
/begin GROUP Ap_ThrmlDutyCycle.DefeatDutySvc.Cnt_lgc "MICROSAR RTE" /begin SUB_GROUP /end SUB_GROUP /begin FUNCTION_LIST /end FUNCTION_LIST /begin REF_CHARACTERISTIC /end REF_CHARACTERISTIC /begin REF_MEASUREMENT Ap_ThrmlDutyCycle.DefeatDutySvc.Cnt_lgc /end REF_MEASUREMENT /end GROUP
/begin GROUP Ap_ThrmlDutyCycle.DutyCycleLevel.Uls_f32 "MICROSAR RTE" /begin SUB_GROUP /end SUB_GROUP /begin FUNCTION_LIST /end FUNCTION_LIST /begin REF_CHARACTERISTIC /end REF_CHARACTERISTIC /begin REF_MEASUREMENT Ap_ThrmlDutyCycle.DutyCycleLevel.Uls_f32 /end REF_MEASUREMENT /end GROUP
/begin GROUP Ap_ThrmlDutyCycle.FiltMeasTemp.DegC_f32 "MICROSAR RTE" /begin SUB_GROUP /end SUB_GROUP /begin FUNCTION_LIST /end FUNCTION_LIST /begin REF_CHARACTERISTIC /end REF_CHARACTERISTIC /begin REF_MEASUREMENT Ap_ThrmlDutyCycle.FiltMeasTemp.DegC_f32 /end REF_MEASUREMENT /end GROUP
/begin GROUP Ap_ThrmlDutyCycle.FilteredPkCurr.AmpSq_f32 "MICROSAR RTE" /begin SUB_GROUP /end SUB_GROUP /begin FUNCTION_LIST /end FUNCTION_LIST /begin REF_CHARACTERISTIC /end REF_CHARACTERISTIC /begin REF_MEASUREMENT Ap_ThrmlDutyCycle.FilteredPkCurr.AmpSq_f32 /end REF_MEASUREMENT /end GROUP
/begin GROUP Ap_ThrmlDutyCycle.IgnTimeOff.Cnt_u32 "MICROSAR RTE" /begin SUB_GROUP /end SUB_GROUP /begin FUNCTION_LIST /end FUNCTION_LIST /begin REF_CHARACTERISTIC /end REF_CHARACTERISTIC /begin REF_MEASUREMENT Ap_ThrmlDutyCycle.IgnTimeOff.Cnt_u32 /end REF_MEASUREMENT /end GROUP
/begin GROUP Ap_ThrmlDutyCycle.MagTempEst.DegC_f32 "MICROSAR RTE" /begin SUB_GROUP /end SUB_GROUP /begin FUNCTION_LIST /end FUNCTION_LIST /begin REF_CHARACTERISTIC /end REF_CHARACTERISTIC /begin REF_MEASUREMENT Ap_ThrmlDutyCycle.MagTempEst.DegC_f32 /end REF_MEASUREMENT /end GROUP
/begin GROUP Ap_ThrmlDutyCycle.MotorVelCRF.MtrRadpS_f32 "MICROSAR RTE" /begin SUB_GROUP /end SUB_GROUP /begin FUNCTION_LIST /end FUNCTION_LIST /begin REF_CHARACTERISTIC /end REF_CHARACTERISTIC /begin REF_MEASUREMENT Ap_ThrmlDutyCycle.MotorVelCRF.MtrRadpS_f32 /end REF_MEASUREMENT /end GROUP
/begin GROUP Ap_ThrmlDutyCycle.MtrPkCurr.AmpSq_f32 "MICROSAR RTE" /begin SUB_GROUP /end SUB_GROUP /begin FUNCTION_LIST /end FUNCTION_LIST /begin REF_CHARACTERISTIC /end REF_CHARACTERISTIC /begin REF_MEASUREMENT Ap_ThrmlDutyCycle.MtrPkCurr.AmpSq_f32 /end REF_MEASUREMENT /end GROUP
/begin GROUP Ap_ThrmlDutyCycle.ReceiverPorts "MICROSAR RTE"
 /begin SUB_GROUP Ap_ThrmlDutyCycle.CuTempEst.DegC_f32 Ap_ThrmlDutyCycle.DefeatDutySvc.Cnt_lgc Ap_ThrmlDutyCycle.FiltMeasTemp.DegC_f32 Ap_ThrmlDutyCycle.FilteredPkCurr.AmpSq_f32 Ap_ThrmlDutyCycle.IgnTimeOff.Cnt_u32 Ap_ThrmlDutyCycle.MagTempEst.DegC_f32 Ap_ThrmlDutyCycle.MotorVelCRF.MtrRadpS_f32 Ap_ThrmlDutyCycle.MtrPkCurr.AmpSq_f32 Ap_ThrmlDutyCycle.SiTempEst.DegC_f32 Ap_ThrmlDutyCycle.VehTimeValid.Cnt_lgc /end SUB_GROUP
 /begin FUNCTION_LIST /end FUNCTION_LIST
 /begin REF_CHARACTERISTIC /end REF_CHARACTERISTIC
 /begin REF_MEASUREMENT /end REF_MEASUREMENT
/end GROUP
/begin GROUP Ap_ThrmlDutyCycle.SenderPorts "MICROSAR RTE"
 /begin SUB_GROUP Ap_ThrmlDutyCycle.DutyCycleLevel.Uls_f32 Ap_ThrmlDutyCycle.ThermLimitPerc.Uls_f32 Ap_ThrmlDutyCycle.ThermalLimit.MtrNm_f32 /end SUB_GROUP
 /begin FUNCTION_LIST /end FUNCTION_LIST
 /begin REF_CHARACTERISTIC /end REF_CHARACTERISTIC
 /begin REF_MEASUREMENT /end REF_MEASUREMENT
/end GROUP
/begin GROUP Ap_ThrmlDutyCycle.SiTempEst.DegC_f32 "MICROSAR RTE" /begin SUB_GROUP /end SUB_GROUP /begin FUNCTION_LIST /end FUNCTION_LIST /begin REF_CHARACTERISTIC /end REF_CHARACTERISTIC /begin REF_MEASUREMENT Ap_ThrmlDutyCycle.SiTempEst.DegC_f32 /end REF_MEASUREMENT /end GROUP
/begin GROUP Ap_ThrmlDutyCycle.ThermLimitPerc.Uls_f32 "MICROSAR RTE" /begin SUB_GROUP /end SUB_GROUP /begin FUNCTION_LIST /end FUNCTION_LIST /begin REF_CHARACTERISTIC /end REF_CHARACTERISTIC /begin REF_MEASUREMENT Ap_ThrmlDutyCycle.ThermLimitPerc.Uls_f32 /end REF_MEASUREMENT /end GROUP
/begin GROUP Ap_ThrmlDutyCycle.ThermalLimit.MtrNm_f32 "MICROSAR RTE" /begin SUB_GROUP /end SUB_GROUP /begin FUNCTION_LIST /end FUNCTION_LIST /begin REF_CHARACTERISTIC /end REF_CHARACTERISTIC /begin REF_MEASUREMENT Ap_ThrmlDutyCycle.ThermalLimit.MtrNm_f32 /end REF_MEASUREMENT /end GROUP
/begin GROUP Ap_ThrmlDutyCycle.VehTimeValid.Cnt_lgc "MICROSAR RTE" /begin SUB_GROUP /end SUB_GROUP /begin FUNCTION_LIST /end FUNCTION_LIST /begin REF_CHARACTERISTIC /end REF_CHARACTERISTIC /begin REF_MEASUREMENT Ap_ThrmlDutyCycle.VehTimeValid.Cnt_lgc /end REF_MEASUREMENT /end GROUP
/begin GROUP Ap_TqRsDg "MICROSAR RTE" /begin SUB_GROUP Ap_TqRsDg.ModeRequirePorts Ap_TqRsDg.ReceiverPorts /end SUB_GROUP /begin FUNCTION_LIST /end FUNCTION_LIST /begin REF_CHARACTERISTIC /end REF_CHARACTERISTIC /begin REF_MEASUREMENT /end REF_MEASUREMENT /end GROUP
/begin GROUP Ap_TqRsDg.DervLambdaAlphaDiag.Volt_f32 "MICROSAR RTE" /begin SUB_GROUP /end SUB_GROUP /begin FUNCTION_LIST /end FUNCTION_LIST /begin REF_CHARACTERISTIC /end REF_CHARACTERISTIC /begin REF_MEASUREMENT Ap_TqRsDg.DervLambdaAlphaDiag.Volt_f32 /end REF_MEASUREMENT /end GROUP
/begin GROUP Ap_TqRsDg.DervLambdaBetaDiag.Volt_f32 "MICROSAR RTE" /begin SUB_GROUP /end SUB_GROUP /begin FUNCTION_LIST /end FUNCTION_LIST /begin REF_CHARACTERISTIC /end REF_CHARACTERISTIC /begin REF_MEASUREMENT Ap_TqRsDg.DervLambdaBetaDiag.Volt_f32 /end REF_MEASUREMENT /end GROUP
/begin GROUP Ap_TqRsDg.ModeRequirePorts "MICROSAR RTE" /begin SUB_GROUP Ap_TqRsDg.SystemState.Mode /end SUB_GROUP /begin FUNCTION_LIST /end FUNCTION_LIST /begin REF_CHARACTERISTIC /end REF_CHARACTERISTIC /begin REF_MEASUREMENT /end REF_MEASUREMENT /end GROUP
/begin GROUP Ap_TqRsDg.OutputRampMult.Uls_f32 "MICROSAR RTE" /begin SUB_GROUP /end SUB_GROUP /begin FUNCTION_LIST /end FUNCTION_LIST /begin REF_CHARACTERISTIC /end REF_CHARACTERISTIC /begin REF_MEASUREMENT Ap_TqRsDg.OutputRampMult.Uls_f32 /end REF_MEASUREMENT /end GROUP
/begin GROUP Ap_TqRsDg.ReceiverPorts "MICROSAR RTE"
 /begin SUB_GROUP Ap_TqRsDg.DervLambdaAlphaDiag.Volt_f32 Ap_TqRsDg.DervLambdaBetaDiag.Volt_f32 Ap_TqRsDg.OutputRampMult.Uls_f32 Ap_TqRsDg.TrqLimitMin.MtrNm_f32 /end SUB_GROUP
 /begin FUNCTION_LIST /end FUNCTION_LIST
 /begin REF_CHARACTERISTIC /end REF_CHARACTERISTIC
 /begin REF_MEASUREMENT /end REF_MEASUREMENT
/end GROUP
/begin GROUP Ap_TqRsDg.SystemState.Mode "MICROSAR RTE" /begin SUB_GROUP /end SUB_GROUP /begin FUNCTION_LIST /end FUNCTION_LIST /begin REF_CHARACTERISTIC /end REF_CHARACTERISTIC /begin REF_MEASUREMENT Ap_TqRsDg.SystemState.Mode /end REF_MEASUREMENT /end GROUP
/begin GROUP Ap_TqRsDg.TrqLimitMin.MtrNm_f32 "MICROSAR RTE" /begin SUB_GROUP /end SUB_GROUP /begin FUNCTION_LIST /end FUNCTION_LIST /begin REF_CHARACTERISTIC /end REF_CHARACTERISTIC /begin REF_MEASUREMENT Ap_TqRsDg.TrqLimitMin.MtrNm_f32 /end REF_MEASUREMENT /end GROUP
/begin GROUP Ap_TrqCanc "MICROSAR RTE" /begin SUB_GROUP Ap_TrqCanc.PerInstanceMemories Ap_TrqCanc.ReceiverPorts /end SUB_GROUP /begin FUNCTION_LIST /end FUNCTION_LIST /begin REF_CHARACTERISTIC /end REF_CHARACTERISTIC /begin REF_MEASUREMENT /end REF_MEASUREMENT /end GROUP
/begin GROUP Ap_TrqCanc.CogTrqCal "MICROSAR RTE" /begin SUB_GROUP /end SUB_GROUP /begin FUNCTION_LIST /end FUNCTION_LIST /begin REF_CHARACTERISTIC /end REF_CHARACTERISTIC /begin REF_MEASUREMENT Ap_TrqCanc.CogTrqCal /end REF_MEASUREMENT /end GROUP
/begin GROUP Ap_TrqCanc.CogTrqRplComp "MICROSAR RTE" /begin SUB_GROUP /end SUB_GROUP /begin FUNCTION_LIST /end FUNCTION_LIST /begin REF_CHARACTERISTIC /end REF_CHARACTERISTIC /begin REF_MEASUREMENT Ap_TrqCanc.CogTrqRplComp /end REF_MEASUREMENT /end GROUP
/begin GROUP Ap_TrqCanc.EstKe.VpRadpS_f32 "MICROSAR RTE" /begin SUB_GROUP /end SUB_GROUP /begin FUNCTION_LIST /end FUNCTION_LIST /begin REF_CHARACTERISTIC /end REF_CHARACTERISTIC /begin REF_MEASUREMENT Ap_TrqCanc.EstKe.VpRadpS_f32 /end REF_MEASUREMENT /end GROUP
/begin GROUP Ap_TrqCanc.MRFMtrVel.MtrRadpS_f32 "MICROSAR RTE" /begin SUB_GROUP /end SUB_GROUP /begin FUNCTION_LIST /end FUNCTION_LIST /begin REF_CHARACTERISTIC /end REF_CHARACTERISTIC /begin REF_MEASUREMENT Ap_TrqCanc.MRFMtrVel.MtrRadpS_f32 /end REF_MEASUREMENT /end GROUP
/begin GROUP Ap_TrqCanc.MtrCurrDaxRef.Amp_f32 "MICROSAR RTE" /begin SUB_GROUP /end SUB_GROUP /begin FUNCTION_LIST /end FUNCTION_LIST /begin REF_CHARACTERISTIC /end REF_CHARACTERISTIC /begin REF_MEASUREMENT Ap_TrqCanc.MtrCurrDaxRef.Amp_f32 /end REF_MEASUREMENT /end GROUP
/begin GROUP Ap_TrqCanc.MtrCurrQaxRef.Amp_f32 "MICROSAR RTE" /begin SUB_GROUP /end SUB_GROUP /begin FUNCTION_LIST /end FUNCTION_LIST /begin REF_CHARACTERISTIC /end REF_CHARACTERISTIC /begin REF_MEASUREMENT Ap_TrqCanc.MtrCurrQaxRef.Amp_f32 /end REF_MEASUREMENT /end GROUP
/begin GROUP Ap_TrqCanc.PerInstanceMemories "MICROSAR RTE" /begin SUB_GROUP Ap_TrqCanc.CogTrqCal Ap_TrqCanc.CogTrqRplComp /end SUB_GROUP /begin FUNCTION_LIST /end FUNCTION_LIST /begin REF_CHARACTERISTIC /end REF_CHARACTERISTIC /begin REF_MEASUREMENT /end REF_MEASUREMENT /end GROUP
/begin GROUP Ap_TrqCanc.ReceiverPorts "MICROSAR RTE"
 /begin SUB_GROUP Ap_TrqCanc.EstKe.VpRadpS_f32 Ap_TrqCanc.MRFMtrVel.MtrRadpS_f32 Ap_TrqCanc.MtrCurrDaxRef.Amp_f32 Ap_TrqCanc.MtrCurrQaxRef.Amp_f32 /end SUB_GROUP
 /begin FUNCTION_LIST /end FUNCTION_LIST
 /begin REF_CHARACTERISTIC /end REF_CHARACTERISTIC
 /begin REF_MEASUREMENT /end REF_MEASUREMENT
/end GROUP
/begin GROUP Ap_TuningSelAuth "MICROSAR RTE"
 /begin SUB_GROUP Ap_TuningSelAuth.ReceiverPorts Ap_TuningSelAuth.SenderPorts /end SUB_GROUP
 /begin FUNCTION_LIST /end FUNCTION_LIST
 /begin REF_CHARACTERISTIC /end REF_CHARACTERISTIC
 /begin REF_MEASUREMENT /end REF_MEASUREMENT
/end GROUP
/begin GROUP Ap_TuningSelAuth.ActiveTunPers.Cnt_u16 "MICROSAR RTE" /begin SUB_GROUP /end SUB_GROUP /begin FUNCTION_LIST /end FUNCTION_LIST /begin REF_CHARACTERISTIC /end REF_CHARACTERISTIC /begin REF_MEASUREMENT Ap_TuningSelAuth.ActiveTunPers.Cnt_u16 /end REF_MEASUREMENT /end GROUP
/begin GROUP Ap_TuningSelAuth.ActiveTunSet.Cnt_u16 "MICROSAR RTE" /begin SUB_GROUP /end SUB_GROUP /begin FUNCTION_LIST /end FUNCTION_LIST /begin REF_CHARACTERISTIC /end REF_CHARACTERISTIC /begin REF_MEASUREMENT Ap_TuningSelAuth.ActiveTunSet.Cnt_u16 /end REF_MEASUREMENT /end GROUP
/begin GROUP Ap_TuningSelAuth.DesiredTunPers.Cnt_u16 "MICROSAR RTE" /begin SUB_GROUP /end SUB_GROUP /begin FUNCTION_LIST /end FUNCTION_LIST /begin REF_CHARACTERISTIC /end REF_CHARACTERISTIC /begin REF_MEASUREMENT Ap_TuningSelAuth.DesiredTunPers.Cnt_u16 /end REF_MEASUREMENT /end GROUP
/begin GROUP Ap_TuningSelAuth.DesiredTunSet.Cnt_u16 "MICROSAR RTE" /begin SUB_GROUP /end SUB_GROUP /begin FUNCTION_LIST /end FUNCTION_LIST /begin REF_CHARACTERISTIC /end REF_CHARACTERISTIC /begin REF_MEASUREMENT Ap_TuningSelAuth.DesiredTunSet.Cnt_u16 /end REF_MEASUREMENT /end GROUP
/begin GROUP Ap_TuningSelAuth.HwTorque.HwNm_f32 "MICROSAR RTE" /begin SUB_GROUP /end SUB_GROUP /begin FUNCTION_LIST /end FUNCTION_LIST /begin REF_CHARACTERISTIC /end REF_CHARACTERISTIC /begin REF_MEASUREMENT Ap_TuningSelAuth.HwTorque.HwNm_f32 /end REF_MEASUREMENT /end GROUP
/begin GROUP Ap_TuningSelAuth.ReceiverPorts "MICROSAR RTE"
 /begin SUB_GROUP Ap_TuningSelAuth.DesiredTunPers.Cnt_u16 Ap_TuningSelAuth.DesiredTunSet.Cnt_u16 Ap_TuningSelAuth.HwTorque.HwNm_f32 Ap_TuningSelAuth.VehicleSpeed.Kph_f32 /end SUB_GROUP
 /begin FUNCTION_LIST /end FUNCTION_LIST
 /begin REF_CHARACTERISTIC /end REF_CHARACTERISTIC
 /begin REF_MEASUREMENT /end REF_MEASUREMENT
/end GROUP
/begin GROUP Ap_TuningSelAuth.SenderPorts "MICROSAR RTE"
 /begin SUB_GROUP Ap_TuningSelAuth.ActiveTunPers.Cnt_u16 Ap_TuningSelAuth.ActiveTunSet.Cnt_u16 /end SUB_GROUP
 /begin FUNCTION_LIST /end FUNCTION_LIST
 /begin REF_CHARACTERISTIC /end REF_CHARACTERISTIC
 /begin REF_MEASUREMENT /end REF_MEASUREMENT
/end GROUP
/begin GROUP Ap_TuningSelAuth.VehicleSpeed.Kph_f32 "MICROSAR RTE" /begin SUB_GROUP /end SUB_GROUP /begin FUNCTION_LIST /end FUNCTION_LIST /begin REF_CHARACTERISTIC /end REF_CHARACTERISTIC /begin REF_MEASUREMENT Ap_TuningSelAuth.VehicleSpeed.Kph_f32 /end REF_MEASUREMENT /end GROUP
/begin GROUP Ap_WIRInputQual "MICROSAR RTE" /begin SUB_GROUP Ap_WIRInputQual.ReceiverPorts Ap_WIRInputQual.SenderPorts /end SUB_GROUP /begin FUNCTION_LIST /end FUNCTION_LIST /begin REF_CHARACTERISTIC /end REF_CHARACTERISTIC /begin REF_MEASUREMENT /end REF_MEASUREMENT /end GROUP
/begin GROUP Ap_WIRInputQual.QualWhlFreqL.Hz_f32 "MICROSAR RTE" /begin SUB_GROUP /end SUB_GROUP /begin FUNCTION_LIST /end FUNCTION_LIST /begin REF_CHARACTERISTIC /end REF_CHARACTERISTIC /begin REF_MEASUREMENT Ap_WIRInputQual.QualWhlFreqL.Hz_f32 /end REF_MEASUREMENT /end GROUP
/begin GROUP Ap_WIRInputQual.QualWhlFreqR.Hz_f32 "MICROSAR RTE" /begin SUB_GROUP /end SUB_GROUP /begin FUNCTION_LIST /end FUNCTION_LIST /begin REF_CHARACTERISTIC /end REF_CHARACTERISTIC /begin REF_MEASUREMENT Ap_WIRInputQual.QualWhlFreqR.Hz_f32 /end REF_MEASUREMENT /end GROUP
/begin GROUP Ap_WIRInputQual.ReceiverPorts "MICROSAR RTE"
 /begin SUB_GROUP Ap_WIRInputQual.SrlComLWhlSpd.Hz_f32 Ap_WIRInputQual.SrlComLWhlSpdVld.Cnt_lgc Ap_WIRInputQual.SrlComRWhlSpd.Hz_f32 Ap_WIRInputQual.SrlComRWhlSpdVld.Cnt_lgc /end SUB_GROUP
 /begin FUNCTION_LIST /end FUNCTION_LIST
 /begin REF_CHARACTERISTIC /end REF_CHARACTERISTIC
 /begin REF_MEASUREMENT /end REF_MEASUREMENT
/end GROUP
/begin GROUP Ap_WIRInputQual.SenderPorts "MICROSAR RTE"
 /begin SUB_GROUP Ap_WIRInputQual.QualWhlFreqL.Hz_f32 Ap_WIRInputQual.QualWhlFreqR.Hz_f32 Ap_WIRInputQual.WhlFreqQualified.Cnt_lgc /end SUB_GROUP
 /begin FUNCTION_LIST /end FUNCTION_LIST
 /begin REF_CHARACTERISTIC /end REF_CHARACTERISTIC
 /begin REF_MEASUREMENT /end REF_MEASUREMENT
/end GROUP
/begin GROUP Ap_WIRInputQual.SrlComLWhlSpd.Hz_f32 "MICROSAR RTE" /begin SUB_GROUP /end SUB_GROUP /begin FUNCTION_LIST /end FUNCTION_LIST /begin REF_CHARACTERISTIC /end REF_CHARACTERISTIC /begin REF_MEASUREMENT Ap_WIRInputQual.SrlComLWhlSpd.Hz_f32 /end REF_MEASUREMENT /end GROUP
/begin GROUP Ap_WIRInputQual.SrlComLWhlSpdVld.Cnt_lgc "MICROSAR RTE" /begin SUB_GROUP /end SUB_GROUP /begin FUNCTION_LIST /end FUNCTION_LIST /begin REF_CHARACTERISTIC /end REF_CHARACTERISTIC /begin REF_MEASUREMENT Ap_WIRInputQual.SrlComLWhlSpdVld.Cnt_lgc /end REF_MEASUREMENT /end GROUP
/begin GROUP Ap_WIRInputQual.SrlComRWhlSpd.Hz_f32 "MICROSAR RTE" /begin SUB_GROUP /end SUB_GROUP /begin FUNCTION_LIST /end FUNCTION_LIST /begin REF_CHARACTERISTIC /end REF_CHARACTERISTIC /begin REF_MEASUREMENT Ap_WIRInputQual.SrlComRWhlSpd.Hz_f32 /end REF_MEASUREMENT /end GROUP
/begin GROUP Ap_WIRInputQual.SrlComRWhlSpdVld.Cnt_lgc "MICROSAR RTE" /begin SUB_GROUP /end SUB_GROUP /begin FUNCTION_LIST /end FUNCTION_LIST /begin REF_CHARACTERISTIC /end REF_CHARACTERISTIC /begin REF_MEASUREMENT Ap_WIRInputQual.SrlComRWhlSpdVld.Cnt_lgc /end REF_MEASUREMENT /end GROUP
/begin GROUP Ap_WIRInputQual.WhlFreqQualified.Cnt_lgc "MICROSAR RTE" /begin SUB_GROUP /end SUB_GROUP /begin FUNCTION_LIST /end FUNCTION_LIST /begin REF_CHARACTERISTIC /end REF_CHARACTERISTIC /begin REF_MEASUREMENT Ap_WIRInputQual.WhlFreqQualified.Cnt_lgc /end REF_MEASUREMENT /end GROUP
/begin GROUP Ap_WhlImbRej "MICROSAR RTE"
 /begin SUB_GROUP Ap_WhlImbRej.ModeRequirePorts Ap_WhlImbRej.ReceiverPorts Ap_WhlImbRej.SenderPorts /end SUB_GROUP
 /begin FUNCTION_LIST /end FUNCTION_LIST
 /begin REF_CHARACTERISTIC /end REF_CHARACTERISTIC
 /begin REF_MEASUREMENT /end REF_MEASUREMENT
/end GROUP
/begin GROUP Ap_WhlImbRej.DiagStsWIRDisable.Cnt_lgc "MICROSAR RTE" /begin SUB_GROUP /end SUB_GROUP /begin FUNCTION_LIST /end FUNCTION_LIST /begin REF_CHARACTERISTIC /end REF_CHARACTERISTIC /begin REF_MEASUREMENT Ap_WhlImbRej.DiagStsWIRDisable.Cnt_lgc /end REF_MEASUREMENT /end GROUP
/begin GROUP Ap_WhlImbRej.HwTrq.HwNm_f32 "MICROSAR RTE" /begin SUB_GROUP /end SUB_GROUP /begin FUNCTION_LIST /end FUNCTION_LIST /begin REF_CHARACTERISTIC /end REF_CHARACTERISTIC /begin REF_MEASUREMENT Ap_WhlImbRej.HwTrq.HwNm_f32 /end REF_MEASUREMENT /end GROUP
/begin GROUP Ap_WhlImbRej.ModeRequirePorts "MICROSAR RTE" /begin SUB_GROUP Ap_WhlImbRej.SystemState.Mode /end SUB_GROUP /begin FUNCTION_LIST /end FUNCTION_LIST /begin REF_CHARACTERISTIC /end REF_CHARACTERISTIC /begin REF_MEASUREMENT /end REF_MEASUREMENT /end GROUP
/begin GROUP Ap_WhlImbRej.QualWhlFreqL.Hz_f32 "MICROSAR RTE" /begin SUB_GROUP /end SUB_GROUP /begin FUNCTION_LIST /end FUNCTION_LIST /begin REF_CHARACTERISTIC /end REF_CHARACTERISTIC /begin REF_MEASUREMENT Ap_WhlImbRej.QualWhlFreqL.Hz_f32 /end REF_MEASUREMENT /end GROUP
/begin GROUP Ap_WhlImbRej.QualWhlFreqR.Hz_f32 "MICROSAR RTE" /begin SUB_GROUP /end SUB_GROUP /begin FUNCTION_LIST /end FUNCTION_LIST /begin REF_CHARACTERISTIC /end REF_CHARACTERISTIC /begin REF_MEASUREMENT Ap_WhlImbRej.QualWhlFreqR.Hz_f32 /end REF_MEASUREMENT /end GROUP
/begin GROUP Ap_WhlImbRej.ReceiverPorts "MICROSAR RTE"
 /begin SUB_GROUP Ap_WhlImbRej.DiagStsWIRDisable.Cnt_lgc Ap_WhlImbRej.HwTrq.HwNm_f32 Ap_WhlImbRej.QualWhlFreqL.Hz_f32 Ap_WhlImbRej.QualWhlFreqR.Hz_f32 Ap_WhlImbRej.VehSpd.Kph_f32 Ap_WhlImbRej.VehSpdValid.Cnt_lgc Ap_WhlImbRej.WIRMfgEnable.Cnt_lgc Ap_WhlImbRej.WhlFreqQualified.Cnt_lgc /end SUB_GROUP
 /begin FUNCTION_LIST /end FUNCTION_LIST
 /begin REF_CHARACTERISTIC /end REF_CHARACTERISTIC
 /begin REF_MEASUREMENT /end REF_MEASUREMENT
/end GROUP
/begin GROUP Ap_WhlImbRej.SenderPorts "MICROSAR RTE"
 /begin SUB_GROUP Ap_WhlImbRej.WIRCmdAmpBlnd.MtrNm_f32 Ap_WhlImbRej.WhlImbRejCmd.MtrNm_f32 /end SUB_GROUP
 /begin FUNCTION_LIST /end FUNCTION_LIST
 /begin REF_CHARACTERISTIC /end REF_CHARACTERISTIC
 /begin REF_MEASUREMENT /end REF_MEASUREMENT
/end GROUP
/begin GROUP Ap_WhlImbRej.SystemState.Mode "MICROSAR RTE" /begin SUB_GROUP /end SUB_GROUP /begin FUNCTION_LIST /end FUNCTION_LIST /begin REF_CHARACTERISTIC /end REF_CHARACTERISTIC /begin REF_MEASUREMENT Ap_WhlImbRej.SystemState.Mode /end REF_MEASUREMENT /end GROUP
/begin GROUP Ap_WhlImbRej.VehSpd.Kph_f32 "MICROSAR RTE" /begin SUB_GROUP /end SUB_GROUP /begin FUNCTION_LIST /end FUNCTION_LIST /begin REF_CHARACTERISTIC /end REF_CHARACTERISTIC /begin REF_MEASUREMENT Ap_WhlImbRej.VehSpd.Kph_f32 /end REF_MEASUREMENT /end GROUP
/begin GROUP Ap_WhlImbRej.VehSpdValid.Cnt_lgc "MICROSAR RTE" /begin SUB_GROUP /end SUB_GROUP /begin FUNCTION_LIST /end FUNCTION_LIST /begin REF_CHARACTERISTIC /end REF_CHARACTERISTIC /begin REF_MEASUREMENT Ap_WhlImbRej.VehSpdValid.Cnt_lgc /end REF_MEASUREMENT /end GROUP
/begin GROUP Ap_WhlImbRej.WIRCmdAmpBlnd.MtrNm_f32 "MICROSAR RTE" /begin SUB_GROUP /end SUB_GROUP /begin FUNCTION_LIST /end FUNCTION_LIST /begin REF_CHARACTERISTIC /end REF_CHARACTERISTIC /begin REF_MEASUREMENT Ap_WhlImbRej.WIRCmdAmpBlnd.MtrNm_f32 /end REF_MEASUREMENT /end GROUP
/begin GROUP Ap_WhlImbRej.WIRMfgEnable.Cnt_lgc "MICROSAR RTE" /begin SUB_GROUP /end SUB_GROUP /begin FUNCTION_LIST /end FUNCTION_LIST /begin REF_CHARACTERISTIC /end REF_CHARACTERISTIC /begin REF_MEASUREMENT Ap_WhlImbRej.WIRMfgEnable.Cnt_lgc /end REF_MEASUREMENT /end GROUP
/begin GROUP Ap_WhlImbRej.WhlFreqQualified.Cnt_lgc "MICROSAR RTE" /begin SUB_GROUP /end SUB_GROUP /begin FUNCTION_LIST /end FUNCTION_LIST /begin REF_CHARACTERISTIC /end REF_CHARACTERISTIC /begin REF_MEASUREMENT Ap_WhlImbRej.WhlFreqQualified.Cnt_lgc /end REF_MEASUREMENT /end GROUP
/begin GROUP Ap_WhlImbRej.WhlImbRejCmd.MtrNm_f32 "MICROSAR RTE" /begin SUB_GROUP /end SUB_GROUP /begin FUNCTION_LIST /end FUNCTION_LIST /begin REF_CHARACTERISTIC /end REF_CHARACTERISTIC /begin REF_MEASUREMENT Ap_WhlImbRej.WhlImbRejCmd.MtrNm_f32 /end REF_MEASUREMENT /end GROUP
/begin GROUP Ap_ePWM2 "MICROSAR RTE" /begin SUB_GROUP Ap_ePWM2.ModeRequirePorts /end SUB_GROUP /begin FUNCTION_LIST /end FUNCTION_LIST /begin REF_CHARACTERISTIC /end REF_CHARACTERISTIC /begin REF_MEASUREMENT /end REF_MEASUREMENT /end GROUP
/begin GROUP Ap_ePWM2.ModeRequirePorts "MICROSAR RTE" /begin SUB_GROUP Ap_ePWM2.SystemState.Mode /end SUB_GROUP /begin FUNCTION_LIST /end FUNCTION_LIST /begin REF_CHARACTERISTIC /end REF_CHARACTERISTIC /begin REF_MEASUREMENT /end REF_MEASUREMENT /end GROUP
/begin GROUP Ap_ePWM2.SystemState.Mode "MICROSAR RTE" /begin SUB_GROUP /end SUB_GROUP /begin FUNCTION_LIST /end FUNCTION_LIST /begin REF_CHARACTERISTIC /end REF_CHARACTERISTIC /begin REF_MEASUREMENT Ap_ePWM2.SystemState.Mode /end REF_MEASUREMENT /end GROUP
/begin GROUP Assist "MICROSAR RTE" /begin SUB_GROUP Assist.ReceiverPorts Assist.SenderPorts /end SUB_GROUP /begin FUNCTION_LIST /end FUNCTION_LIST /begin REF_CHARACTERISTIC /end REF_CHARACTERISTIC /begin REF_MEASUREMENT /end REF_MEASUREMENT /end GROUP
/begin GROUP Assist.AssistDDFactor.Uls_f32 "MICROSAR RTE" /begin SUB_GROUP /end SUB_GROUP /begin FUNCTION_LIST /end FUNCTION_LIST /begin REF_CHARACTERISTIC /end REF_CHARACTERISTIC /begin REF_MEASUREMENT Assist.AssistDDFactor.Uls_f32 /end REF_MEASUREMENT /end GROUP
/begin GROUP Assist.BaseAssistCmd.MtrNm_f32 "MICROSAR RTE" /begin SUB_GROUP /end SUB_GROUP /begin FUNCTION_LIST /end FUNCTION_LIST /begin REF_CHARACTERISTIC /end REF_CHARACTERISTIC /begin REF_MEASUREMENT Assist.BaseAssistCmd.MtrNm_f32 /end REF_MEASUREMENT /end GROUP
/begin GROUP Assist.DftAsstTbl.Cnt_lgc "MICROSAR RTE" /begin SUB_GROUP /end SUB_GROUP /begin FUNCTION_LIST /end FUNCTION_LIST /begin REF_CHARACTERISTIC /end REF_CHARACTERISTIC /begin REF_MEASUREMENT Assist.DftAsstTbl.Cnt_lgc /end REF_MEASUREMENT /end GROUP
/begin GROUP Assist.DutyCycleLevel.Uls_f32 "MICROSAR RTE" /begin SUB_GROUP /end SUB_GROUP /begin FUNCTION_LIST /end FUNCTION_LIST /begin REF_CHARACTERISTIC /end REF_CHARACTERISTIC /begin REF_MEASUREMENT Assist.DutyCycleLevel.Uls_f32 /end REF_MEASUREMENT /end GROUP
/begin GROUP Assist.DwnldAsstGain.Uls_f32 "MICROSAR RTE" /begin SUB_GROUP /end SUB_GROUP /begin FUNCTION_LIST /end FUNCTION_LIST /begin REF_CHARACTERISTIC /end REF_CHARACTERISTIC /begin REF_MEASUREMENT Assist.DwnldAsstGain.Uls_f32 /end REF_MEASUREMENT /end GROUP
/begin GROUP Assist.HwTrq.HwNm_f32 "MICROSAR RTE" /begin SUB_GROUP /end SUB_GROUP /begin FUNCTION_LIST /end FUNCTION_LIST /begin REF_CHARACTERISTIC /end REF_CHARACTERISTIC /begin REF_MEASUREMENT Assist.HwTrq.HwNm_f32 /end REF_MEASUREMENT /end GROUP
/begin GROUP Assist.HwTrqHysAdd.HwNm_f32 "MICROSAR RTE" /begin SUB_GROUP /end SUB_GROUP /begin FUNCTION_LIST /end FUNCTION_LIST /begin REF_CHARACTERISTIC /end REF_CHARACTERISTIC /begin REF_MEASUREMENT Assist.HwTrqHysAdd.HwNm_f32 /end REF_MEASUREMENT /end GROUP
/begin GROUP Assist.IpTrqOvr.HwNm_f32 "MICROSAR RTE" /begin SUB_GROUP /end SUB_GROUP /begin FUNCTION_LIST /end FUNCTION_LIST /begin REF_CHARACTERISTIC /end REF_CHARACTERISTIC /begin REF_MEASUREMENT Assist.IpTrqOvr.HwNm_f32 /end REF_MEASUREMENT /end GROUP
/begin GROUP Assist.ReceiverPorts "MICROSAR RTE"
 /begin SUB_GROUP Assist.AssistDDFactor.Uls_f32 Assist.DftAsstTbl.Cnt_lgc Assist.DutyCycleLevel.Uls_f32 Assist.DwnldAsstGain.Uls_f32 Assist.HwTrq.HwNm_f32 Assist.HwTrqHysAdd.HwNm_f32 Assist.IpTrqOvr.HwNm_f32 Assist.VehSpd.Kph_f32 Assist.WIRCmdAmpBlnd.MtrNm_f32 /end SUB_GROUP
 /begin FUNCTION_LIST /end FUNCTION_LIST
 /begin REF_CHARACTERISTIC /end REF_CHARACTERISTIC
 /begin REF_MEASUREMENT /end REF_MEASUREMENT
/end GROUP
/begin GROUP Assist.SenderPorts "MICROSAR RTE" /begin SUB_GROUP Assist.BaseAssistCmd.MtrNm_f32 /end SUB_GROUP /begin FUNCTION_LIST /end FUNCTION_LIST /begin REF_CHARACTERISTIC /end REF_CHARACTERISTIC /begin REF_MEASUREMENT /end REF_MEASUREMENT /end GROUP
/begin GROUP Assist.VehSpd.Kph_f32 "MICROSAR RTE" /begin SUB_GROUP /end SUB_GROUP /begin FUNCTION_LIST /end FUNCTION_LIST /begin REF_CHARACTERISTIC /end REF_CHARACTERISTIC /begin REF_MEASUREMENT Assist.VehSpd.Kph_f32 /end REF_MEASUREMENT /end GROUP
/begin GROUP Assist.WIRCmdAmpBlnd.MtrNm_f32 "MICROSAR RTE" /begin SUB_GROUP /end SUB_GROUP /begin FUNCTION_LIST /end FUNCTION_LIST /begin REF_CHARACTERISTIC /end REF_CHARACTERISTIC /begin REF_MEASUREMENT Assist.WIRCmdAmpBlnd.MtrNm_f32 /end REF_MEASUREMENT /end GROUP
/begin GROUP BatteryVoltage "MICROSAR RTE"
 /begin SUB_GROUP BatteryVoltage.ModeRequirePorts BatteryVoltage.PerInstanceMemories BatteryVoltage.ReceiverPorts BatteryVoltage.SenderPorts /end SUB_GROUP
 /begin FUNCTION_LIST /end FUNCTION_LIST
 /begin REF_CHARACTERISTIC /end REF_CHARACTERISTIC
 /begin REF_MEASUREMENT /end REF_MEASUREMENT
/end GROUP
/begin GROUP BatteryVoltage.Batt.Volt_f32 "MICROSAR RTE" /begin SUB_GROUP /end SUB_GROUP /begin FUNCTION_LIST /end FUNCTION_LIST /begin REF_CHARACTERISTIC /end REF_CHARACTERISTIC /begin REF_MEASUREMENT BatteryVoltage.Batt.Volt_f32 /end REF_MEASUREMENT /end GROUP
/begin GROUP BatteryVoltage.BattSwitched.Volt_f32 "MICROSAR RTE" /begin SUB_GROUP /end SUB_GROUP /begin FUNCTION_LIST /end FUNCTION_LIST /begin REF_CHARACTERISTIC /end REF_CHARACTERISTIC /begin REF_MEASUREMENT BatteryVoltage.BattSwitched.Volt_f32 /end REF_MEASUREMENT /end GROUP
/begin GROUP BatteryVoltage.ModeRequirePorts "MICROSAR RTE" /begin SUB_GROUP BatteryVoltage.SystemState.Mode /end SUB_GROUP /begin FUNCTION_LIST /end FUNCTION_LIST /begin REF_CHARACTERISTIC /end REF_CHARACTERISTIC /begin REF_MEASUREMENT /end REF_MEASUREMENT /end GROUP
/begin GROUP BatteryVoltage.OvervoltageData "MICROSAR RTE" /begin SUB_GROUP /end SUB_GROUP /begin FUNCTION_LIST /end FUNCTION_LIST /begin REF_CHARACTERISTIC /end REF_CHARACTERISTIC
 /begin REF_MEASUREMENT BatteryVoltage.OvervoltageData.MaxBattVoltage_Volts_f32 BatteryVoltage.OvervoltageData.OvervoltageCounter_Cnt_u16 /end REF_MEASUREMENT
/end GROUP
/begin GROUP BatteryVoltage.PerInstanceMemories "MICROSAR RTE" /begin SUB_GROUP BatteryVoltage.OvervoltageData /end SUB_GROUP /begin FUNCTION_LIST /end FUNCTION_LIST /begin REF_CHARACTERISTIC /end REF_CHARACTERISTIC /begin REF_MEASUREMENT /end REF_MEASUREMENT /end GROUP
/begin GROUP BatteryVoltage.ReceiverPorts "MICROSAR RTE"
 /begin SUB_GROUP BatteryVoltage.Batt.Volt_f32 BatteryVoltage.BattSwitched.Volt_f32 BatteryVoltage.SysCVSwitch.Volt_f32 /end SUB_GROUP
 /begin FUNCTION_LIST /end FUNCTION_LIST
 /begin REF_CHARACTERISTIC /end REF_CHARACTERISTIC
 /begin REF_MEASUREMENT /end REF_MEASUREMENT
/end GROUP
/begin GROUP BatteryVoltage.SenderPorts "MICROSAR RTE"
 /begin SUB_GROUP BatteryVoltage.SysC_Vecu.Volt_f32 BatteryVoltage.Vecu.Volt_f32 BatteryVoltage.VswitchClosed.Cnt_lgc /end SUB_GROUP
 /begin FUNCTION_LIST /end FUNCTION_LIST
 /begin REF_CHARACTERISTIC /end REF_CHARACTERISTIC
 /begin REF_MEASUREMENT /end REF_MEASUREMENT
/end GROUP
/begin GROUP BatteryVoltage.SysCVSwitch.Volt_f32 "MICROSAR RTE" /begin SUB_GROUP /end SUB_GROUP /begin FUNCTION_LIST /end FUNCTION_LIST /begin REF_CHARACTERISTIC /end REF_CHARACTERISTIC /begin REF_MEASUREMENT BatteryVoltage.SysCVSwitch.Volt_f32 /end REF_MEASUREMENT /end GROUP
/begin GROUP BatteryVoltage.SysC_Vecu.Volt_f32 "MICROSAR RTE" /begin SUB_GROUP /end SUB_GROUP /begin FUNCTION_LIST /end FUNCTION_LIST /begin REF_CHARACTERISTIC /end REF_CHARACTERISTIC /begin REF_MEASUREMENT BatteryVoltage.SysC_Vecu.Volt_f32 /end REF_MEASUREMENT /end GROUP
/begin GROUP BatteryVoltage.SystemState.Mode "MICROSAR RTE" /begin SUB_GROUP /end SUB_GROUP /begin FUNCTION_LIST /end FUNCTION_LIST /begin REF_CHARACTERISTIC /end REF_CHARACTERISTIC /begin REF_MEASUREMENT BatteryVoltage.SystemState.Mode /end REF_MEASUREMENT /end GROUP
/begin GROUP BatteryVoltage.Vecu.Volt_f32 "MICROSAR RTE" /begin SUB_GROUP /end SUB_GROUP /begin FUNCTION_LIST /end FUNCTION_LIST /begin REF_CHARACTERISTIC /end REF_CHARACTERISTIC /begin REF_MEASUREMENT BatteryVoltage.Vecu.Volt_f32 /end REF_MEASUREMENT /end GROUP
/begin GROUP BatteryVoltage.VswitchClosed.Cnt_lgc "MICROSAR RTE" /begin SUB_GROUP /end SUB_GROUP /begin FUNCTION_LIST /end FUNCTION_LIST /begin REF_CHARACTERISTIC /end REF_CHARACTERISTIC /begin REF_MEASUREMENT BatteryVoltage.VswitchClosed.Cnt_lgc /end REF_MEASUREMENT /end GROUP
/begin GROUP CDDInterface "MICROSAR RTE"
 /begin SUB_GROUP CDDInterface.ModeRequirePorts CDDInterface.ReceiverPorts CDDInterface.SenderPorts /end SUB_GROUP
 /begin FUNCTION_LIST /end FUNCTION_LIST
 /begin REF_CHARACTERISTIC /end REF_CHARACTERISTIC
 /begin REF_MEASUREMENT /end REF_MEASUREMENT
/end GROUP
/begin GROUP CDDInterface.ADCMtrCurr1.Volts_f32 "MICROSAR RTE" /begin SUB_GROUP /end SUB_GROUP /begin FUNCTION_LIST /end FUNCTION_LIST /begin REF_CHARACTERISTIC /end REF_CHARACTERISTIC /begin REF_MEASUREMENT CDDInterface.ADCMtrCurr1.Volts_f32 /end REF_MEASUREMENT /end GROUP
/begin GROUP CDDInterface.ADCMtrCurr2.Volts_f32 "MICROSAR RTE" /begin SUB_GROUP /end SUB_GROUP /begin FUNCTION_LIST /end FUNCTION_LIST /begin REF_CHARACTERISTIC /end REF_CHARACTERISTIC /begin REF_MEASUREMENT CDDInterface.ADCMtrCurr2.Volts_f32 /end REF_MEASUREMENT /end GROUP
/begin GROUP CDDInterface.CommOffset.Cnt_u16 "MICROSAR RTE" /begin SUB_GROUP /end SUB_GROUP /begin FUNCTION_LIST /end FUNCTION_LIST /begin REF_CHARACTERISTIC /end REF_CHARACTERISTIC /begin REF_MEASUREMENT CDDInterface.CommOffset.Cnt_u16 /end REF_MEASUREMENT /end GROUP
/begin GROUP CDDInterface.CorrMtrCurrPosition.Rev_f32 "MICROSAR RTE" /begin SUB_GROUP /end SUB_GROUP /begin FUNCTION_LIST /end FUNCTION_LIST /begin REF_CHARACTERISTIC /end REF_CHARACTERISTIC /begin REF_MEASUREMENT CDDInterface.CorrMtrCurrPosition.Rev_f32 /end REF_MEASUREMENT /end GROUP
/begin GROUP CDDInterface.CorrMtrPosElec.Rev_f32 "MICROSAR RTE" /begin SUB_GROUP /end SUB_GROUP /begin FUNCTION_LIST /end FUNCTION_LIST /begin REF_CHARACTERISTIC /end REF_CHARACTERISTIC /begin REF_MEASUREMENT CDDInterface.CorrMtrPosElec.Rev_f32 /end REF_MEASUREMENT /end GROUP
/begin GROUP CDDInterface.Cos1Theta.Volts_f32 "MICROSAR RTE" /begin SUB_GROUP /end SUB_GROUP /begin FUNCTION_LIST /end FUNCTION_LIST /begin REF_CHARACTERISTIC /end REF_CHARACTERISTIC /begin REF_MEASUREMENT CDDInterface.Cos1Theta.Volts_f32 /end REF_MEASUREMENT /end GROUP
/begin GROUP CDDInterface.DampingSrlComSvcDft.Cnt_lgc "MICROSAR RTE" /begin SUB_GROUP /end SUB_GROUP /begin FUNCTION_LIST /end FUNCTION_LIST /begin REF_CHARACTERISTIC /end REF_CHARACTERISTIC /begin REF_MEASUREMENT CDDInterface.DampingSrlComSvcDft.Cnt_lgc /end REF_MEASUREMENT /end GROUP
/begin GROUP CDDInterface.DaxIntegralGain_IPM.Uls_f32 "MICROSAR RTE" /begin SUB_GROUP /end SUB_GROUP /begin FUNCTION_LIST /end FUNCTION_LIST /begin REF_CHARACTERISTIC /end REF_CHARACTERISTIC /begin REF_MEASUREMENT CDDInterface.DaxIntegralGain_IPM.Uls_f32 /end REF_MEASUREMENT /end GROUP
/begin GROUP CDDInterface.DaxIntegralGain_SPM.Uls_f32 "MICROSAR RTE" /begin SUB_GROUP /end SUB_GROUP /begin FUNCTION_LIST /end FUNCTION_LIST /begin REF_CHARACTERISTIC /end REF_CHARACTERISTIC /begin REF_MEASUREMENT CDDInterface.DaxIntegralGain_SPM.Uls_f32 /end REF_MEASUREMENT /end GROUP
/begin GROUP CDDInterface.DaxPropotionalGain_IPM.Uls_f32 "MICROSAR RTE" /begin SUB_GROUP /end SUB_GROUP /begin FUNCTION_LIST /end FUNCTION_LIST /begin REF_CHARACTERISTIC /end REF_CHARACTERISTIC /begin REF_MEASUREMENT CDDInterface.DaxPropotionalGain_IPM.Uls_f32 /end REF_MEASUREMENT /end GROUP
/begin GROUP CDDInterface.DaxPropotionalGain_SPM.Uls_f32 "MICROSAR RTE" /begin SUB_GROUP /end SUB_GROUP /begin FUNCTION_LIST /end FUNCTION_LIST /begin REF_CHARACTERISTIC /end REF_CHARACTERISTIC /begin REF_MEASUREMENT CDDInterface.DaxPropotionalGain_SPM.Uls_f32 /end REF_MEASUREMENT /end GROUP
/begin GROUP CDDInterface.DftAsstTbl.Cnt_lgc "MICROSAR RTE" /begin SUB_GROUP /end SUB_GROUP /begin FUNCTION_LIST /end FUNCTION_LIST /begin REF_CHARACTERISTIC /end REF_CHARACTERISTIC /begin REF_MEASUREMENT CDDInterface.DftAsstTbl.Cnt_lgc /end REF_MEASUREMENT /end GROUP
/begin GROUP CDDInterface.DrivingDynSrlComSvcDft.Cnt_lgc "MICROSAR RTE" /begin SUB_GROUP /end SUB_GROUP /begin FUNCTION_LIST /end FUNCTION_LIST /begin REF_CHARACTERISTIC /end REF_CHARACTERISTIC /begin REF_MEASUREMENT CDDInterface.DrivingDynSrlComSvcDft.Cnt_lgc /end REF_MEASUREMENT /end GROUP
/begin GROUP CDDInterface.DutyCycleSmall.Cnt_u16 "MICROSAR RTE" /begin SUB_GROUP /end SUB_GROUP /begin FUNCTION_LIST /end FUNCTION_LIST /begin REF_CHARACTERISTIC /end REF_CHARACTERISTIC /begin REF_MEASUREMENT CDDInterface.DutyCycleSmall.Cnt_u16 /end REF_MEASUREMENT /end GROUP
/begin GROUP CDDInterface.DwnldAsstGain.Uls_f32 "MICROSAR RTE" /begin SUB_GROUP /end SUB_GROUP /begin FUNCTION_LIST /end FUNCTION_LIST /begin REF_CHARACTERISTIC /end REF_CHARACTERISTIC /begin REF_MEASUREMENT CDDInterface.DwnldAsstGain.Uls_f32 /end REF_MEASUREMENT /end GROUP
/begin GROUP CDDInterface.EOTImpactSrlComSvcDft.Cnt_lgc "MICROSAR RTE" /begin SUB_GROUP /end SUB_GROUP /begin FUNCTION_LIST /end FUNCTION_LIST /begin REF_CHARACTERISTIC /end REF_CHARACTERISTIC /begin REF_MEASUREMENT CDDInterface.EOTImpactSrlComSvcDft.Cnt_lgc /end REF_MEASUREMENT /end GROUP
/begin GROUP CDDInterface.EOTThermalSrlComSvcDft.Cnt_lgc "MICROSAR RTE" /begin SUB_GROUP /end SUB_GROUP /begin FUNCTION_LIST /end FUNCTION_LIST /begin REF_CHARACTERISTIC /end REF_CHARACTERISTIC /begin REF_MEASUREMENT CDDInterface.EOTThermalSrlComSvcDft.Cnt_lgc /end REF_MEASUREMENT /end GROUP
/begin GROUP CDDInterface.EngONSrlComSvcDft.Cnt_lgc "MICROSAR RTE" /begin SUB_GROUP /end SUB_GROUP /begin FUNCTION_LIST /end FUNCTION_LIST /begin REF_CHARACTERISTIC /end REF_CHARACTERISTIC /begin REF_MEASUREMENT CDDInterface.EngONSrlComSvcDft.Cnt_lgc /end REF_MEASUREMENT /end GROUP
/begin GROUP CDDInterface.EstKe.VpRadpS_f32 "MICROSAR RTE" /begin SUB_GROUP /end SUB_GROUP /begin FUNCTION_LIST /end FUNCTION_LIST /begin REF_CHARACTERISTIC /end REF_CHARACTERISTIC /begin REF_MEASUREMENT CDDInterface.EstKe.VpRadpS_f32 /end REF_MEASUREMENT /end GROUP
/begin GROUP CDDInterface.ExpectedOnTimeA.Cnt_u32 "MICROSAR RTE" /begin SUB_GROUP /end SUB_GROUP /begin FUNCTION_LIST /end FUNCTION_LIST /begin REF_CHARACTERISTIC /end REF_CHARACTERISTIC /begin REF_MEASUREMENT CDDInterface.ExpectedOnTimeA.Cnt_u32 /end REF_MEASUREMENT /end GROUP
/begin GROUP CDDInterface.ExpectedOnTimeB.Cnt_u32 "MICROSAR RTE" /begin SUB_GROUP /end SUB_GROUP /begin FUNCTION_LIST /end FUNCTION_LIST /begin REF_CHARACTERISTIC /end REF_CHARACTERISTIC /begin REF_MEASUREMENT CDDInterface.ExpectedOnTimeB.Cnt_u32 /end REF_MEASUREMENT /end GROUP
/begin GROUP CDDInterface.ExpectedOnTimeC.Cnt_u32 "MICROSAR RTE" /begin SUB_GROUP /end SUB_GROUP /begin FUNCTION_LIST /end FUNCTION_LIST /begin REF_CHARACTERISTIC /end REF_CHARACTERISTIC /begin REF_MEASUREMENT CDDInterface.ExpectedOnTimeC.Cnt_u32 /end REF_MEASUREMENT /end GROUP
/begin GROUP CDDInterface.FETFaultPhase.Cnt_enum "MICROSAR RTE" /begin SUB_GROUP /end SUB_GROUP /begin FUNCTION_LIST /end FUNCTION_LIST /begin REF_CHARACTERISTIC /end REF_CHARACTERISTIC /begin REF_MEASUREMENT CDDInterface.FETFaultPhase.Cnt_enum /end REF_MEASUREMENT /end GROUP
/begin GROUP CDDInterface.FETFaultType.Cnt_enum "MICROSAR RTE" /begin SUB_GROUP /end SUB_GROUP /begin FUNCTION_LIST /end FUNCTION_LIST /begin REF_CHARACTERISTIC /end REF_CHARACTERISTIC /begin REF_MEASUREMENT CDDInterface.FETFaultType.Cnt_enum /end REF_MEASUREMENT /end GROUP
/begin GROUP CDDInterface.FreqDepDmpSrlComSvcDft.Cnt_lgc "MICROSAR RTE" /begin SUB_GROUP /end SUB_GROUP /begin FUNCTION_LIST /end FUNCTION_LIST /begin REF_CHARACTERISTIC /end REF_CHARACTERISTIC /begin REF_MEASUREMENT CDDInterface.FreqDepDmpSrlComSvcDft.Cnt_lgc /end REF_MEASUREMENT /end GROUP
/begin GROUP CDDInterface.FricLrnSrlComSvcDft.Cnt_lgc "MICROSAR RTE" /begin SUB_GROUP /end SUB_GROUP /begin FUNCTION_LIST /end FUNCTION_LIST /begin REF_CHARACTERISTIC /end REF_CHARACTERISTIC /begin REF_MEASUREMENT CDDInterface.FricLrnSrlComSvcDft.Cnt_lgc /end REF_MEASUREMENT /end GROUP
/begin GROUP CDDInterface.HysAddSrlComSvcDft.Cnt_lgc "MICROSAR RTE" /begin SUB_GROUP /end SUB_GROUP /begin FUNCTION_LIST /end FUNCTION_LIST /begin REF_CHARACTERISTIC /end REF_CHARACTERISTIC /begin REF_MEASUREMENT CDDInterface.HysAddSrlComSvcDft.Cnt_lgc /end REF_MEASUREMENT /end GROUP
/begin GROUP CDDInterface.HystCompSrlComSvcDft.Cnt_lgc "MICROSAR RTE" /begin SUB_GROUP /end SUB_GROUP /begin FUNCTION_LIST /end FUNCTION_LIST /begin REF_CHARACTERISTIC /end REF_CHARACTERISTIC /begin REF_MEASUREMENT CDDInterface.HystCompSrlComSvcDft.Cnt_lgc /end REF_MEASUREMENT /end GROUP
/begin GROUP CDDInterface.IgnCnt.Cnt_u16 "MICROSAR RTE" /begin SUB_GROUP /end SUB_GROUP /begin FUNCTION_LIST /end FUNCTION_LIST /begin REF_CHARACTERISTIC /end REF_CHARACTERISTIC /begin REF_MEASUREMENT CDDInterface.IgnCnt.Cnt_u16 /end REF_MEASUREMENT /end GROUP
/begin GROUP CDDInterface.KinIntDiagSrlComSvcDft.Cnt_lgc "MICROSAR RTE" /begin SUB_GROUP /end SUB_GROUP /begin FUNCTION_LIST /end FUNCTION_LIST /begin REF_CHARACTERISTIC /end REF_CHARACTERISTIC /begin REF_MEASUREMENT CDDInterface.KinIntDiagSrlComSvcDft.Cnt_lgc /end REF_MEASUREMENT /end GROUP
/begin GROUP CDDInterface.LRPRPhaseadvanceCaptured.Cnt_s16 "MICROSAR RTE" /begin SUB_GROUP /end SUB_GROUP /begin FUNCTION_LIST /end FUNCTION_LIST /begin REF_CHARACTERISTIC /end REF_CHARACTERISTIC /begin REF_MEASUREMENT CDDInterface.LRPRPhaseadvanceCaptured.Cnt_s16 /end REF_MEASUREMENT /end GROUP
/begin GROUP CDDInterface.LimitSrlComSvcDft.Cnt_lgc "MICROSAR RTE" /begin SUB_GROUP /end SUB_GROUP /begin FUNCTION_LIST /end FUNCTION_LIST /begin REF_CHARACTERISTIC /end REF_CHARACTERISTIC /begin REF_MEASUREMENT CDDInterface.LimitSrlComSvcDft.Cnt_lgc /end REF_MEASUREMENT /end GROUP
/begin GROUP CDDInterface.MEC.Cnt_enum "MICROSAR RTE" /begin SUB_GROUP /end SUB_GROUP /begin FUNCTION_LIST /end FUNCTION_LIST /begin REF_CHARACTERISTIC /end REF_CHARACTERISTIC /begin REF_MEASUREMENT CDDInterface.MEC.Cnt_enum /end REF_MEASUREMENT /end GROUP
/begin GROUP CDDInterface.MRFMtrVel.MtrRadpS_f32 "MICROSAR RTE" /begin SUB_GROUP /end SUB_GROUP /begin FUNCTION_LIST /end FUNCTION_LIST /begin REF_CHARACTERISTIC /end REF_CHARACTERISTIC /begin REF_MEASUREMENT CDDInterface.MRFMtrVel.MtrRadpS_f32 /end REF_MEASUREMENT /end GROUP
/begin GROUP CDDInterface.MeasuredOnTimeA.Cnt_u32 "MICROSAR RTE" /begin SUB_GROUP /end SUB_GROUP /begin FUNCTION_LIST /end FUNCTION_LIST /begin REF_CHARACTERISTIC /end REF_CHARACTERISTIC /begin REF_MEASUREMENT CDDInterface.MeasuredOnTimeA.Cnt_u32 /end REF_MEASUREMENT /end GROUP
/begin GROUP CDDInterface.MeasuredOnTimeB.Cnt_u32 "MICROSAR RTE" /begin SUB_GROUP /end SUB_GROUP /begin FUNCTION_LIST /end FUNCTION_LIST /begin REF_CHARACTERISTIC /end REF_CHARACTERISTIC /begin REF_MEASUREMENT CDDInterface.MeasuredOnTimeB.Cnt_u32 /end REF_MEASUREMENT /end GROUP
/begin GROUP CDDInterface.MeasuredOnTimeC.Cnt_u32 "MICROSAR RTE" /begin SUB_GROUP /end SUB_GROUP /begin FUNCTION_LIST /end FUNCTION_LIST /begin REF_CHARACTERISTIC /end REF_CHARACTERISTIC /begin REF_MEASUREMENT CDDInterface.MeasuredOnTimeC.Cnt_u32 /end REF_MEASUREMENT /end GROUP
/begin GROUP CDDInterface.MfgDiagInhibit.Cnt_lgc "MICROSAR RTE" /begin SUB_GROUP /end SUB_GROUP /begin FUNCTION_LIST /end FUNCTION_LIST /begin REF_CHARACTERISTIC /end REF_CHARACTERISTIC /begin REF_MEASUREMENT CDDInterface.MfgDiagInhibit.Cnt_lgc /end REF_MEASUREMENT /end GROUP
/begin GROUP CDDInterface.ModIdxFinal.Uls_f32 "MICROSAR RTE" /begin SUB_GROUP /end SUB_GROUP /begin FUNCTION_LIST /end FUNCTION_LIST /begin REF_CHARACTERISTIC /end REF_CHARACTERISTIC /begin REF_MEASUREMENT CDDInterface.ModIdxFinal.Uls_f32 /end REF_MEASUREMENT /end GROUP
/begin GROUP CDDInterface.ModIdxSrlComSvcDft.Cnt_lgc "MICROSAR RTE" /begin SUB_GROUP /end SUB_GROUP /begin FUNCTION_LIST /end FUNCTION_LIST /begin REF_CHARACTERISTIC /end REF_CHARACTERISTIC /begin REF_MEASUREMENT CDDInterface.ModIdxSrlComSvcDft.Cnt_lgc /end REF_MEASUREMENT /end GROUP
/begin GROUP CDDInterface.ModeRequirePorts "MICROSAR RTE" /begin SUB_GROUP CDDInterface.SystemState.Mode /end SUB_GROUP /begin FUNCTION_LIST /end FUNCTION_LIST /begin REF_CHARACTERISTIC /end REF_CHARACTERISTIC /begin REF_MEASUREMENT /end REF_MEASUREMENT /end GROUP
/begin GROUP CDDInterface.MtrCurr1TempOffset.Volt_f32 "MICROSAR RTE" /begin SUB_GROUP /end SUB_GROUP /begin FUNCTION_LIST /end FUNCTION_LIST /begin REF_CHARACTERISTIC /end REF_CHARACTERISTIC /begin REF_MEASUREMENT CDDInterface.MtrCurr1TempOffset.Volt_f32 /end REF_MEASUREMENT /end GROUP
/begin GROUP CDDInterface.MtrCurr2TempOffset.Volt_f32 "MICROSAR RTE" /begin SUB_GROUP /end SUB_GROUP /begin FUNCTION_LIST /end FUNCTION_LIST /begin REF_CHARACTERISTIC /end REF_CHARACTERISTIC /begin REF_MEASUREMENT CDDInterface.MtrCurr2TempOffset.Volt_f32 /end REF_MEASUREMENT /end GROUP
/begin GROUP CDDInterface.MtrCurrDax.Amp_f32 "MICROSAR RTE" /begin SUB_GROUP /end SUB_GROUP /begin FUNCTION_LIST /end FUNCTION_LIST /begin REF_CHARACTERISTIC /end REF_CHARACTERISTIC /begin REF_MEASUREMENT CDDInterface.MtrCurrDax.Amp_f32 /end REF_MEASUREMENT /end GROUP
/begin GROUP CDDInterface.MtrCurrDaxRef.Amp_f32 "MICROSAR RTE" /begin SUB_GROUP /end SUB_GROUP /begin FUNCTION_LIST /end FUNCTION_LIST /begin REF_CHARACTERISTIC /end REF_CHARACTERISTIC /begin REF_MEASUREMENT CDDInterface.MtrCurrDaxRef.Amp_f32 /end REF_MEASUREMENT /end GROUP
/begin GROUP CDDInterface.MtrCurrDaxRef_IPM.Amp_f32 "MICROSAR RTE" /begin SUB_GROUP /end SUB_GROUP /begin FUNCTION_LIST /end FUNCTION_LIST /begin REF_CHARACTERISTIC /end REF_CHARACTERISTIC /begin REF_MEASUREMENT CDDInterface.MtrCurrDaxRef_IPM.Amp_f32 /end REF_MEASUREMENT /end GROUP
/begin GROUP CDDInterface.MtrCurrDaxRef_SPM.Amp_f32 "MICROSAR RTE" /begin SUB_GROUP /end SUB_GROUP /begin FUNCTION_LIST /end FUNCTION_LIST /begin REF_CHARACTERISTIC /end REF_CHARACTERISTIC /begin REF_MEASUREMENT CDDInterface.MtrCurrDaxRef_SPM.Amp_f32 /end REF_MEASUREMENT /end GROUP
/begin GROUP CDDInterface.MtrCurrK1.Amp_f32 "MICROSAR RTE" /begin SUB_GROUP /end SUB_GROUP /begin FUNCTION_LIST /end FUNCTION_LIST /begin REF_CHARACTERISTIC /end REF_CHARACTERISTIC /begin REF_MEASUREMENT CDDInterface.MtrCurrK1.Amp_f32 /end REF_MEASUREMENT /end GROUP
/begin GROUP CDDInterface.MtrCurrK2.Amp_f32 "MICROSAR RTE" /begin SUB_GROUP /end SUB_GROUP /begin FUNCTION_LIST /end FUNCTION_LIST /begin REF_CHARACTERISTIC /end REF_CHARACTERISTIC /begin REF_MEASUREMENT CDDInterface.MtrCurrK2.Amp_f32 /end REF_MEASUREMENT /end GROUP
/begin GROUP CDDInterface.MtrCurrQax.Amp_f32 "MICROSAR RTE" /begin SUB_GROUP /end SUB_GROUP /begin FUNCTION_LIST /end FUNCTION_LIST /begin REF_CHARACTERISTIC /end REF_CHARACTERISTIC /begin REF_MEASUREMENT CDDInterface.MtrCurrQax.Amp_f32 /end REF_MEASUREMENT /end GROUP
/begin GROUP CDDInterface.MtrCurrQax12Mag.Amp_f32 "MICROSAR RTE" /begin SUB_GROUP /end SUB_GROUP /begin FUNCTION_LIST /end FUNCTION_LIST /begin REF_CHARACTERISTIC /end REF_CHARACTERISTIC /begin REF_MEASUREMENT CDDInterface.MtrCurrQax12Mag.Amp_f32 /end REF_MEASUREMENT /end GROUP
/begin GROUP CDDInterface.MtrCurrQax12Ph.Rev_f32 "MICROSAR RTE" /begin SUB_GROUP /end SUB_GROUP /begin FUNCTION_LIST /end FUNCTION_LIST /begin REF_CHARACTERISTIC /end REF_CHARACTERISTIC /begin REF_MEASUREMENT CDDInterface.MtrCurrQax12Ph.Rev_f32 /end REF_MEASUREMENT /end GROUP
/begin GROUP CDDInterface.MtrCurrQax6Mag.Amp_f32 "MICROSAR RTE" /begin SUB_GROUP /end SUB_GROUP /begin FUNCTION_LIST /end FUNCTION_LIST /begin REF_CHARACTERISTIC /end REF_CHARACTERISTIC /begin REF_MEASUREMENT CDDInterface.MtrCurrQax6Mag.Amp_f32 /end REF_MEASUREMENT /end GROUP
/begin GROUP CDDInterface.MtrCurrQax6Ph.Rev_f32 "MICROSAR RTE" /begin SUB_GROUP /end SUB_GROUP /begin FUNCTION_LIST /end FUNCTION_LIST /begin REF_CHARACTERISTIC /end REF_CHARACTERISTIC /begin REF_MEASUREMENT CDDInterface.MtrCurrQax6Ph.Rev_f32 /end REF_MEASUREMENT /end GROUP
/begin GROUP CDDInterface.MtrCurrQaxFinalRef.Amp_f32 "MICROSAR RTE" /begin SUB_GROUP /end SUB_GROUP /begin FUNCTION_LIST /end FUNCTION_LIST /begin REF_CHARACTERISTIC /end REF_CHARACTERISTIC /begin REF_MEASUREMENT CDDInterface.MtrCurrQaxFinalRef.Amp_f32 /end REF_MEASUREMENT /end GROUP
/begin GROUP CDDInterface.MtrCurrQaxRef_IPM.Amp_f32 "MICROSAR RTE" /begin SUB_GROUP /end SUB_GROUP /begin FUNCTION_LIST /end FUNCTION_LIST /begin REF_CHARACTERISTIC /end REF_CHARACTERISTIC /begin REF_MEASUREMENT CDDInterface.MtrCurrQaxRef_IPM.Amp_f32 /end REF_MEASUREMENT /end GROUP
/begin GROUP CDDInterface.MtrCurrQaxRef_SPM.Amp_f32 "MICROSAR RTE" /begin SUB_GROUP /end SUB_GROUP /begin FUNCTION_LIST /end FUNCTION_LIST /begin REF_CHARACTERISTIC /end REF_CHARACTERISTIC /begin REF_MEASUREMENT CDDInterface.MtrCurrQaxRef_SPM.Amp_f32 /end REF_MEASUREMENT /end GROUP
/begin GROUP CDDInterface.MtrElecMechPolarity.Cnt_s08 "MICROSAR RTE" /begin SUB_GROUP /end SUB_GROUP /begin FUNCTION_LIST /end FUNCTION_LIST /begin REF_CHARACTERISTIC /end REF_CHARACTERISTIC /begin REF_MEASUREMENT CDDInterface.MtrElecMechPolarity.Cnt_s08 /end REF_MEASUREMENT /end GROUP
/begin GROUP CDDInterface.MtrParmNrmLrnSrlComSvcDft.Cnt_lgc "MICROSAR RTE" /begin SUB_GROUP /end SUB_GROUP /begin FUNCTION_LIST /end FUNCTION_LIST /begin REF_CHARACTERISTIC /end REF_CHARACTERISTIC /begin REF_MEASUREMENT CDDInterface.MtrParmNrmLrnSrlComSvcDft.Cnt_lgc /end REF_MEASUREMENT /end GROUP
/begin GROUP CDDInterface.MtrPosComputationDelay_IPM.Deg_f32 "MICROSAR RTE" /begin SUB_GROUP /end SUB_GROUP /begin FUNCTION_LIST /end FUNCTION_LIST /begin REF_CHARACTERISTIC /end REF_CHARACTERISTIC /begin REF_MEASUREMENT CDDInterface.MtrPosComputationDelay_IPM.Deg_f32 /end REF_MEASUREMENT /end GROUP
/begin GROUP CDDInterface.MtrPosComputationDelay_SPM.Deg_f32 "MICROSAR RTE" /begin SUB_GROUP /end SUB_GROUP /begin FUNCTION_LIST /end FUNCTION_LIST /begin REF_CHARACTERISTIC /end REF_CHARACTERISTIC /begin REF_MEASUREMENT CDDInterface.MtrPosComputationDelay_SPM.Deg_f32 /end REF_MEASUREMENT /end GROUP
/begin GROUP CDDInterface.MtrPosElec.Rev_f32 "MICROSAR RTE" /begin SUB_GROUP /end SUB_GROUP /begin FUNCTION_LIST /end FUNCTION_LIST /begin REF_CHARACTERISTIC /end REF_CHARACTERISTIC /begin REF_MEASUREMENT CDDInterface.MtrPosElec.Rev_f32 /end REF_MEASUREMENT /end GROUP
/begin GROUP CDDInterface.MtrPosMech.Rev_f32 "MICROSAR RTE" /begin SUB_GROUP /end SUB_GROUP /begin FUNCTION_LIST /end FUNCTION_LIST /begin REF_CHARACTERISTIC /end REF_CHARACTERISTIC /begin REF_MEASUREMENT CDDInterface.MtrPosMech.Rev_f32 /end REF_MEASUREMENT /end GROUP
/begin GROUP CDDInterface.MtrRevCntr.Cnt_s16 "MICROSAR RTE" /begin SUB_GROUP /end SUB_GROUP /begin FUNCTION_LIST /end FUNCTION_LIST /begin REF_CHARACTERISTIC /end REF_CHARACTERISTIC /begin REF_MEASUREMENT CDDInterface.MtrRevCntr.Cnt_s16 /end REF_MEASUREMENT /end GROUP
/begin GROUP CDDInterface.MtrTrqCmdSign_IPM.Cnt_s16 "MICROSAR RTE" /begin SUB_GROUP /end SUB_GROUP /begin FUNCTION_LIST /end FUNCTION_LIST /begin REF_CHARACTERISTIC /end REF_CHARACTERISTIC /begin REF_MEASUREMENT CDDInterface.MtrTrqCmdSign_IPM.Cnt_s16 /end REF_MEASUREMENT /end GROUP
/begin GROUP CDDInterface.MtrTrqCmdSign_SPM.Cnt_s16 "MICROSAR RTE" /begin SUB_GROUP /end SUB_GROUP /begin FUNCTION_LIST /end FUNCTION_LIST /begin REF_CHARACTERISTIC /end REF_CHARACTERISTIC /begin REF_MEASUREMENT CDDInterface.MtrTrqCmdSign_SPM.Cnt_s16 /end REF_MEASUREMENT /end GROUP
/begin GROUP CDDInterface.MtrVelNrmLrnSrlComSvcDft.Cnt_lgc "MICROSAR RTE" /begin SUB_GROUP /end SUB_GROUP /begin FUNCTION_LIST /end FUNCTION_LIST /begin REF_CHARACTERISTIC /end REF_CHARACTERISTIC /begin REF_MEASUREMENT CDDInterface.MtrVelNrmLrnSrlComSvcDft.Cnt_lgc /end REF_MEASUREMENT /end GROUP
/begin GROUP CDDInterface.MtrVoltDax.Volt_f32 "MICROSAR RTE" /begin SUB_GROUP /end SUB_GROUP /begin FUNCTION_LIST /end FUNCTION_LIST /begin REF_CHARACTERISTIC /end REF_CHARACTERISTIC /begin REF_MEASUREMENT CDDInterface.MtrVoltDax.Volt_f32 /end REF_MEASUREMENT /end GROUP
/begin GROUP CDDInterface.MtrVoltDaxFF_IPM.Volt_f32 "MICROSAR RTE" /begin SUB_GROUP /end SUB_GROUP /begin FUNCTION_LIST /end FUNCTION_LIST /begin REF_CHARACTERISTIC /end REF_CHARACTERISTIC /begin REF_MEASUREMENT CDDInterface.MtrVoltDaxFF_IPM.Volt_f32 /end REF_MEASUREMENT /end GROUP
/begin GROUP CDDInterface.MtrVoltDaxFF_SPM.Volt_f32 "MICROSAR RTE" /begin SUB_GROUP /end SUB_GROUP /begin FUNCTION_LIST /end FUNCTION_LIST /begin REF_CHARACTERISTIC /end REF_CHARACTERISTIC /begin REF_MEASUREMENT CDDInterface.MtrVoltDaxFF_SPM.Volt_f32 /end REF_MEASUREMENT /end GROUP
/begin GROUP CDDInterface.MtrVoltQax.Volt_f32 "MICROSAR RTE" /begin SUB_GROUP /end SUB_GROUP /begin FUNCTION_LIST /end FUNCTION_LIST /begin REF_CHARACTERISTIC /end REF_CHARACTERISTIC /begin REF_MEASUREMENT CDDInterface.MtrVoltQax.Volt_f32 /end REF_MEASUREMENT /end GROUP
/begin GROUP CDDInterface.MtrVoltQaxFF_IPM.Volt_f32 "MICROSAR RTE" /begin SUB_GROUP /end SUB_GROUP /begin FUNCTION_LIST /end FUNCTION_LIST /begin REF_CHARACTERISTIC /end REF_CHARACTERISTIC /begin REF_MEASUREMENT CDDInterface.MtrVoltQaxFF_IPM.Volt_f32 /end REF_MEASUREMENT /end GROUP
/begin GROUP CDDInterface.MtrVoltQaxFF_SPM.Volt_f32 "MICROSAR RTE" /begin SUB_GROUP /end SUB_GROUP /begin FUNCTION_LIST /end FUNCTION_LIST /begin REF_CHARACTERISTIC /end REF_CHARACTERISTIC /begin REF_MEASUREMENT CDDInterface.MtrVoltQaxFF_SPM.Volt_f32 /end REF_MEASUREMENT /end GROUP
/begin GROUP CDDInterface.MultIgnSrlComSvcDft.Cnt_lgc "MICROSAR RTE" /begin SUB_GROUP /end SUB_GROUP /begin FUNCTION_LIST /end FUNCTION_LIST /begin REF_CHARACTERISTIC /end REF_CHARACTERISTIC /begin REF_MEASUREMENT CDDInterface.MultIgnSrlComSvcDft.Cnt_lgc /end REF_MEASUREMENT /end GROUP
/begin GROUP CDDInterface.ParkAstSrlComSvcDft.Cnt_lgc "MICROSAR RTE" /begin SUB_GROUP /end SUB_GROUP /begin FUNCTION_LIST /end FUNCTION_LIST /begin REF_CHARACTERISTIC /end REF_CHARACTERISTIC /begin REF_MEASUREMENT CDDInterface.ParkAstSrlComSvcDft.Cnt_lgc /end REF_MEASUREMENT /end GROUP
/begin GROUP CDDInterface.PhsReasA.Volts_f32 "MICROSAR RTE" /begin SUB_GROUP /end SUB_GROUP /begin FUNCTION_LIST /end FUNCTION_LIST /begin REF_CHARACTERISTIC /end REF_CHARACTERISTIC /begin REF_MEASUREMENT CDDInterface.PhsReasA.Volts_f32 /end REF_MEASUREMENT /end GROUP
/begin GROUP CDDInterface.PhsReasB.Volts_f32 "MICROSAR RTE" /begin SUB_GROUP /end SUB_GROUP /begin FUNCTION_LIST /end FUNCTION_LIST /begin REF_CHARACTERISTIC /end REF_CHARACTERISTIC /begin REF_MEASUREMENT CDDInterface.PhsReasB.Volts_f32 /end REF_MEASUREMENT /end GROUP
/begin GROUP CDDInterface.PhsReasC.Volts_f32 "MICROSAR RTE" /begin SUB_GROUP /end SUB_GROUP /begin FUNCTION_LIST /end FUNCTION_LIST /begin REF_CHARACTERISTIC /end REF_CHARACTERISTIC /begin REF_MEASUREMENT CDDInterface.PhsReasC.Volts_f32 /end REF_MEASUREMENT /end GROUP
/begin GROUP CDDInterface.PullCompSrlComSvcDft.Cnt_lgc "MICROSAR RTE" /begin SUB_GROUP /end SUB_GROUP /begin FUNCTION_LIST /end FUNCTION_LIST /begin REF_CHARACTERISTIC /end REF_CHARACTERISTIC /begin REF_MEASUREMENT CDDInterface.PullCompSrlComSvcDft.Cnt_lgc /end REF_MEASUREMENT /end GROUP
/begin GROUP CDDInterface.QaxIntegralGain_IPM.Uls_f32 "MICROSAR RTE" /begin SUB_GROUP /end SUB_GROUP /begin FUNCTION_LIST /end FUNCTION_LIST /begin REF_CHARACTERISTIC /end REF_CHARACTERISTIC /begin REF_MEASUREMENT CDDInterface.QaxIntegralGain_IPM.Uls_f32 /end REF_MEASUREMENT /end GROUP
/begin GROUP CDDInterface.QaxIntegralGain_SPM.Uls_f32 "MICROSAR RTE" /begin SUB_GROUP /end SUB_GROUP /begin FUNCTION_LIST /end FUNCTION_LIST /begin REF_CHARACTERISTIC /end REF_CHARACTERISTIC /begin REF_MEASUREMENT CDDInterface.QaxIntegralGain_SPM.Uls_f32 /end REF_MEASUREMENT /end GROUP
/begin GROUP CDDInterface.QaxPropotionalGain_IPM.Uls_f32 "MICROSAR RTE" /begin SUB_GROUP /end SUB_GROUP /begin FUNCTION_LIST /end FUNCTION_LIST /begin REF_CHARACTERISTIC /end REF_CHARACTERISTIC /begin REF_MEASUREMENT CDDInterface.QaxPropotionalGain_IPM.Uls_f32 /end REF_MEASUREMENT /end GROUP
/begin GROUP CDDInterface.QaxPropotionalGain_SPM.Uls_f32 "MICROSAR RTE" /begin SUB_GROUP /end SUB_GROUP /begin FUNCTION_LIST /end FUNCTION_LIST /begin REF_CHARACTERISTIC /end REF_CHARACTERISTIC /begin REF_MEASUREMENT CDDInterface.QaxPropotionalGain_SPM.Uls_f32 /end REF_MEASUREMENT /end GROUP
/begin GROUP CDDInterface.ReceiverPorts "MICROSAR RTE"
 /begin SUB_GROUP CDDInterface.CommOffset.Cnt_u16 CDDInterface.DaxIntegralGain_IPM.Uls_f32 CDDInterface.DaxIntegralGain_SPM.Uls_f32 CDDInterface.DaxPropotionalGain_IPM.Uls_f32 CDDInterface.DaxPropotionalGain_SPM.Uls_f32 CDDInterface.EstKe.VpRadpS_f32 CDDInterface.FETFaultPhase.Cnt_enum CDDInterface.FETFaultType.Cnt_enum CDDInterface.MRFMtrVel.MtrRadpS_f32 CDDInterface.MtrCurr1TempOffset.Volt_f32 CDDInterface.MtrCurr2TempOffset.Volt_f32 CDDInterface.MtrCurrDaxRef_IPM.Amp_f32 CDDInterface.MtrCurrDaxRef_SPM.Amp_f32 CDDInterface.MtrCurrQax12Mag.Amp_f32 CDDInterface.MtrCurrQax12Ph.Rev_f32 CDDInterface.MtrCurrQax6Mag.Amp_f32 CDDInterface.MtrCurrQax6Ph.Rev_f32 CDDInterface.MtrCurrQaxRef_IPM.Amp_f32 CDDInterface.MtrCurrQaxRef_SPM.Amp_f32 CDDInterface.MtrElecMechPolarity.Cnt_s08 CDDInterface.MtrPosComputationDelay_IPM.Deg_f32 CDDInterface.MtrPosComputationDelay_SPM.Deg_f32 CDDInterface.MtrTrqCmdSign_IPM.Cnt_s16 CDDInterface.MtrTrqCmdSign_SPM.Cnt_s16 CDDInterface.MtrVoltDaxFF_IPM.Volt_f32 CDDInterface.MtrVoltDaxFF_SPM.Volt_f32 CDDInterface.MtrVoltQaxFF_IPM.Volt_f32 CDDInterface.MtrVoltQaxFF_SPM.Volt_f32 CDDInterface.QaxIntegralGain_IPM.Uls_f32 CDDInterface.QaxIntegralGain_SPM.Uls_f32 CDDInterface.QaxPropotionalGain_IPM.Uls_f32 CDDInterface.QaxPropotionalGain_SPM.Uls_f32 CDDInterface.Vecu.Volt_f32 /end SUB_GROUP
 /begin FUNCTION_LIST /end FUNCTION_LIST
 /begin REF_CHARACTERISTIC /end REF_CHARACTERISTIC
 /begin REF_MEASUREMENT /end REF_MEASUREMENT
/end GROUP
/begin GROUP CDDInterface.ReturnSrlComSvcDft.Cnt_lgc "MICROSAR RTE" /begin SUB_GROUP /end SUB_GROUP /begin FUNCTION_LIST /end FUNCTION_LIST /begin REF_CHARACTERISTIC /end REF_CHARACTERISTIC /begin REF_MEASUREMENT CDDInterface.ReturnSrlComSvcDft.Cnt_lgc /end REF_MEASUREMENT /end GROUP
/begin GROUP CDDInterface.RxMsgsSrlComSvcDft.Cnt_lgc "MICROSAR RTE" /begin SUB_GROUP /end SUB_GROUP /begin FUNCTION_LIST /end FUNCTION_LIST /begin REF_CHARACTERISTIC /end REF_CHARACTERISTIC /begin REF_MEASUREMENT CDDInterface.RxMsgsSrlComSvcDft.Cnt_lgc /end REF_MEASUREMENT /end GROUP
/begin GROUP CDDInterface.SenderPorts "MICROSAR RTE"
 /begin SUB_GROUP CDDInterface.ADCMtrCurr1.Volts_f32 CDDInterface.ADCMtrCurr2.Volts_f32 CDDInterface.CorrMtrCurrPosition.Rev_f32 CDDInterface.CorrMtrPosElec.Rev_f32 CDDInterface.Cos1Theta.Volts_f32 CDDInterface.DampingSrlComSvcDft.Cnt_lgc CDDInterface.DftAsstTbl.Cnt_lgc CDDInterface.DrivingDynSrlComSvcDft.Cnt_lgc CDDInterface.DutyCycleSmall.Cnt_u16 CDDInterface.DwnldAsstGain.Uls_f32 CDDInterface.EOTImpactSrlComSvcDft.Cnt_lgc CDDInterface.EOTThermalSrlComSvcDft.Cnt_lgc CDDInterface.EngONSrlComSvcDft.Cnt_lgc CDDInterface.ExpectedOnTimeA.Cnt_u32 CDDInterface.ExpectedOnTimeB.Cnt_u32 CDDInterface.ExpectedOnTimeC.Cnt_u32 CDDInterface.FreqDepDmpSrlComSvcDft.Cnt_lgc CDDInterface.FricLrnSrlComSvcDft.Cnt_lgc CDDInterface.HysAddSrlComSvcDft.Cnt_lgc CDDInterface.HystCompSrlComSvcDft.Cnt_lgc CDDInterface.IgnCnt.Cnt_u16 CDDInterface.KinIntDiagSrlComSvcDft.Cnt_lgc CDDInterface.LRPRPhaseadvanceCaptured.Cnt_s16 CDDInterface.LimitSrlComSvcDft.Cnt_lgc CDDInterface.MEC.Cnt_enum CDDInterface.MeasuredOnTimeA.Cnt_u32 CDDInterface.MeasuredOnTimeB.Cnt_u32 CDDInterface.MeasuredOnTimeC.Cnt_u32 CDDInterface.MfgDiagInhibit.Cnt_lgc CDDInterface.ModIdxFinal.Uls_f32 CDDInterface.ModIdxSrlComSvcDft.Cnt_lgc CDDInterface.MtrCurrDax.Amp_f32 CDDInterface.MtrCurrDaxRef.Amp_f32 CDDInterface.MtrCurrK1.Amp_f32 CDDInterface.MtrCurrK2.Amp_f32 CDDInterface.MtrCurrQax.Amp_f32 CDDInterface.MtrCurrQaxFinalRef.Amp_f32 CDDInterface.MtrParmNrmLrnSrlComSvcDft.Cnt_lgc CDDInterface.MtrPosElec.Rev_f32 CDDInterface.MtrPosMech.Rev_f32 CDDInterface.MtrRevCntr.Cnt_s16 CDDInterface.MtrVelNrmLrnSrlComSvcDft.Cnt_lgc CDDInterface.MtrVoltDax.Volt_f32 CDDInterface.MtrVoltQax.Volt_f32 CDDInterface.MultIgnSrlComSvcDft.Cnt_lgc CDDInterface.ParkAstSrlComSvcDft.Cnt_lgc CDDInterface.PhsReasA.Volts_f32 CDDInterface.PhsReasB.Volts_f32 CDDInterface.PhsReasC.Volts_f32 CDDInterface.PullCompSrlComSvcDft.Cnt_lgc CDDInterface.ReturnSrlComSvcDft.Cnt_lgc CDDInterface.RxMsgsSrlComSvcDft.Cnt_lgc CDDInterface.Sin1Theta.Volts_f32 CDDInterface.SrlComSvcDft.Cnt_b32 CDDInterface.SysCCorrectedMtrPos.Rev_f32 CDDInterface.TOEOLDisable.Cnt_lgc CDDInterface.ThermalDCSrlComSvcDft.Cnt_lgc CDDInterface.TrqRmpSrlComSvcDft.Cnt_lgc CDDInterface.WIREnabled.Cnt_lgc CDDInterface.WhlImbRejSrlComSvcDft.Cnt_lgc /end SUB_GROUP
 /begin FUNCTION_LIST /end FUNCTION_LIST
 /begin REF_CHARACTERISTIC /end REF_CHARACTERISTIC
 /begin REF_MEASUREMENT /end REF_MEASUREMENT
/end GROUP
/begin GROUP CDDInterface.Sin1Theta.Volts_f32 "MICROSAR RTE" /begin SUB_GROUP /end SUB_GROUP /begin FUNCTION_LIST /end FUNCTION_LIST /begin REF_CHARACTERISTIC /end REF_CHARACTERISTIC /begin REF_MEASUREMENT CDDInterface.Sin1Theta.Volts_f32 /end REF_MEASUREMENT /end GROUP
/begin GROUP CDDInterface.SrlComSvcDft.Cnt_b32 "MICROSAR RTE" /begin SUB_GROUP /end SUB_GROUP /begin FUNCTION_LIST /end FUNCTION_LIST /begin REF_CHARACTERISTIC /end REF_CHARACTERISTIC /begin REF_MEASUREMENT CDDInterface.SrlComSvcDft.Cnt_b32 /end REF_MEASUREMENT /end GROUP
/begin RECORD_LAYOUT RTE_RL_ULONG FNC_VALUES 1 ULONG ROW_DIR DIRECT /end RECORD_LAYOUT
/begin RECORD_LAYOUT RTE_RL_SBYTE FNC_VALUES 1 SBYTE ROW_DIR DIRECT /end RECORD_LAYOUT
/**********************************************************************************************************************
* COMPU_METHOD / COMPU_VTAB_RANGE
*********************************************************************************************************************/
/begin COMPU_METHOD RTE_CM_BOOLEAN "" TAB_VERB "%3.1" "" COMPU_TAB_REF RTE_CM_BOOLEAN /end COMPU_METHOD
/begin COMPU_VTAB_RANGE RTE_CM_BOOLEAN "" 2 0 0 "false" 1 255 "true" /end COMPU_VTAB_RANGE
/begin COMPU_METHOD RTE_CM_ENUM_StaMd_Mode "" TAB_VERB "%.1" "" COMPU_TAB_REF RTE_CM_ENUM_StaMd_Mode /end COMPU_METHOD
/begin COMPU_VTAB_RANGE RTE_CM_ENUM_StaMd_Mode "" 5 0 0 "RTE_MODE_StaMd_Mode_DISABLE" 1 1 "RTE_MODE_StaMd_Mode_OFF" 2 2 "RTE_MODE_StaMd_Mode_OPERATE" 3 3 "RTE_MODE_StaMd_Mode_WARMINIT" 4 4 "RTE_TRANSITION_StaMd_Mode" /end COMPU_VTAB_RANGE
/begin COMPU_METHOD RTE_CM_ENUM_ManufModeType "" TAB_VERB "%.1" "" COMPU_TAB_REF RTE_CM_ENUM_ManufModeType /end COMPU_METHOD
/begin COMPU_VTAB_RANGE RTE_CM_ENUM_ManufModeType "" 3 0 0 "ProductionMode" 1 1 "ManufacturingMode" 2 2 "EngineeringMode" /end COMPU_VTAB_RANGE
/begin COMPU_METHOD RTE_CM_ENUM_TOC_STATE "" TAB_VERB "%.1" "" COMPU_TAB_REF RTE_CM_ENUM_TOC_STATE /end COMPU_METHOD
/begin COMPU_VTAB_RANGE RTE_CM_ENUM_TOC_STATE "" 9 0 0 "TOCSTATE_OFF" 1 1 "TOCSTATE_TNA" 2 2 "TOCSTATE_PNA" 3 3 "TOCSTATE_READY" 4 4 "TOCSTATE_REQUESTDENIED" 5 5 "TOCSTATE_ACTIVEMODE05" 6 6 "TOCSTATE_ACTIVEMODE06" 7 7 "TOCSTATE_ACTIVEMODE07" 8 8 "TOCSTATE_NOTAVAILABLE" /end COMPU_VTAB_RANGE
/begin COMPU_METHOD RTE_CM_ENUM_FETPHASETYPE_ENUM "" TAB_VERB "%.1" "" COMPU_TAB_REF RTE_CM_ENUM_FETPHASETYPE_ENUM /end COMPU_METHOD
/begin COMPU_VTAB_RANGE RTE_CM_ENUM_FETPHASETYPE_ENUM "" 4 0 0 "NOPHASE" 1 1 "PHASEA" 2 2 "PHASEB" 3 3 "PHASEC" /end COMPU_VTAB_RANGE
/begin COMPU_METHOD RTE_CM_ENUM_FETFAULTTYPE_ENUM "" TAB_VERB "%.1" "" COMPU_TAB_REF RTE_CM_ENUM_FETFAULTTYPE_ENUM /end COMPU_METHOD
/begin COMPU_VTAB_RANGE RTE_CM_ENUM_FETFAULTTYPE_ENUM "" 3 0 0 "NOFAULT" 1 1 "LOWER" 2 2 "UPPER" /end COMPU_VTAB_RANGE
