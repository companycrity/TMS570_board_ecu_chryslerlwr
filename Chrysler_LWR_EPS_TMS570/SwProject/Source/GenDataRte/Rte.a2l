/**********************************************************************************************************************
* COPYRIGHT
* Copyright (c) 2006-2011 by Vector Informatik GmbH. All rights reserved.
* This software is copyright protected and proprietary to Vector Informatik GmbH.
* Vector Informatik GmbH grants to you only those rights as set out in the license conditions.
* All other rights remain with Vector Informatik GmbH.
* FILE DESCRIPTION
* File: Rte.a2l
* Workspace: C:/Sankar/Chrysler/Synergy/CL/Temp_work/Chrysler_LWR_EPS_TMS570/Tools/AsrProject/Config/DCF/EPS.dcf
* ECU-Project: EPS
* Generated at: Mon Jul 18 14:56:57 2016
* Generator: MICROSAR RTE Generator Version 2.19.1
* License: License CBD1010124 valid for CBD1010124 Nexteer Package: BMW MSR SIP BAC3.0 Micro: TI TMS570 TMS570LS30306 Compiler: Code Composer Studio 4.9.0
* Description: MICROSAR RTE A2L file
*********************************************************************************************************************/
/**********************************************************************************************************************
* MEASUREMENT
*********************************************************************************************************************/
/begin MEASUREMENT Ap_AbsHwPosScom.CRFCumMtrPos.Deg_f32 "MICROSAR RTE" FLOAT32_IEEE NO_COMPU_METHOD 0 0 1.175494351e-38 3.402823466e+38 ECU_ADDRESS 0 SYMBOL_LINK "Rte_MtrPos_CumMtrPosCRF_Deg_f32" 0 DISPLAY_IDENTIFIER Ap_AbsHwPosScom.ReceiverPorts.CRFCumMtrPos.Deg_f32 /end MEASUREMENT
/begin MEASUREMENT Ap_AbsHwPosScom.CRFMtrTrqCmd.MtrNm_f32 "MICROSAR RTE" FLOAT32_IEEE NO_COMPU_METHOD 0 0 1.175494351e-38 3.402823466e+38 ECU_ADDRESS 0 SYMBOL_LINK "Rte_CtrldDisShtdn_CntDisMtrTrqCmdCRF_MtrNm_f32" 0 DISPLAY_IDENTIFIER Ap_AbsHwPosScom.ReceiverPorts.CRFMtrTrqCmd.MtrNm_f32 /end MEASUREMENT
/begin MEASUREMENT Ap_AbsHwPosScom.CRFMtrVel.MtrRadpS_f32 "MICROSAR RTE" FLOAT32_IEEE NO_COMPU_METHOD 0 0 1.175494351e-38 3.402823466e+38 ECU_ADDRESS 0 SYMBOL_LINK "Rte_MtrVel_CRFMotorVel_MtrRadpS_f32" 0 DISPLAY_IDENTIFIER Ap_AbsHwPosScom.ReceiverPorts.CRFMtrVel.MtrRadpS_f32 /end MEASUREMENT
/begin MEASUREMENT Ap_AbsHwPosScom.DiagStsHwPosDis.Cnt_lgc "MICROSAR RTE" UBYTE RTE_CM_BOOLEAN 0 0 0 255 ECU_ADDRESS 0 SYMBOL_LINK "Rte_DiagMgr_DiagStsHWASbSystmFltPres_Cnt_lgc" 0 DISPLAY_IDENTIFIER Ap_AbsHwPosScom.ReceiverPorts.DiagStsHwPosDis.Cnt_lgc /end MEASUREMENT
/begin MEASUREMENT Ap_AbsHwPosScom.HwPos.HwDeg_f32 "MICROSAR RTE" FLOAT32_IEEE NO_COMPU_METHOD 0 0 1.175494351e-38 3.402823466e+38 ECU_ADDRESS 0 SYMBOL_LINK "Rte_Ap_AbsHwPosScom_HwPos_HwDeg_f32" 0 DISPLAY_IDENTIFIER Ap_AbsHwPosScom.SenderPorts.HwPos.HwDeg_f32 /end MEASUREMENT
/begin MEASUREMENT Ap_AbsHwPosScom.HwPosAuthority.Uls_f32 "MICROSAR RTE" FLOAT32_IEEE NO_COMPU_METHOD 0 0 1.175494351e-38 3.402823466e+38 ECU_ADDRESS 0 SYMBOL_LINK "Rte_Ap_AbsHwPosScom_HwPosAuthority_Uls_f32" 0 DISPLAY_IDENTIFIER Ap_AbsHwPosScom.SenderPorts.HwPosAuthority.Uls_f32 /end MEASUREMENT
/begin MEASUREMENT Ap_AbsHwPosScom.HwTrq.HwNm_f32 "MICROSAR RTE" FLOAT32_IEEE NO_COMPU_METHOD 0 0 1.175494351e-38 3.402823466e+38 ECU_ADDRESS 0 SYMBOL_LINK "Rte_HwTrq_AnaHwTorque_HwNm_f32" 0 DISPLAY_IDENTIFIER Ap_AbsHwPosScom.ReceiverPorts.HwTrq.HwNm_f32 /end MEASUREMENT
/begin MEASUREMENT Ap_AbsHwPosScom.KinIntDiagSrlComSvcDft.Cnt_lgc "MICROSAR RTE" UBYTE RTE_CM_BOOLEAN 0 0 0 255 ECU_ADDRESS 0 SYMBOL_LINK "Rte_CDDInterface_KinIntDiagSrlComSvcDft_Cnt_lgc" 0 DISPLAY_IDENTIFIER Ap_AbsHwPosScom.ReceiverPorts.KinIntDiagSrlComSvcDft.Cnt_lgc /end MEASUREMENT
/begin MEASUREMENT Ap_AbsHwPosScom.SComInpHwA.HwDeg_f32 "MICROSAR RTE" FLOAT32_IEEE NO_COMPU_METHOD 0 0 1.175494351e-38 3.402823466e+38 ECU_ADDRESS 0 SYMBOL_LINK "Rte_SrlComInput_StrgWhlAngl_HwDeg_f32" 0 DISPLAY_IDENTIFIER Ap_AbsHwPosScom.ReceiverPorts.SComInpHwA.HwDeg_f32 /end MEASUREMENT
/begin MEASUREMENT Ap_AbsHwPosScom.SComInpHwAValid.Cnt_lgc "MICROSAR RTE" UBYTE RTE_CM_BOOLEAN 0 0 0 255 ECU_ADDRESS 0 SYMBOL_LINK "Rte_SrlComInput_StrgWhlAnglValid_Cnt_lgc" 0 DISPLAY_IDENTIFIER Ap_AbsHwPosScom.ReceiverPorts.SComInpHwAValid.Cnt_lgc /end MEASUREMENT
/begin MEASUREMENT Ap_AbsHwPosScom.VehicleSpeed.Kph_f32 "MICROSAR RTE" FLOAT32_IEEE NO_COMPU_METHOD 0 0 1.175494351e-38 3.402823466e+38 ECU_ADDRESS 0 SYMBOL_LINK "Rte_Ap_SignlCondn_VehicleSpeed_Kph_f32" 0 DISPLAY_IDENTIFIER Ap_AbsHwPosScom.ReceiverPorts.VehicleSpeed.Kph_f32 /end MEASUREMENT
/begin MEASUREMENT Ap_AbsHwPosScom.VehicleSpeedValid.Cnt_lgc "MICROSAR RTE" UBYTE RTE_CM_BOOLEAN 0 0 0 255 ECU_ADDRESS 0 SYMBOL_LINK "Rte_SrlComInput_SrlComVehSpdValid_Cnt_lgc" 0 DISPLAY_IDENTIFIER Ap_AbsHwPosScom.ReceiverPorts.VehicleSpeedValid.Cnt_lgc /end MEASUREMENT
/begin MEASUREMENT Ap_ActivePull.DisableLearning.Cnt_lgc "MICROSAR RTE" UBYTE RTE_CM_BOOLEAN 0 0 0 255 ECU_ADDRESS 0 SYMBOL_LINK "Rte_Ap_ArbLmt_PICmpDisableLearning_Cnt_lgc" 0 DISPLAY_IDENTIFIER Ap_ActivePull.ReceiverPorts.DisableLearning.Cnt_lgc /end MEASUREMENT
/begin MEASUREMENT Ap_ActivePull.DisableOutput.Cnt_lgc "MICROSAR RTE" UBYTE RTE_CM_BOOLEAN 0 0 0 255 ECU_ADDRESS 0 SYMBOL_LINK "Rte_CDDInterface_PullCompSrlComSvcDft_Cnt_lgc" 0 DISPLAY_IDENTIFIER Ap_ActivePull.ReceiverPorts.DisableOutput.Cnt_lgc /end MEASUREMENT
/begin MEASUREMENT Ap_ActivePull.HandwheelAuthority.Uls_f32 "MICROSAR RTE" FLOAT32_IEEE NO_COMPU_METHOD 0 0 1.175494351e-38 3.402823466e+38 ECU_ADDRESS 0 SYMBOL_LINK "Rte_Ap_AbsHwPosScom_HwPosAuthority_Uls_f32" 0 DISPLAY_IDENTIFIER Ap_ActivePull.ReceiverPorts.HandwheelAuthority.Uls_f32 /end MEASUREMENT
/begin MEASUREMENT Ap_ActivePull.HandwheelPosition.HwDeg_f32 "MICROSAR RTE" FLOAT32_IEEE NO_COMPU_METHOD 0 0 1.175494351e-38 3.402823466e+38 ECU_ADDRESS 0 SYMBOL_LINK "Rte_Ap_AbsHwPosScom_HwPos_HwDeg_f32" 0 DISPLAY_IDENTIFIER Ap_ActivePull.ReceiverPorts.HandwheelPosition.HwDeg_f32 /end MEASUREMENT
/begin MEASUREMENT Ap_ActivePull.HandwheelVelocity.HwRadpS_f32 "MICROSAR RTE" FLOAT32_IEEE NO_COMPU_METHOD 0 0 1.175494351e-38 3.402823466e+38 ECU_ADDRESS 0 SYMBOL_LINK "Rte_MtrVel_HandwheelVel_HwRadpS_f32" 0 DISPLAY_IDENTIFIER Ap_ActivePull.ReceiverPorts.HandwheelVelocity.HwRadpS_f32 /end MEASUREMENT
/begin MEASUREMENT Ap_ActivePull.HwTorque.HwNm_f32 "MICROSAR RTE" FLOAT32_IEEE NO_COMPU_METHOD 0 0 1.175494351e-38 3.402823466e+38 ECU_ADDRESS 0 SYMBOL_LINK "Rte_HwTrq_AnaHwTorque_HwNm_f32" 0 DISPLAY_IDENTIFIER Ap_ActivePull.ReceiverPorts.HwTorque.HwNm_f32 /end MEASUREMENT
/begin MEASUREMENT Ap_ActivePull.PullCompCmd.MtrNm_f32 "MICROSAR RTE" FLOAT32_IEEE NO_COMPU_METHOD 0 0 1.175494351e-38 3.402823466e+38 ECU_ADDRESS 0 SYMBOL_LINK "Rte_Ap_ActivePull_PullCompCmd_MtrNm_f32" 0 DISPLAY_IDENTIFIER Ap_ActivePull.SenderPorts.PullCompCmd.MtrNm_f32 /end MEASUREMENT
/begin MEASUREMENT Ap_ActivePull.SrlComYawRate.DegpS_f32 "MICROSAR RTE" FLOAT32_IEEE NO_COMPU_METHOD 0 0 1.175494351e-38 3.402823466e+38 ECU_ADDRESS 0 SYMBOL_LINK "Rte_Ap_ActivePull_SrlComYawRate_DegpS_f32" 0 DISPLAY_IDENTIFIER Ap_ActivePull.ReceiverPorts.SrlComYawRate.DegpS_f32 /end MEASUREMENT
/begin MEASUREMENT Ap_ActivePull.SystemState.Mode "MICROSAR RTE" UBYTE RTE_CM_ENUM_StaMd_Mode 0 0 0 255 ECU_ADDRESS 0 SYMBOL_LINK "Rte_ModeMachine_Ap_StaMd9_SystemState9_Mode" 0 DISPLAY_IDENTIFIER Ap_ActivePull.ModeRequirePorts.SystemState.Mode /end MEASUREMENT
/begin MEASUREMENT Ap_ActivePull.VehicleSpeed.Kph_f32 "MICROSAR RTE" FLOAT32_IEEE NO_COMPU_METHOD 0 0 1.175494351e-38 3.402823466e+38 ECU_ADDRESS 0 SYMBOL_LINK "Rte_Ap_SignlCondn_VehicleSpeed_Kph_f32" 0 DISPLAY_IDENTIFIER Ap_ActivePull.ReceiverPorts.VehicleSpeed.Kph_f32 /end MEASUREMENT
/begin MEASUREMENT Ap_ActivePull.VehicleSpeedValid.Cnt_lgc "MICROSAR RTE" UBYTE RTE_CM_BOOLEAN 0 0 0 255 ECU_ADDRESS 0 SYMBOL_LINK "Rte_SrlComInput_SrlComVehSpdValid_Cnt_lgc" 0 DISPLAY_IDENTIFIER Ap_ActivePull.ReceiverPorts.VehicleSpeedValid.Cnt_lgc /end MEASUREMENT
/begin MEASUREMENT Ap_ArbLmt.ActiveFunctionBits.Cnt_u08 "MICROSAR RTE" UBYTE NO_COMPU_METHOD 0 0 0 255 ECU_ADDRESS 0 SYMBOL_LINK "Rte_Ap_ArbLmt_ActiveFunctionBits_Cnt_u08" 0 DISPLAY_IDENTIFIER Ap_ArbLmt.SenderPorts.ActiveFunctionBits.Cnt_u08 /end MEASUREMENT
/begin MEASUREMENT Ap_ArbLmt.DSTActive.Cnt_lgc "MICROSAR RTE" UBYTE RTE_CM_BOOLEAN 0 0 0 255 ECU_ADDRESS 0 SYMBOL_LINK "Rte_Ap_StbCTO_DSTActive_Cnt_lgc" 0 DISPLAY_IDENTIFIER Ap_ArbLmt.ReceiverPorts.DSTActive.Cnt_lgc /end MEASUREMENT
/begin MEASUREMENT Ap_ArbLmt.DSTSlewComplete.Cnt_lgc "MICROSAR RTE" UBYTE RTE_CM_BOOLEAN 0 0 0 255 ECU_ADDRESS 0 SYMBOL_LINK "Rte_Ap_ArbLmt_DSTSlewComplete_Cnt_lgc" 0 DISPLAY_IDENTIFIER Ap_ArbLmt.SenderPorts.DSTSlewComplete.Cnt_lgc /end MEASUREMENT
/begin MEASUREMENT Ap_ArbLmt.DSTState.Cnt_u08 "MICROSAR RTE" UBYTE NO_COMPU_METHOD 0 0 0 255 ECU_ADDRESS 0 SYMBOL_LINK "Rte_Ap_StbCTO_DSTState_Cnt_u08" 0 DISPLAY_IDENTIFIER Ap_ArbLmt.ReceiverPorts.DSTState.Cnt_u08 /end MEASUREMENT
/begin MEASUREMENT Ap_ArbLmt.DSTTrqOvCmdRqst.HwNm_f32 "MICROSAR RTE" FLOAT32_IEEE NO_COMPU_METHOD 0 0 1.175494351e-38 3.402823466e+38 ECU_ADDRESS 0 SYMBOL_LINK "Rte_SrlComInput_DSTTrqOvCmdRqst_HwNm_f32" 0 DISPLAY_IDENTIFIER Ap_ArbLmt.ReceiverPorts.DSTTrqOvCmdRqst.HwNm_f32 /end MEASUREMENT
/begin MEASUREMENT Ap_ArbLmt.HaLFActive.Cnt_lgc "MICROSAR RTE" UBYTE RTE_CM_BOOLEAN 0 0 0 255 ECU_ADDRESS 0 SYMBOL_LINK "Rte_Ap_HaLFTO_HaLFActive_Cnt_lgc" 0 DISPLAY_IDENTIFIER Ap_ArbLmt.ReceiverPorts.HaLFActive.Cnt_lgc /end MEASUREMENT
/begin MEASUREMENT Ap_ArbLmt.HaLFSlewComplete.Cnt_lgc "MICROSAR RTE" UBYTE RTE_CM_BOOLEAN 0 0 0 255 ECU_ADDRESS 0 SYMBOL_LINK "Rte_Ap_ArbLmt_HaLFSlewComplete_Cnt_lgc" 0 DISPLAY_IDENTIFIER Ap_ArbLmt.SenderPorts.HaLFSlewComplete.Cnt_lgc /end MEASUREMENT
/begin MEASUREMENT Ap_ArbLmt.HaLFTOState.Cnt_u08 "MICROSAR RTE" UBYTE NO_COMPU_METHOD 0 0 0 255 ECU_ADDRESS 0 SYMBOL_LINK "Rte_Ap_HaLFTO_HaLFState_Cnt_u08" 0 DISPLAY_IDENTIFIER Ap_ArbLmt.ReceiverPorts.HaLFTOState.Cnt_u08 /end MEASUREMENT
/begin MEASUREMENT Ap_ArbLmt.HaLFTrqOvCmdRqst.MtrNm_f32 "MICROSAR RTE" FLOAT32_IEEE NO_COMPU_METHOD 0 0 1.175494351e-38 3.402823466e+38 ECU_ADDRESS 0 SYMBOL_LINK "Rte_SrlComInput_HaLFTrqOvCmdRqst_MtrNm_f32" 0 DISPLAY_IDENTIFIER Ap_ArbLmt.ReceiverPorts.HaLFTrqOvCmdRqst.MtrNm_f32 /end MEASUREMENT
/begin MEASUREMENT Ap_ArbLmt.IpTrqOvr.HwNm_f32 "MICROSAR RTE" FLOAT32_IEEE NO_COMPU_METHOD 0 0 1.175494351e-38 3.402823466e+38 ECU_ADDRESS 0 SYMBOL_LINK "Rte_Ap_ArbLmt_IpTrqOvr_HwNm_f32" 0 DISPLAY_IDENTIFIER Ap_ArbLmt.SenderPorts.IpTrqOvr.HwNm_f32 /end MEASUREMENT
/begin MEASUREMENT Ap_ArbLmt.OpTrqOvr.MtrNm_f32 "MICROSAR RTE" FLOAT32_IEEE NO_COMPU_METHOD 0 0 1.175494351e-38 3.402823466e+38 ECU_ADDRESS 0 SYMBOL_LINK "Rte_Ap_ArbLmt_OpTrqOvr_MtrNm_f32" 0 DISPLAY_IDENTIFIER Ap_ArbLmt.SenderPorts.OpTrqOvr.MtrNm_f32 /end MEASUREMENT
/begin MEASUREMENT Ap_ArbLmt.PAReturnSclFct.Uls_f32 "MICROSAR RTE" FLOAT32_IEEE NO_COMPU_METHOD 0 0 1.175494351e-38 3.402823466e+38 ECU_ADDRESS 0 SYMBOL_LINK "Rte_Ap_ArbLmt_PAReturnSclFct_Uls_f32" 0 DISPLAY_IDENTIFIER Ap_ArbLmt.SenderPorts.PAReturnSclFct.Uls_f32 /end MEASUREMENT
/begin MEASUREMENT Ap_ArbLmt.PATrqOvCmdRqst.HwNm_f32 "MICROSAR RTE" FLOAT32_IEEE NO_COMPU_METHOD 0 0 1.175494351e-38 3.402823466e+38 ECU_ADDRESS 0 SYMBOL_LINK "Rte_SrlComInput_PATrqOvCmdRqst_HwNm_f32" 0 DISPLAY_IDENTIFIER Ap_ArbLmt.ReceiverPorts.PATrqOvCmdRqst.HwNm_f32 /end MEASUREMENT
/begin MEASUREMENT Ap_ArbLmt.PrkAssistState.Cnt_u08 "MICROSAR RTE" UBYTE NO_COMPU_METHOD 0 0 0 255 ECU_ADDRESS 0 SYMBOL_LINK "Rte_Ap_PAwTO_PrkAssistState_Cnt_u08" 0 DISPLAY_IDENTIFIER Ap_ArbLmt.ReceiverPorts.PrkAssistState.Cnt_u08 /end MEASUREMENT
/begin MEASUREMENT Ap_ArbLmt.PrkAsstSlewComplete.Cnt_lgc "MICROSAR RTE" UBYTE RTE_CM_BOOLEAN 0 0 0 255 ECU_ADDRESS 0 SYMBOL_LINK "Rte_Ap_ArbLmt_PrkAsstSlewComplete_Cnt_lgc" 0 DISPLAY_IDENTIFIER Ap_ArbLmt.SenderPorts.PrkAsstSlewComplete.Cnt_lgc /end MEASUREMENT
/begin MEASUREMENT Ap_ArbLmt.VehicleSpeed.Kph_f32 "MICROSAR RTE" FLOAT32_IEEE NO_COMPU_METHOD 0 0 1.175494351e-38 3.402823466e+38 ECU_ADDRESS 0 SYMBOL_LINK "Rte_Ap_SignlCondn_VehicleSpeed_Kph_f32" 0 DISPLAY_IDENTIFIER Ap_ArbLmt.ReceiverPorts.VehicleSpeed.Kph_f32 /end MEASUREMENT
/begin MEASUREMENT Ap_AssistFirewall.AsstFirewallActive.Uls_f32 "MICROSAR RTE" FLOAT32_IEEE NO_COMPU_METHOD 0 0 1.175494351e-38 3.402823466e+38 ECU_ADDRESS 0 SYMBOL_LINK "Rte_Ap_AssistFirewall_AsstFirewallActive_Uls_f32" 0 DISPLAY_IDENTIFIER Ap_AssistFirewall.SenderPorts.AsstFirewallActive.Uls_f32 /end MEASUREMENT
/begin MEASUREMENT Ap_AssistFirewall.BaseAssistCmd.MtrNm_f32 "MICROSAR RTE" FLOAT32_IEEE NO_COMPU_METHOD 0 0 1.175494351e-38 3.402823466e+38 ECU_ADDRESS 0 SYMBOL_LINK "Rte_Assist_BaseAssistCmd_MtrNm_f32" 0 DISPLAY_IDENTIFIER Ap_AssistFirewall.ReceiverPorts.BaseAssistCmd.MtrNm_f32 /end MEASUREMENT
/begin MEASUREMENT Ap_AssistFirewall.CombinedAssist.MtrNm_f32 "MICROSAR RTE" FLOAT32_IEEE NO_COMPU_METHOD 0 0 1.175494351e-38 3.402823466e+38 ECU_ADDRESS 0 SYMBOL_LINK "Rte_Ap_AssistFirewall_CombinedAssist_MtrNm_f32" 0 DISPLAY_IDENTIFIER Ap_AssistFirewall.SenderPorts.CombinedAssist.MtrNm_f32 /end MEASUREMENT
/begin MEASUREMENT Ap_AssistFirewall.Defeat_AsstTbl_Service.Cnt_lgc "MICROSAR RTE" UBYTE RTE_CM_BOOLEAN 0 0 0 255 ECU_ADDRESS 0 SYMBOL_LINK "Rte_CDDInterface_DftAsstTbl_Cnt_lgc" 0 DISPLAY_IDENTIFIER Ap_AssistFirewall.ReceiverPorts.Defeat_AsstTbl_Service.Cnt_lgc /end MEASUREMENT
/begin MEASUREMENT Ap_AssistFirewall.HighFreqAssist.MtrNm_f32 "MICROSAR RTE" FLOAT32_IEEE NO_COMPU_METHOD 0 0 1.175494351e-38 3.402823466e+38 ECU_ADDRESS 0 SYMBOL_LINK "Rte_HighFreqAssist_HighFreqAssist_MtrNm_f32" 0 DISPLAY_IDENTIFIER Ap_AssistFirewall.ReceiverPorts.HighFreqAssist.MtrNm_f32 /end MEASUREMENT
/begin MEASUREMENT Ap_AssistFirewall.HwTorque.HwNm_f32 "MICROSAR RTE" FLOAT32_IEEE NO_COMPU_METHOD 0 0 1.175494351e-38 3.402823466e+38 ECU_ADDRESS 0 SYMBOL_LINK "Rte_HwTrq_AnaHwTorque_HwNm_f32" 0 DISPLAY_IDENTIFIER Ap_AssistFirewall.ReceiverPorts.HwTorque.HwNm_f32 /end MEASUREMENT
/begin MEASUREMENT Ap_AssistFirewall.HysteresisComp.MtrNm_f32 "MICROSAR RTE" FLOAT32_IEEE NO_COMPU_METHOD 0 0 1.175494351e-38 3.402823466e+38 ECU_ADDRESS 0 SYMBOL_LINK "Rte_HystComp_HysteresisComp_MtrNm_f32" 0 DISPLAY_IDENTIFIER Ap_AssistFirewall.ReceiverPorts.HysteresisComp.MtrNm_f32 /end MEASUREMENT
/begin MEASUREMENT Ap_AssistFirewall.MEC_Counter.Cnt_enum "MICROSAR RTE" UBYTE RTE_CM_ENUM_ManufModeType 0 0 0 2 ECU_ADDRESS 0 SYMBOL_LINK "Rte_CDDInterface_MEC_Cnt_enum" 0 DISPLAY_IDENTIFIER Ap_AssistFirewall.ReceiverPorts.MEC_Counter.Cnt_enum /end MEASUREMENT
/begin MEASUREMENT Ap_AssistFirewall.VehicleSpeed.Kph_f32 "MICROSAR RTE" FLOAT32_IEEE NO_COMPU_METHOD 0 0 1.175494351e-38 3.402823466e+38 ECU_ADDRESS 0 SYMBOL_LINK "Rte_Ap_SignlCondn_VehicleSpeed_Kph_f32" 0 DISPLAY_IDENTIFIER Ap_AssistFirewall.ReceiverPorts.VehicleSpeed.Kph_f32 /end MEASUREMENT
/begin MEASUREMENT Ap_AstLmt.AssistCmd.MtrNm_f32 "MICROSAR RTE" FLOAT32_IEEE NO_COMPU_METHOD 0 0 1.175494351e-38 3.402823466e+38 ECU_ADDRESS 0 SYMBOL_LINK "Rte_StabilityComp_AssistCmd_MtrNm_f32" 0 DISPLAY_IDENTIFIER Ap_AstLmt.ReceiverPorts.AssistCmd.MtrNm_f32 /end MEASUREMENT
/begin MEASUREMENT Ap_AstLmt.AssistEOTDamping.MtrNm_f32 "MICROSAR RTE" FLOAT32_IEEE NO_COMPU_METHOD 0 0 1.175494351e-38 3.402823466e+38 ECU_ADDRESS 0 SYMBOL_LINK "Rte_EOTActuatorMng_AssistEOTDamping_MtrNm_f32" 0 DISPLAY_IDENTIFIER Ap_AstLmt.ReceiverPorts.AssistEOTDamping.MtrNm_f32 /end MEASUREMENT
/begin MEASUREMENT Ap_AstLmt.AssistEOTGain.Uls_f32 "MICROSAR RTE" FLOAT32_IEEE NO_COMPU_METHOD 0 0 1.175494351e-38 3.402823466e+38 ECU_ADDRESS 0 SYMBOL_LINK "Rte_Ap_LmtCod_EOTGainLtd_Uls_f32" 0 DISPLAY_IDENTIFIER Ap_AstLmt.ReceiverPorts.AssistEOTGain.Uls_f32 /end MEASUREMENT
/begin MEASUREMENT Ap_AstLmt.AssistEOTLimit.MtrNm_f32 "MICROSAR RTE" FLOAT32_IEEE NO_COMPU_METHOD 0 0 1.175494351e-38 3.402823466e+38 ECU_ADDRESS 0 SYMBOL_LINK "Rte_Ap_LmtCod_EOTLimitLtd_MtrNm_f32" 0 DISPLAY_IDENTIFIER Ap_AstLmt.ReceiverPorts.AssistEOTLimit.MtrNm_f32 /end MEASUREMENT
/begin MEASUREMENT Ap_AstLmt.AssistStallLimit.MtrNm_f32 "MICROSAR RTE" FLOAT32_IEEE NO_COMPU_METHOD 0 0 1.175494351e-38 3.402823466e+38 ECU_ADDRESS 0 SYMBOL_LINK "Rte_Ap_LmtCod_StallLimitLtd_MtrNm_f32" 0 DISPLAY_IDENTIFIER Ap_AstLmt.ReceiverPorts.AssistStallLimit.MtrNm_f32 /end MEASUREMENT
/begin MEASUREMENT Ap_AstLmt.AssistVehSpdLimit.MtrNm_f32 "MICROSAR RTE" FLOAT32_IEEE NO_COMPU_METHOD 0 0 1.175494351e-38 3.402823466e+38 ECU_ADDRESS 0 SYMBOL_LINK "Rte_Ap_LmtCod_VehSpdLimitLtd_MtrNm_f32" 0 DISPLAY_IDENTIFIER Ap_AstLmt.ReceiverPorts.AssistVehSpdLimit.MtrNm_f32 /end MEASUREMENT
/begin MEASUREMENT Ap_AstLmt.CombinedDamping.MtrNm_f32 "MICROSAR RTE" FLOAT32_IEEE NO_COMPU_METHOD 0 0 1.175494351e-38 3.402823466e+38 ECU_ADDRESS 0 SYMBOL_LINK "Rte_Ap_DampingFirewall_CombinedDamping_MtrNm_f32" 0 DISPLAY_IDENTIFIER Ap_AstLmt.ReceiverPorts.CombinedDamping.MtrNm_f32 /end MEASUREMENT
/begin MEASUREMENT Ap_AstLmt.DefeatLimitService.Cnt_lgc "MICROSAR RTE" UBYTE RTE_CM_BOOLEAN 0 0 0 255 ECU_ADDRESS 0 SYMBOL_LINK "Rte_CDDInterface_LimitSrlComSvcDft_Cnt_lgc" 0 DISPLAY_IDENTIFIER Ap_AstLmt.ReceiverPorts.DefeatLimitService.Cnt_lgc /end MEASUREMENT
/begin MEASUREMENT Ap_AstLmt.LimitPercentFiltered.Uls_f32 "MICROSAR RTE" FLOAT32_IEEE NO_COMPU_METHOD 0 0 1.175494351e-38 3.402823466e+38 ECU_ADDRESS 0 SYMBOL_LINK "Rte_Ap_AstLmt_LimitPercentFiltered_Uls_f32" 0 DISPLAY_IDENTIFIER Ap_AstLmt.SenderPorts.LimitPercentFiltered.Uls_f32 /end MEASUREMENT
/begin MEASUREMENT Ap_AstLmt.LimitedReturn.MtrNm_f32 "MICROSAR RTE" FLOAT32_IEEE NO_COMPU_METHOD 0 0 1.175494351e-38 3.402823466e+38 ECU_ADDRESS 0 SYMBOL_LINK "Rte_Ap_ReturnFirewall_LimitedReturn_MtrNm_f32" 0 DISPLAY_IDENTIFIER Ap_AstLmt.ReceiverPorts.LimitedReturn.MtrNm_f32 /end MEASUREMENT
/begin MEASUREMENT Ap_AstLmt.LrnPnCtrCCDisable.Cnt_lgc "MICROSAR RTE" UBYTE RTE_CM_BOOLEAN 0 0 0 255 ECU_ADDRESS 0 SYMBOL_LINK "Rte_Ap_AstLmt_LrnPnCtrCCDisable_Cnt_lgc" 0 DISPLAY_IDENTIFIER Ap_AstLmt.ReceiverPorts.LrnPnCtrCCDisable.Cnt_lgc /end MEASUREMENT
/begin MEASUREMENT Ap_AstLmt.LrnPnCtrEnable.Cnt_lgc "MICROSAR RTE" UBYTE RTE_CM_BOOLEAN 0 0 0 255 ECU_ADDRESS 0 SYMBOL_LINK "Rte_Ap_AstLmt_LrnPnCtrEnable_Cnt_lgc" 0 DISPLAY_IDENTIFIER Ap_AstLmt.ReceiverPorts.LrnPnCtrEnable.Cnt_lgc /end MEASUREMENT
/begin MEASUREMENT Ap_AstLmt.LrnPnCtrTCmd.MtrNm_f32 "MICROSAR RTE" FLOAT32_IEEE NO_COMPU_METHOD 0 0 1.175494351e-38 3.402823466e+38 ECU_ADDRESS 0 SYMBOL_LINK "Rte_Ap_AstLmt_LrnPnCtrTCmd_MtrNm_f32" 0 DISPLAY_IDENTIFIER Ap_AstLmt.ReceiverPorts.LrnPnCtrTCmd.MtrNm_f32 /end MEASUREMENT
/begin MEASUREMENT Ap_AstLmt.OpTrqOvr.MtrNm_f32 "MICROSAR RTE" FLOAT32_IEEE NO_COMPU_METHOD 0 0 1.175494351e-38 3.402823466e+38 ECU_ADDRESS 0 SYMBOL_LINK "Rte_Ap_ArbLmt_OpTrqOvr_MtrNm_f32" 0 DISPLAY_IDENTIFIER Ap_AstLmt.ReceiverPorts.OpTrqOvr.MtrNm_f32 /end MEASUREMENT
/begin MEASUREMENT Ap_AstLmt.OutputRampMult.Uls_f32 "MICROSAR RTE" FLOAT32_IEEE NO_COMPU_METHOD 0 0 1.175494351e-38 3.402823466e+38 ECU_ADDRESS 0 SYMBOL_LINK "Rte_Ap_LmtCod_OutputRampMultLtd_Uls_f32" 0 DISPLAY_IDENTIFIER Ap_AstLmt.ReceiverPorts.OutputRampMult.Uls_f32 /end MEASUREMENT
/begin MEASUREMENT Ap_AstLmt.PosServCCDisable.Cnt_lgc "MICROSAR RTE" UBYTE RTE_CM_BOOLEAN 0 0 0 255 ECU_ADDRESS 0 SYMBOL_LINK "Rte_Ap_AstLmt_PosServCCDisable_Cnt_lgc" 0 DISPLAY_IDENTIFIER Ap_AstLmt.ReceiverPorts.PosServCCDisable.Cnt_lgc /end MEASUREMENT
/begin MEASUREMENT Ap_AstLmt.PowerLimitPerc.Uls_f32 "MICROSAR RTE" FLOAT32_IEEE NO_COMPU_METHOD 0 0 1.175494351e-38 3.402823466e+38 ECU_ADDRESS 0 SYMBOL_LINK "Rte_Ap_PwrLmtFuncCr_FltTrqLmt_Uls_f32" 0 DISPLAY_IDENTIFIER Ap_AstLmt.ReceiverPorts.PowerLimitPerc.Uls_f32 /end MEASUREMENT
/begin MEASUREMENT Ap_AstLmt.PreLimitForStall.MtrNm_f32 "MICROSAR RTE" FLOAT32_IEEE NO_COMPU_METHOD 0 0 1.175494351e-38 3.402823466e+38 ECU_ADDRESS 0 SYMBOL_LINK "Rte_Ap_AstLmt_PreLimitForStall_MtrNm_f32" 0 DISPLAY_IDENTIFIER Ap_AstLmt.SenderPorts.PreLimitForStall.MtrNm_f32 /end MEASUREMENT
/begin MEASUREMENT Ap_AstLmt.PreLimitTorque.MtrNm_f32 "MICROSAR RTE" FLOAT32_IEEE NO_COMPU_METHOD 0 0 1.175494351e-38 3.402823466e+38 ECU_ADDRESS 0 SYMBOL_LINK "Rte_Ap_AstLmt_PreLimitTorque_MtrNm_f32" 0 DISPLAY_IDENTIFIER Ap_AstLmt.SenderPorts.PreLimitTorque.MtrNm_f32 /end MEASUREMENT
/begin MEASUREMENT Ap_AstLmt.PrkAssistCmd.MtrNm_f32 "MICROSAR RTE" FLOAT32_IEEE NO_COMPU_METHOD 0 0 1.175494351e-38 3.402823466e+38 ECU_ADDRESS 0 SYMBOL_LINK "Rte_Ap_AstLmt_PrkAssistCmd_MtrNm_f32" 0 DISPLAY_IDENTIFIER Ap_AstLmt.ReceiverPorts.PrkAssistCmd.MtrNm_f32 /end MEASUREMENT
/begin MEASUREMENT Ap_AstLmt.PullCompCmd.MtrNm_f32 "MICROSAR RTE" FLOAT32_IEEE NO_COMPU_METHOD 0 0 1.175494351e-38 3.402823466e+38 ECU_ADDRESS 0 SYMBOL_LINK "Rte_Ap_ActivePull_PullCompCmd_MtrNm_f32" 0 DISPLAY_IDENTIFIER Ap_AstLmt.ReceiverPorts.PullCompCmd.MtrNm_f32 /end MEASUREMENT
/begin MEASUREMENT Ap_AstLmt.SteerAsstDefeat "MICROSAR RTE" UBYTE RTE_CM_BOOLEAN 0 0 0 255 ECU_ADDRESS 0 SYMBOL_LINK "Rte_Ap_AstLmt_SteerAsstDefeat" 0 DISPLAY_IDENTIFIER Ap_AstLmt.PerInstanceMemories.SteerAsstDefeat READ_WRITE /end MEASUREMENT
/begin MEASUREMENT Ap_AstLmt.SumLimTrqCmd.MtrNm_f32 "MICROSAR RTE" FLOAT32_IEEE NO_COMPU_METHOD 0 0 1.175494351e-38 3.402823466e+38 ECU_ADDRESS 0 SYMBOL_LINK "Rte_Ap_AstLmt_SumLimTrqCmd_MtrNm_f32" 0 DISPLAY_IDENTIFIER Ap_AstLmt.SenderPorts.SumLimTrqCmd.MtrNm_f32 /end MEASUREMENT
/begin MEASUREMENT Ap_AstLmt.ThermalLimit.MtrNm_f32 "MICROSAR RTE" FLOAT32_IEEE NO_COMPU_METHOD 0 0 1.175494351e-38 3.402823466e+38 ECU_ADDRESS 0 SYMBOL_LINK "Rte_Ap_LmtCod_ThermalLimitLtd_MtrNm_f32" 0 DISPLAY_IDENTIFIER Ap_AstLmt.ReceiverPorts.ThermalLimit.MtrNm_f32 /end MEASUREMENT
/begin MEASUREMENT Ap_AstLmt.ThermalLimitPerc.Uls_f32 "MICROSAR RTE" FLOAT32_IEEE NO_COMPU_METHOD 0 0 1.175494351e-38 3.402823466e+38 ECU_ADDRESS 0 SYMBOL_LINK "Rte_Ap_ThrmlDutyCycle_ThermLimitPerc_Uls_f32" 0 DISPLAY_IDENTIFIER Ap_AstLmt.ReceiverPorts.ThermalLimitPerc.Uls_f32 /end MEASUREMENT
/begin MEASUREMENT Ap_AstLmt.TrqLimitMin.MtrNm_f32 "MICROSAR RTE" FLOAT32_IEEE NO_COMPU_METHOD 0 0 1.175494351e-38 3.402823466e+38 ECU_ADDRESS 0 SYMBOL_LINK "Rte_Ap_AstLmt_TrqLimitMin_MtrNm_f32" 0 DISPLAY_IDENTIFIER Ap_AstLmt.SenderPorts.TrqLimitMin.MtrNm_f32 /end MEASUREMENT
/begin MEASUREMENT Ap_AstLmt.VehSpd.Kph_f32 "MICROSAR RTE" FLOAT32_IEEE NO_COMPU_METHOD 0 0 1.175494351e-38 3.402823466e+38 ECU_ADDRESS 0 SYMBOL_LINK "Rte_Ap_SignlCondn_VehicleSpeed_Kph_f32" 0 DISPLAY_IDENTIFIER Ap_AstLmt.ReceiverPorts.VehSpd.Kph_f32 /end MEASUREMENT
/begin MEASUREMENT Ap_AstLmt.WheelImbalanceCmd.MtrNm_f32 "MICROSAR RTE" FLOAT32_IEEE NO_COMPU_METHOD 0 0 1.175494351e-38 3.402823466e+38 ECU_ADDRESS 0 SYMBOL_LINK "Rte_Ap_WhlImbRej_WhlImbRejCmd_MtrNm_f32" 0 DISPLAY_IDENTIFIER Ap_AstLmt.ReceiverPorts.WheelImbalanceCmd.MtrNm_f32 /end MEASUREMENT
/begin MEASUREMENT Ap_AvgFricLrn.AvgFricLrnData.EOLFric_HwNm_f32 "MICROSAR RTE" FLOAT32_IEEE NO_COMPU_METHOD 0 0 1.175494351e-38 3.402823466e+38 ECU_ADDRESS 0 SYMBOL_LINK "Rte_Ap_AvgFricLrn_AvgFricLrnData.EOLFric_HwNm_f32" 0 DISPLAY_IDENTIFIER Ap_AvgFricLrn.PerInstanceMemories.AvgFricLrnData.EOLFric_HwNm_f32 READ_WRITE /end MEASUREMENT
/begin MEASUREMENT Ap_AvgFricLrn.AvgFricLrnData.EnableFricLearning_Cnt_lgc "MICROSAR RTE" UBYTE RTE_CM_BOOLEAN 0 0 0 255 ECU_ADDRESS 0 SYMBOL_LINK "Rte_Ap_AvgFricLrn_AvgFricLrnData.EnableFricLearning_Cnt_lgc" 0 DISPLAY_IDENTIFIER Ap_AvgFricLrn.PerInstanceMemories.AvgFricLrnData.EnableFricLearning_Cnt_lgc READ_WRITE /end MEASUREMENT
/begin MEASUREMENT Ap_AvgFricLrn.AvgFricLrnData.EnableFricOffsetOutput_Cnt_lgc "MICROSAR RTE" UBYTE RTE_CM_BOOLEAN 0 0 0 255 ECU_ADDRESS 0 SYMBOL_LINK "Rte_Ap_AvgFricLrn_AvgFricLrnData.EnableFricOffsetOutput_Cnt_lgc" 0 DISPLAY_IDENTIFIER Ap_AvgFricLrn.PerInstanceMemories.AvgFricLrnData.EnableFricOffsetOutput_Cnt_lgc READ_WRITE /end MEASUREMENT
/begin MEASUREMENT Ap_AvgFricLrn.AvgFricLrnData.FricOffset_HwNm_f32 "MICROSAR RTE" FLOAT32_IEEE NO_COMPU_METHOD 0 0 1.175494351e-38 3.402823466e+38 ECU_ADDRESS 0 SYMBOL_LINK "Rte_Ap_AvgFricLrn_AvgFricLrnData.FricOffset_HwNm_f32" 0 DISPLAY_IDENTIFIER Ap_AvgFricLrn.PerInstanceMemories.AvgFricLrnData.FricOffset_HwNm_f32 READ_WRITE /end MEASUREMENT
/begin MEASUREMENT Ap_AvgFricLrn.AvgFricLrnData.OpMode_Cnt_enum "MICROSAR RTE" UBYTE NO_COMPU_METHOD 0 0 0 255 ECU_ADDRESS 0 SYMBOL_LINK "Rte_Ap_AvgFricLrn_AvgFricLrnData.OpMode_Cnt_enum" 0 DISPLAY_IDENTIFIER Ap_AvgFricLrn.PerInstanceMemories.AvgFricLrnData.OpMode_Cnt_enum READ_WRITE /end MEASUREMENT
/begin MEASUREMENT Ap_AvgFricLrn.AvgFricLrnData.RangeCounter_Cnt_u16 "MICROSAR RTE" UWORD NO_COMPU_METHOD 0 0 0 65535 MATRIX_DIM 8 3 1 ECU_ADDRESS 0 SYMBOL_LINK "Rte_Ap_AvgFricLrn_AvgFricLrnData.RangeCounter_Cnt_u16" 0 DISPLAY_IDENTIFIER Ap_AvgFricLrn.PerInstanceMemories.AvgFricLrnData.RangeCounter_Cnt_u16 READ_WRITE /end MEASUREMENT
/begin MEASUREMENT Ap_AvgFricLrn.AvgFricLrnData.Theta_HwNm_f32 "MICROSAR RTE" FLOAT32_IEEE NO_COMPU_METHOD 0 0 1.175494351e-38 3.402823466e+38 MATRIX_DIM 8 4 1 ECU_ADDRESS 0 SYMBOL_LINK "Rte_Ap_AvgFricLrn_AvgFricLrnData.Theta_HwNm_f32" 0 DISPLAY_IDENTIFIER Ap_AvgFricLrn.PerInstanceMemories.AvgFricLrnData.Theta_HwNm_f32 READ_WRITE /end MEASUREMENT
/begin MEASUREMENT Ap_AvgFricLrn.AvgFricLrnData.VehLearnedFric_HwNm_f32 "MICROSAR RTE" FLOAT32_IEEE NO_COMPU_METHOD 0 0 1.175494351e-38 3.402823466e+38 MATRIX_DIM 4 1 1 ECU_ADDRESS 0 SYMBOL_LINK "Rte_Ap_AvgFricLrn_AvgFricLrnData.VehLearnedFric_HwNm_f32" 0 DISPLAY_IDENTIFIER Ap_AvgFricLrn.PerInstanceMemories.AvgFricLrnData.VehLearnedFric_HwNm_f32 READ_WRITE /end MEASUREMENT
/begin MEASUREMENT Ap_AvgFricLrn.CRFMtrTrq.MtrNm_f32 "MICROSAR RTE" FLOAT32_IEEE NO_COMPU_METHOD 0 0 1.175494351e-38 3.402823466e+38 ECU_ADDRESS 0 SYMBOL_LINK "Rte_CtrldDisShtdn_CntDisMtrTrqCmdCRF_MtrNm_f32" 0 DISPLAY_IDENTIFIER Ap_AvgFricLrn.ReceiverPorts.CRFMtrTrq.MtrNm_f32 /end MEASUREMENT
/begin MEASUREMENT Ap_AvgFricLrn.DefeatFricLearning.Cnt_lgc "MICROSAR RTE" UBYTE RTE_CM_BOOLEAN 0 0 0 255 ECU_ADDRESS 0 SYMBOL_LINK "Rte_CDDInterface_FricLrnSrlComSvcDft_Cnt_lgc" 0 DISPLAY_IDENTIFIER Ap_AvgFricLrn.ReceiverPorts.DefeatFricLearning.Cnt_lgc /end MEASUREMENT
/begin MEASUREMENT Ap_AvgFricLrn.EstFric.HwNm_f32 "MICROSAR RTE" FLOAT32_IEEE NO_COMPU_METHOD 0 0 1.175494351e-38 3.402823466e+38 ECU_ADDRESS 0 SYMBOL_LINK "Rte_Ap_AvgFricLrn_EstFric_HwNm_f32" 0 DISPLAY_IDENTIFIER Ap_AvgFricLrn.SenderPorts.EstFric.HwNm_f32 /end MEASUREMENT
/begin MEASUREMENT Ap_AvgFricLrn.FricOffset.HwNm_f32 "MICROSAR RTE" FLOAT32_IEEE NO_COMPU_METHOD 0 0 1.175494351e-38 3.402823466e+38 ECU_ADDRESS 0 SYMBOL_LINK "Rte_Ap_AvgFricLrn_FricOffset_HwNm_f32" 0 DISPLAY_IDENTIFIER Ap_AvgFricLrn.SenderPorts.FricOffset.HwNm_f32 /end MEASUREMENT
/begin MEASUREMENT Ap_AvgFricLrn.HwAng.HwDeg_f32 "MICROSAR RTE" FLOAT32_IEEE NO_COMPU_METHOD 0 0 1.175494351e-38 3.402823466e+38 ECU_ADDRESS 0 SYMBOL_LINK "Rte_Ap_AbsHwPosScom_HwPos_HwDeg_f32" 0 DISPLAY_IDENTIFIER Ap_AvgFricLrn.ReceiverPorts.HwAng.HwDeg_f32 /end MEASUREMENT
/begin MEASUREMENT Ap_AvgFricLrn.HwPosAuthority.Uls_f32 "MICROSAR RTE" FLOAT32_IEEE NO_COMPU_METHOD 0 0 1.175494351e-38 3.402823466e+38 ECU_ADDRESS 0 SYMBOL_LINK "Rte_Ap_AbsHwPosScom_HwPosAuthority_Uls_f32" 0 DISPLAY_IDENTIFIER Ap_AvgFricLrn.ReceiverPorts.HwPosAuthority.Uls_f32 /end MEASUREMENT
/begin MEASUREMENT Ap_AvgFricLrn.HwTrq.HwNm_f32 "MICROSAR RTE" FLOAT32_IEEE NO_COMPU_METHOD 0 0 1.175494351e-38 3.402823466e+38 ECU_ADDRESS 0 SYMBOL_LINK "Rte_HwTrq_AnaHwTorque_HwNm_f32" 0 DISPLAY_IDENTIFIER Ap_AvgFricLrn.ReceiverPorts.HwTrq.HwNm_f32 /end MEASUREMENT
/begin MEASUREMENT Ap_AvgFricLrn.HwVel.HwRadpS_f32 "MICROSAR RTE" FLOAT32_IEEE NO_COMPU_METHOD 0 0 1.175494351e-38 3.402823466e+38 ECU_ADDRESS 0 SYMBOL_LINK "Rte_MtrVel_HandwheelVel_HwRadpS_f32" 0 DISPLAY_IDENTIFIER Ap_AvgFricLrn.ReceiverPorts.HwVel.HwRadpS_f32 /end MEASUREMENT
/begin MEASUREMENT Ap_AvgFricLrn.SatEstFric.HwNm_f32 "MICROSAR RTE" FLOAT32_IEEE NO_COMPU_METHOD 0 0 1.175494351e-38 3.402823466e+38 ECU_ADDRESS 0 SYMBOL_LINK "Rte_Ap_AvgFricLrn_SatEstFric_HwNm_f32" 0 DISPLAY_IDENTIFIER Ap_AvgFricLrn.SenderPorts.SatEstFric.HwNm_f32 /end MEASUREMENT
/begin MEASUREMENT Ap_AvgFricLrn.SystemState.Mode "MICROSAR RTE" UBYTE RTE_CM_ENUM_StaMd_Mode 0 0 0 255 ECU_ADDRESS 0 SYMBOL_LINK "Rte_ModeMachine_Ap_StaMd9_SystemState9_Mode" 0 DISPLAY_IDENTIFIER Ap_AvgFricLrn.ModeRequirePorts.SystemState.Mode /end MEASUREMENT
/begin MEASUREMENT Ap_AvgFricLrn.Temperature.DegC_f32 "MICROSAR RTE" FLOAT32_IEEE NO_COMPU_METHOD 0 0 1.175494351e-38 3.402823466e+38 ECU_ADDRESS 0 SYMBOL_LINK "Rte_Ap_MtrTempEst_AssistMechTempEst_DegC_f32" 0 DISPLAY_IDENTIFIER Ap_AvgFricLrn.ReceiverPorts.Temperature.DegC_f32 /end MEASUREMENT
/begin MEASUREMENT Ap_AvgFricLrn.VehSpd.Kph_f32 "MICROSAR RTE" FLOAT32_IEEE NO_COMPU_METHOD 0 0 1.175494351e-38 3.402823466e+38 ECU_ADDRESS 0 SYMBOL_LINK "Rte_Ap_SignlCondn_VehicleSpeed_Kph_f32" 0 DISPLAY_IDENTIFIER Ap_AvgFricLrn.ReceiverPorts.VehSpd.Kph_f32 /end MEASUREMENT
/begin MEASUREMENT Ap_AvgFricLrn.VehicleSpeedValid.Cnt_lgc "MICROSAR RTE" UBYTE RTE_CM_BOOLEAN 0 0 0 255 ECU_ADDRESS 0 SYMBOL_LINK "Rte_SrlComInput_SrlComVehSpdValid_Cnt_lgc" 0 DISPLAY_IDENTIFIER Ap_AvgFricLrn.ReceiverPorts.VehicleSpeedValid.Cnt_lgc /end MEASUREMENT
/begin MEASUREMENT Ap_BVDiag.Batt.Volt_f32 "This signal is intended to communicate any type voltage signal measured by the ecu.  This signal has a lower limit of 0 which reequires users of the signal to provide divide by 0 protection if it is used as a denominator in a calculation.  See Vecu port p" FLOAT32_IEEE NO_COMPU_METHOD 0 0 1.175494351e-38 3.402823466e+38 ECU_ADDRESS 0 SYMBOL_LINK "Rte_IoHwAbstractionUsr_Batt_Volt_f32" 0 DISPLAY_IDENTIFIER Ap_BVDiag.ReceiverPorts.Batt.Volt_f32 /end MEASUREMENT
/begin MEASUREMENT Ap_BVDiag.CCLMSAActive.Cnt_lgc "MICROSAR RTE" UBYTE RTE_CM_BOOLEAN 0 0 0 255 ECU_ADDRESS 0 SYMBOL_LINK "Rte_Ap_BVDiag_CCLMSAActive_Cnt_lgc" 0 DISPLAY_IDENTIFIER Ap_BVDiag.ReceiverPorts.CCLMSAActive.Cnt_lgc /end MEASUREMENT
/begin MEASUREMENT Ap_DampingFirewall.AsstFirewallActive.Uls_f32 "MICROSAR RTE" FLOAT32_IEEE NO_COMPU_METHOD 0 0 1.175494351e-38 3.402823466e+38 ECU_ADDRESS 0 SYMBOL_LINK "Rte_Ap_AssistFirewall_AsstFirewallActive_Uls_f32" 0 DISPLAY_IDENTIFIER Ap_DampingFirewall.ReceiverPorts.AsstFirewallActive.Uls_f32 /end MEASUREMENT
/begin MEASUREMENT Ap_DampingFirewall.BaseAssistCmd.MtrNm_f32 "MICROSAR RTE" FLOAT32_IEEE NO_COMPU_METHOD 0 0 1.175494351e-38 3.402823466e+38 ECU_ADDRESS 0 SYMBOL_LINK "Rte_Assist_BaseAssistCmd_MtrNm_f32" 0 DISPLAY_IDENTIFIER Ap_DampingFirewall.ReceiverPorts.BaseAssistCmd.MtrNm_f32 /end MEASUREMENT
/begin MEASUREMENT Ap_DampingFirewall.CombinedDamping.MtrNm_f32 "MICROSAR RTE" FLOAT32_IEEE NO_COMPU_METHOD 0 0 1.175494351e-38 3.402823466e+38 ECU_ADDRESS 0 SYMBOL_LINK "Rte_Ap_DampingFirewall_CombinedDamping_MtrNm_f32" 0 DISPLAY_IDENTIFIER Ap_DampingFirewall.SenderPorts.CombinedDamping.MtrNm_f32 /end MEASUREMENT
/begin MEASUREMENT Ap_DampingFirewall.DampingCmd.MtrNm_f32 "MICROSAR RTE" FLOAT32_IEEE NO_COMPU_METHOD 0 0 1.175494351e-38 3.402823466e+38 ECU_ADDRESS 0 SYMBOL_LINK "Rte_Damping_DampingCmd_MtrNm_f32" 0 DISPLAY_IDENTIFIER Ap_DampingFirewall.ReceiverPorts.DampingCmd.MtrNm_f32 /end MEASUREMENT
/begin MEASUREMENT Ap_DampingFirewall.Defeat_Damping_Svc.Cnt_lgc "MICROSAR RTE" UBYTE RTE_CM_BOOLEAN 0 0 0 255 ECU_ADDRESS 0 SYMBOL_LINK "Rte_CDDInterface_DampingSrlComSvcDft_Cnt_lgc" 0 DISPLAY_IDENTIFIER Ap_DampingFirewall.ReceiverPorts.Defeat_Damping_Svc.Cnt_lgc /end MEASUREMENT
/begin MEASUREMENT Ap_DampingFirewall.FreqDepDmpSrlComSvcDft.Cnt_lgc "MICROSAR RTE" UBYTE RTE_CM_BOOLEAN 0 0 0 255 ECU_ADDRESS 0 SYMBOL_LINK "Rte_CDDInterface_FreqDepDmpSrlComSvcDft_Cnt_lgc" 0 DISPLAY_IDENTIFIER Ap_DampingFirewall.ReceiverPorts.FreqDepDmpSrlComSvcDft.Cnt_lgc /end MEASUREMENT
/begin MEASUREMENT Ap_DampingFirewall.HwTorque.HwNm_f32 "MICROSAR RTE" FLOAT32_IEEE NO_COMPU_METHOD 0 0 1.175494351e-38 3.402823466e+38 ECU_ADDRESS 0 SYMBOL_LINK "Rte_HwTrq_AnaHwTorque_HwNm_f32" 0 DISPLAY_IDENTIFIER Ap_DampingFirewall.ReceiverPorts.HwTorque.HwNm_f32 /end MEASUREMENT
/begin MEASUREMENT Ap_DampingFirewall.InertiaComp.MtrNm_f32 "MICROSAR RTE" FLOAT32_IEEE NO_COMPU_METHOD 0 0 1.175494351e-38 3.402823466e+38 ECU_ADDRESS 0 SYMBOL_LINK "Rte_FrqDepDmpnInrtCmp_FrqDepDmpnInrtCmp_MtrNm_f32" 0 DISPLAY_IDENTIFIER Ap_DampingFirewall.ReceiverPorts.InertiaComp.MtrNm_f32 /end MEASUREMENT
/begin MEASUREMENT Ap_DampingFirewall.MEC_Counter.Cnt_enum "MICROSAR RTE" UBYTE RTE_CM_ENUM_ManufModeType 0 0 0 2 ECU_ADDRESS 0 SYMBOL_LINK "Rte_CDDInterface_MEC_Cnt_enum" 0 DISPLAY_IDENTIFIER Ap_DampingFirewall.ReceiverPorts.MEC_Counter.Cnt_enum /end MEASUREMENT
/begin MEASUREMENT Ap_DampingFirewall.MtrVelCRF.MtrRadpS_f32 "MICROSAR RTE" FLOAT32_IEEE NO_COMPU_METHOD 0 0 1.175494351e-38 3.402823466e+38 ECU_ADDRESS 0 SYMBOL_LINK "Rte_MtrVel_CRFMotorVel_MtrRadpS_f32" 0 DISPLAY_IDENTIFIER Ap_DampingFirewall.ReceiverPorts.MtrVelCRF.MtrRadpS_f32 /end MEASUREMENT
/begin MEASUREMENT Ap_DampingFirewall.VehicleLonAccel.KphpS_f32 "MICROSAR RTE" FLOAT32_IEEE NO_COMPU_METHOD 0 0 1.175494351e-38 3.402823466e+38 ECU_ADDRESS 0 SYMBOL_LINK "Rte_Ap_SignlCondn_Vehicle_LonAccel_KphpS_f32" 0 DISPLAY_IDENTIFIER Ap_DampingFirewall.ReceiverPorts.VehicleLonAccel.KphpS_f32 /end MEASUREMENT
/begin MEASUREMENT Ap_DampingFirewall.VehicleSpeed.Kph_f32 "MICROSAR RTE" FLOAT32_IEEE NO_COMPU_METHOD 0 0 1.175494351e-38 3.402823466e+38 ECU_ADDRESS 0 SYMBOL_LINK "Rte_Ap_SignlCondn_VehicleSpeed_Kph_f32" 0 DISPLAY_IDENTIFIER Ap_DampingFirewall.ReceiverPorts.VehicleSpeed.Kph_f32 /end MEASUREMENT
/begin MEASUREMENT Ap_DampingFirewall.WIRCmdAmpBlnd.MtrNm_f32 "MICROSAR RTE" FLOAT32_IEEE NO_COMPU_METHOD 0 0 1.175494351e-38 3.402823466e+38 ECU_ADDRESS 0 SYMBOL_LINK "Rte_Ap_WhlImbRej_WIRCmdAmpBlnd_MtrNm_f32" 0 DISPLAY_IDENTIFIER Ap_DampingFirewall.ReceiverPorts.WIRCmdAmpBlnd.MtrNm_f32 /end MEASUREMENT
/begin MEASUREMENT Ap_DiagMgr8.HwTrq.HwNm_f32 "MICROSAR RTE" FLOAT32_IEEE NO_COMPU_METHOD 0 0 1.175494351e-38 3.402823466e+38 ECU_ADDRESS 0 SYMBOL_LINK "Rte_HwTrq_AnaHwTorque_HwNm_f32" 0 DISPLAY_IDENTIFIER Ap_DiagMgr8.ReceiverPorts.HwTrq.HwNm_f32 /end MEASUREMENT
/begin MEASUREMENT Ap_DiagMgr8.IgnCnt.Cnt_u16 "MICROSAR RTE" UWORD NO_COMPU_METHOD 0 0 0 65535 ECU_ADDRESS 0 SYMBOL_LINK "Rte_CDDInterface_IgnCnt_Cnt_u16" 0 DISPLAY_IDENTIFIER Ap_DiagMgr8.ReceiverPorts.IgnCnt.Cnt_u16 /end MEASUREMENT
/begin MEASUREMENT Ap_DiagMgr8.MEC.Cnt_enum "MICROSAR RTE" UBYTE RTE_CM_ENUM_ManufModeType 0 0 0 2 ECU_ADDRESS 0 SYMBOL_LINK "Rte_CDDInterface_MEC_Cnt_enum" 0 DISPLAY_IDENTIFIER Ap_DiagMgr8.ReceiverPorts.MEC.Cnt_enum /end MEASUREMENT
/begin MEASUREMENT Ap_DiagMgr8.MfgDiagInhibit.Cnt_lgc "MICROSAR RTE" UBYTE RTE_CM_BOOLEAN 0 0 0 255 ECU_ADDRESS 0 SYMBOL_LINK "Rte_CDDInterface_MfgDiagInhibit_Cnt_lgc" 0 DISPLAY_IDENTIFIER Ap_DiagMgr8.ReceiverPorts.MfgDiagInhibit.Cnt_lgc /end MEASUREMENT
/begin MEASUREMENT Ap_DiagMgr8.MtrTrq.MtrNm_f32 "MICROSAR RTE" FLOAT32_IEEE NO_COMPU_METHOD 0 0 1.175494351e-38 3.402823466e+38 ECU_ADDRESS 0 SYMBOL_LINK "Rte_Ap_PwrLmtFuncCr_MRFMtrTrqCmd_MtrNm_f32" 0 DISPLAY_IDENTIFIER Ap_DiagMgr8.ReceiverPorts.MtrTrq.MtrNm_f32 /end MEASUREMENT
/begin MEASUREMENT Ap_DiagMgr8.SystemState.Mode "MICROSAR RTE" UBYTE RTE_CM_ENUM_StaMd_Mode 0 0 0 255 ECU_ADDRESS 0 SYMBOL_LINK "Rte_ModeMachine_Ap_StaMd8_SystemState8_Mode" 0 DISPLAY_IDENTIFIER Ap_DiagMgr8.ModeRequirePorts.SystemState.Mode /end MEASUREMENT
/begin MEASUREMENT Ap_DiagMgr8.VehSpd.Kph_f32 "MICROSAR RTE" FLOAT32_IEEE NO_COMPU_METHOD 0 0 1.175494351e-38 3.402823466e+38 ECU_ADDRESS 0 SYMBOL_LINK "Rte_Ap_SignlCondn_VehicleSpeed_Kph_f32" 0 DISPLAY_IDENTIFIER Ap_DiagMgr8.ReceiverPorts.VehSpd.Kph_f32 /end MEASUREMENT
/begin MEASUREMENT Ap_DiagMgr9.HwTrq.HwNm_f32 "MICROSAR RTE" FLOAT32_IEEE NO_COMPU_METHOD 0 0 1.175494351e-38 3.402823466e+38 ECU_ADDRESS 0 SYMBOL_LINK "Rte_HwTrq_AnaHwTorque_HwNm_f32" 0 DISPLAY_IDENTIFIER Ap_DiagMgr9.ReceiverPorts.HwTrq.HwNm_f32 /end MEASUREMENT
/begin MEASUREMENT Ap_DiagMgr9.IgnCnt.Cnt_u16 "MICROSAR RTE" UWORD NO_COMPU_METHOD 0 0 0 65535 ECU_ADDRESS 0 SYMBOL_LINK "Rte_CDDInterface_IgnCnt_Cnt_u16" 0 DISPLAY_IDENTIFIER Ap_DiagMgr9.ReceiverPorts.IgnCnt.Cnt_u16 /end MEASUREMENT
/begin MEASUREMENT Ap_DiagMgr9.MEC.Cnt_enum "MICROSAR RTE" UBYTE RTE_CM_ENUM_ManufModeType 0 0 0 2 ECU_ADDRESS 0 SYMBOL_LINK "Rte_CDDInterface_MEC_Cnt_enum" 0 DISPLAY_IDENTIFIER Ap_DiagMgr9.ReceiverPorts.MEC.Cnt_enum /end MEASUREMENT
/begin MEASUREMENT Ap_DiagMgr9.MfgDiagInhibit.Cnt_lgc "MICROSAR RTE" UBYTE RTE_CM_BOOLEAN 0 0 0 255 ECU_ADDRESS 0 SYMBOL_LINK "Rte_CDDInterface_MfgDiagInhibit_Cnt_lgc" 0 DISPLAY_IDENTIFIER Ap_DiagMgr9.ReceiverPorts.MfgDiagInhibit.Cnt_lgc /end MEASUREMENT
/begin MEASUREMENT Ap_DiagMgr9.MtrTrq.MtrNm_f32 "MICROSAR RTE" FLOAT32_IEEE NO_COMPU_METHOD 0 0 1.175494351e-38 3.402823466e+38 ECU_ADDRESS 0 SYMBOL_LINK "Rte_Ap_PwrLmtFuncCr_MRFMtrTrqCmd_MtrNm_f32" 0 DISPLAY_IDENTIFIER Ap_DiagMgr9.ReceiverPorts.MtrTrq.MtrNm_f32 /end MEASUREMENT
/begin MEASUREMENT Ap_DiagMgr9.SystemState.Mode "MICROSAR RTE" UBYTE RTE_CM_ENUM_StaMd_Mode 0 0 0 255 ECU_ADDRESS 0 SYMBOL_LINK "Rte_ModeMachine_Ap_StaMd9_SystemState9_Mode" 0 DISPLAY_IDENTIFIER Ap_DiagMgr9.ModeRequirePorts.SystemState.Mode /end MEASUREMENT
/begin MEASUREMENT Ap_DiagMgr9.VehSpd.Kph_f32 "MICROSAR RTE" FLOAT32_IEEE NO_COMPU_METHOD 0 0 1.175494351e-38 3.402823466e+38 ECU_ADDRESS 0 SYMBOL_LINK "Rte_Ap_SignlCondn_VehicleSpeed_Kph_f32" 0 DISPLAY_IDENTIFIER Ap_DiagMgr9.ReceiverPorts.VehSpd.Kph_f32 /end MEASUREMENT
/begin MEASUREMENT Ap_ElePwr.ElectricPower.Watt_f32 "MICROSAR RTE" FLOAT32_IEEE NO_COMPU_METHOD 0 0 1.175494351e-38 3.402823466e+38 ECU_ADDRESS 0 SYMBOL_LINK "Rte_Ap_ElePwr_ElectricPower_Watt_f32" 0 DISPLAY_IDENTIFIER Ap_ElePwr.SenderPorts.ElectricPower.Watt_f32 /end MEASUREMENT
/begin MEASUREMENT Ap_ElePwr.MtrCurrDax.Amp_f32 "MICROSAR RTE" FLOAT32_IEEE NO_COMPU_METHOD 0 0 1.175494351e-38 3.402823466e+38 ECU_ADDRESS 0 SYMBOL_LINK "Rte_CDDInterface_MtrCurrDax_Amp_f32" 0 DISPLAY_IDENTIFIER Ap_ElePwr.ReceiverPorts.MtrCurrDax.Amp_f32 /end MEASUREMENT
/begin MEASUREMENT Ap_ElePwr.MtrCurrQax.Amp_f32 "MICROSAR RTE" FLOAT32_IEEE NO_COMPU_METHOD 0 0 1.175494351e-38 3.402823466e+38 ECU_ADDRESS 0 SYMBOL_LINK "Rte_CDDInterface_MtrCurrQax_Amp_f32" 0 DISPLAY_IDENTIFIER Ap_ElePwr.ReceiverPorts.MtrCurrQax.Amp_f32 /end MEASUREMENT
/begin MEASUREMENT Ap_ElePwr.MtrVoltDax.Volt_f32 "This signal is intended to communicate any type voltage signal measured by the ecu.  This signal has a lower limit of 0 which reequires users of the signal to provide divide by 0 protection if it is used as a denominator in a calculation.  See Vecu port p" FLOAT32_IEEE NO_COMPU_METHOD 0 0 1.175494351e-38 3.402823466e+38 ECU_ADDRESS 0 SYMBOL_LINK "Rte_CDDInterface_MtrVoltDax_Volt_f32" 0 DISPLAY_IDENTIFIER Ap_ElePwr.ReceiverPorts.MtrVoltDax.Volt_f32 /end MEASUREMENT
/begin MEASUREMENT Ap_ElePwr.MtrVoltQax.Volt_f32 "This signal is intended to communicate any type voltage signal measured by the ecu.  This signal has a lower limit of 0 which reequires users of the signal to provide divide by 0 protection if it is used as a denominator in a calculation.  See Vecu port p" FLOAT32_IEEE NO_COMPU_METHOD 0 0 1.175494351e-38 3.402823466e+38 ECU_ADDRESS 0 SYMBOL_LINK "Rte_CDDInterface_MtrVoltQax_Volt_f32" 0 DISPLAY_IDENTIFIER Ap_ElePwr.ReceiverPorts.MtrVoltQax.Volt_f32 /end MEASUREMENT
/begin MEASUREMENT Ap_ElePwr.SupplyCurrent.Amp_f32 "MICROSAR RTE" FLOAT32_IEEE NO_COMPU_METHOD 0 0 1.175494351e-38 3.402823466e+38 ECU_ADDRESS 0 SYMBOL_LINK "Rte_Ap_ElePwr_SupplyCurrent_Amp_f32" 0 DISPLAY_IDENTIFIER Ap_ElePwr.SenderPorts.SupplyCurrent.Amp_f32 /end MEASUREMENT
/begin MEASUREMENT Ap_ElePwr.Vecu.Volt_f32 "This port prototype is inteded to communicate voltage signals that represent the ecu supplied voltage.  This signal has a lower limit, which is non-zero, to allow users of the signal to use it as a denominator in an expression without requiring a divide b" FLOAT32_IEEE NO_COMPU_METHOD 0 0 1.175494351e-38 3.402823466e+38 ECU_ADDRESS 0 SYMBOL_LINK "Rte_BatteryVoltage_Vecu_Volt_f32" 0 DISPLAY_IDENTIFIER Ap_ElePwr.ReceiverPorts.Vecu.Volt_f32 /end MEASUREMENT
/begin MEASUREMENT Ap_Gsod.Ana_Hw_Torque.HwNm_f32 "MICROSAR RTE" FLOAT32_IEEE NO_COMPU_METHOD 0 0 1.175494351e-38 3.402823466e+38 ECU_ADDRESS 0 SYMBOL_LINK "Rte_HwTrq_AnaHwTorque_HwNm_f32" 0 DISPLAY_IDENTIFIER Ap_Gsod.ReceiverPorts.Ana_Hw_Torque.HwNm_f32 /end MEASUREMENT
/begin MEASUREMENT Ap_Gsod.Corrected_MtrPos.Rev_f32 "MICROSAR RTE" FLOAT32_IEEE NO_COMPU_METHOD 0 0 1.175494351e-38 3.402823466e+38 ECU_ADDRESS 0 SYMBOL_LINK "Rte_Sa_MtrPos2_CorrectedMtrPos_Rev_f32" 0 DISPLAY_IDENTIFIER Ap_Gsod.ReceiverPorts.Corrected_MtrPos.Rev_f32 /end MEASUREMENT
/begin MEASUREMENT Ap_Gsod.Cum_Mtr_Pos_CRF.Deg_f32 "MICROSAR RTE" FLOAT32_IEEE NO_COMPU_METHOD 0 0 1.175494351e-38 3.402823466e+38 ECU_ADDRESS 0 SYMBOL_LINK "Rte_MtrPos_CumMtrPosCRF_Deg_f32" 0 DISPLAY_IDENTIFIER Ap_Gsod.ReceiverPorts.Cum_Mtr_Pos_CRF.Deg_f32 /end MEASUREMENT
/begin MEASUREMENT Ap_Gsod.MtrElecMech_Polarity.Cnt_s08 "MICROSAR RTE" SBYTE NO_COMPU_METHOD 0 0 -128 127 ECU_ADDRESS 0 SYMBOL_LINK "Rte_Polarity_MtrElecMechPolarity_Cnt_s08" 0 DISPLAY_IDENTIFIER Ap_Gsod.ReceiverPorts.MtrElecMech_Polarity.Cnt_s08 /end MEASUREMENT
/begin MEASUREMENT Ap_Gsod.SysC_Ana_Hw_Torque.HwNm_f32 "MICROSAR RTE" FLOAT32_IEEE NO_COMPU_METHOD 0 0 1.175494351e-38 3.402823466e+38 ECU_ADDRESS 0 SYMBOL_LINK "Rte_HwTrq_SysCAnaHwTorque_HwNm_f32" 0 DISPLAY_IDENTIFIER Ap_Gsod.ReceiverPorts.SysC_Ana_Hw_Torque.HwNm_f32 /end MEASUREMENT
/begin MEASUREMENT Ap_Gsod.SysC_Corrected_MtrPos.Rev_f32 "MICROSAR RTE" FLOAT32_IEEE NO_COMPU_METHOD 0 0 1.175494351e-38 3.402823466e+38 ECU_ADDRESS 0 SYMBOL_LINK "Rte_Sa_MtrPos2_SysCCorrectedMtrPos_Rev_f32" 0 DISPLAY_IDENTIFIER Ap_Gsod.ReceiverPorts.SysC_Corrected_MtrPos.Rev_f32 /end MEASUREMENT
/begin MEASUREMENT Ap_Gsod.SysC_Cum_Mtr_Pos_CRF.Deg_f32 "MICROSAR RTE" FLOAT32_IEEE NO_COMPU_METHOD 0 0 1.175494351e-38 3.402823466e+38 ECU_ADDRESS 0 SYMBOL_LINK "Rte_MtrPos_SysCCumMtrPosCRF_Deg_f32" 0 DISPLAY_IDENTIFIER Ap_Gsod.ReceiverPorts.SysC_Cum_Mtr_Pos_CRF.Deg_f32 /end MEASUREMENT
/begin MEASUREMENT Ap_Gsod.SysC_MtrElecMech_Polarity.Cnt_s32 "MICROSAR RTE" SLONG NO_COMPU_METHOD 0 0 -2147483648 2147483647 ECU_ADDRESS 0 SYMBOL_LINK "Rte_Polarity_SysC_MtrElecMechPolarity_Cnt_s32" 0 DISPLAY_IDENTIFIER Ap_Gsod.ReceiverPorts.SysC_MtrElecMech_Polarity.Cnt_s32 /end MEASUREMENT
/begin MEASUREMENT Ap_Gsod.SysC_Torque_Cmd_CRF.MtrNm_f32 "MICROSAR RTE" FLOAT32_IEEE NO_COMPU_METHOD 0 0 1.175494351e-38 3.402823466e+38 ECU_ADDRESS 0 SYMBOL_LINK "Rte_CtrldDisShtdn_SysC_CRFMtrTrqCmd_MtrNm_f32" 0 DISPLAY_IDENTIFIER Ap_Gsod.ReceiverPorts.SysC_Torque_Cmd_CRF.MtrNm_f32 /end MEASUREMENT
/begin MEASUREMENT Ap_Gsod.SysC_Torque_Cmd_MRF.MtrNm_f32 "MICROSAR RTE" FLOAT32_IEEE NO_COMPU_METHOD 0 0 1.175494351e-38 3.402823466e+38 ECU_ADDRESS 0 SYMBOL_LINK "Rte_CtrldDisShtdn_SysC_MRFMtrTrqCmd_MtrNm_f32" 0 DISPLAY_IDENTIFIER Ap_Gsod.ReceiverPorts.SysC_Torque_Cmd_MRF.MtrNm_f32 /end MEASUREMENT
/begin MEASUREMENT Ap_Gsod.SysC_Vecu.Volt_f32 "This port prototype is inteded to communicate voltage signals that represent the ecu supplied voltage.  This signal has a lower limit, which is non-zero, to allow users of the signal to use it as a denominator in an expression without requiring a divide b" FLOAT32_IEEE NO_COMPU_METHOD 0 0 1.175494351e-38 3.402823466e+38 ECU_ADDRESS 0 SYMBOL_LINK "Rte_BatteryVoltage_SysC_Vecu_Volt_f32" 0 DISPLAY_IDENTIFIER Ap_Gsod.ReceiverPorts.SysC_Vecu.Volt_f32 /end MEASUREMENT
/begin MEASUREMENT Ap_Gsod.SystemState.Mode "MICROSAR RTE" UBYTE RTE_CM_ENUM_StaMd_Mode 0 0 0 255 ECU_ADDRESS 0 SYMBOL_LINK "Rte_ModeMachine_Ap_StaMd8_SystemState8_Mode" 0 DISPLAY_IDENTIFIER Ap_Gsod.ModeRequirePorts.SystemState.Mode /end MEASUREMENT
/begin MEASUREMENT Ap_Gsod.Torque_Cmd_CRF.MtrNm_f32 "MICROSAR RTE" FLOAT32_IEEE NO_COMPU_METHOD 0 0 1.175494351e-38 3.402823466e+38 ECU_ADDRESS 0 SYMBOL_LINK "Rte_CtrldDisShtdn_CntDisMtrTrqCmdCRF_MtrNm_f32" 0 DISPLAY_IDENTIFIER Ap_Gsod.ReceiverPorts.Torque_Cmd_CRF.MtrNm_f32 /end MEASUREMENT
/begin MEASUREMENT Ap_Gsod.Torque_Cmd_MRF.MtrNm_f32 "MICROSAR RTE" FLOAT32_IEEE NO_COMPU_METHOD 0 0 1.175494351e-38 3.402823466e+38 ECU_ADDRESS 0 SYMBOL_LINK "Rte_CtrldDisShtdn_CntDisMtrTrqCmdCRF_MtrNm_f32" 0 DISPLAY_IDENTIFIER Ap_Gsod.ReceiverPorts.Torque_Cmd_MRF.MtrNm_f32 /end MEASUREMENT
/begin MEASUREMENT Ap_Gsod.Vecu.Volt_f32 "This port prototype is inteded to communicate voltage signals that represent the ecu supplied voltage.  This signal has a lower limit, which is non-zero, to allow users of the signal to use it as a denominator in an expression without requiring a divide b" FLOAT32_IEEE NO_COMPU_METHOD 0 0 1.175494351e-38 3.402823466e+38 ECU_ADDRESS 0 SYMBOL_LINK "Rte_BatteryVoltage_Vecu_Volt_f32" 0 DISPLAY_IDENTIFIER Ap_Gsod.ReceiverPorts.Vecu.Volt_f32 /end MEASUREMENT
/begin MEASUREMENT Ap_HaLFTO.DSTState.Cnt_u08 "MICROSAR RTE" UBYTE NO_COMPU_METHOD 0 0 0 255 ECU_ADDRESS 0 SYMBOL_LINK "Rte_Ap_StbCTO_DSTState_Cnt_u08" 0 DISPLAY_IDENTIFIER Ap_HaLFTO.ReceiverPorts.DSTState.Cnt_u08 /end MEASUREMENT
/begin MEASUREMENT Ap_HaLFTO.DiagStsNonRecRmpToZeroFltPres.Cnt_lgc "MICROSAR RTE" UBYTE RTE_CM_BOOLEAN 0 0 0 255 ECU_ADDRESS 0 SYMBOL_LINK "Rte_DiagMgr_DiagStsNonRecRmpToZeroFltPres_Cnt_lgc" 0 DISPLAY_IDENTIFIER Ap_HaLFTO.ReceiverPorts.DiagStsNonRecRmpToZeroFltPres.Cnt_lgc /end MEASUREMENT
/begin MEASUREMENT Ap_HaLFTO.DiagStsRecRmpToZeroFltPres.Cnt_lgc "MICROSAR RTE" UBYTE RTE_CM_BOOLEAN 0 0 0 255 ECU_ADDRESS 0 SYMBOL_LINK "Rte_DiagMgr_DiagStsRecRmpToZeroFltPres_Cnt_lgc" 0 DISPLAY_IDENTIFIER Ap_HaLFTO.ReceiverPorts.DiagStsRecRmpToZeroFltPres.Cnt_lgc /end MEASUREMENT
/begin MEASUREMENT Ap_HaLFTO.HaLFActive.Cnt_lgc "MICROSAR RTE" UBYTE RTE_CM_BOOLEAN 0 0 0 255 ECU_ADDRESS 0 SYMBOL_LINK "Rte_Ap_HaLFTO_HaLFActive_Cnt_lgc" 0 DISPLAY_IDENTIFIER Ap_HaLFTO.SenderPorts.HaLFActive.Cnt_lgc /end MEASUREMENT
/begin MEASUREMENT Ap_HaLFTO.HaLFEnableRqst.Cnt_lgc "MICROSAR RTE" UBYTE RTE_CM_BOOLEAN 0 0 0 255 ECU_ADDRESS 0 SYMBOL_LINK "Rte_SrlComInput_HaLFEnableRqst_Cnt_lgc" 0 DISPLAY_IDENTIFIER Ap_HaLFTO.ReceiverPorts.HaLFEnableRqst.Cnt_lgc /end MEASUREMENT
/begin MEASUREMENT Ap_HaLFTO.HaLFErrInterfaceActive.Cnt_lgc "MICROSAR RTE" UBYTE RTE_CM_BOOLEAN 0 0 0 255 ECU_ADDRESS 0 SYMBOL_LINK "Rte_SrlComInput_HaLFErrInterfaceActive_Cnt_lgc" 0 DISPLAY_IDENTIFIER Ap_HaLFTO.ReceiverPorts.HaLFErrInterfaceActive.Cnt_lgc /end MEASUREMENT
/begin MEASUREMENT Ap_HaLFTO.HaLFExtSystemFltActive.Cnt_lgc "MICROSAR RTE" UBYTE RTE_CM_BOOLEAN 0 0 0 255 ECU_ADDRESS 0 SYMBOL_LINK "Rte_SrlComInput_HaLFExtSystemFltActive_Cnt_lgc" 0 DISPLAY_IDENTIFIER Ap_HaLFTO.ReceiverPorts.HaLFExtSystemFltActive.Cnt_lgc /end MEASUREMENT
/begin MEASUREMENT Ap_HaLFTO.HaLFFuncPresent.Cnt_lgc "MICROSAR RTE" UBYTE RTE_CM_BOOLEAN 0 0 0 255 ECU_ADDRESS 0 SYMBOL_LINK "Rte_SrlComInput_HaLFFuncPresent_Cnt_lgc" 0 DISPLAY_IDENTIFIER Ap_HaLFTO.ReceiverPorts.HaLFFuncPresent.Cnt_lgc /end MEASUREMENT
/begin MEASUREMENT Ap_HaLFTO.HaLFIntSystemFltActive.Cnt_lgc "MICROSAR RTE" UBYTE RTE_CM_BOOLEAN 0 0 0 255 ECU_ADDRESS 0 SYMBOL_LINK "Rte_SrlComInput_HaLFIntSystemFltActive_Cnt_lgc" 0 DISPLAY_IDENTIFIER Ap_HaLFTO.ReceiverPorts.HaLFIntSystemFltActive.Cnt_lgc /end MEASUREMENT
/begin MEASUREMENT Ap_HaLFTO.HaLFSWATrqFail.Cnt_lgc "MICROSAR RTE" UBYTE RTE_CM_BOOLEAN 0 0 0 255 ECU_ADDRESS 0 SYMBOL_LINK "Rte_SrlComInput_HaLFSWATrqFail_Cnt_lgc" 0 DISPLAY_IDENTIFIER Ap_HaLFTO.ReceiverPorts.HaLFSWATrqFail.Cnt_lgc /end MEASUREMENT
/begin MEASUREMENT Ap_HaLFTO.HaLFSlewComplete.Cnt_lgc "MICROSAR RTE" UBYTE RTE_CM_BOOLEAN 0 0 0 255 ECU_ADDRESS 0 SYMBOL_LINK "Rte_Ap_ArbLmt_HaLFSlewComplete_Cnt_lgc" 0 DISPLAY_IDENTIFIER Ap_HaLFTO.ReceiverPorts.HaLFSlewComplete.Cnt_lgc /end MEASUREMENT
/begin MEASUREMENT Ap_HaLFTO.HaLFState.Cnt_u08 "MICROSAR RTE" UBYTE NO_COMPU_METHOD 0 0 0 255 ECU_ADDRESS 0 SYMBOL_LINK "Rte_Ap_HaLFTO_HaLFState_Cnt_u08" 0 DISPLAY_IDENTIFIER Ap_HaLFTO.SenderPorts.HaLFState.Cnt_u08 /end MEASUREMENT
/begin MEASUREMENT Ap_HaLFTO.HaLFSuspend.Cnt_lgc "MICROSAR RTE" UBYTE RTE_CM_BOOLEAN 0 0 0 255 ECU_ADDRESS 0 SYMBOL_LINK "Rte_Ap_HaLFTO_HaLFSuspend_Cnt_lgc" 0 DISPLAY_IDENTIFIER Ap_HaLFTO.SenderPorts.HaLFSuspend.Cnt_lgc /end MEASUREMENT
/begin MEASUREMENT Ap_HaLFTO.HaLFTrqOvReverseGearEngage.Cnt_lgc "MICROSAR RTE" UBYTE RTE_CM_BOOLEAN 0 0 0 255 ECU_ADDRESS 0 SYMBOL_LINK "Rte_SrlComInput_HalfTrqOvRvrsGearEngage_Cnt_lgc" 0 DISPLAY_IDENTIFIER Ap_HaLFTO.ReceiverPorts.HaLFTrqOvReverseGearEngage.Cnt_lgc /end MEASUREMENT
/begin MEASUREMENT Ap_HaLFTO.HwTorque.HwNm_f32 "MICROSAR RTE" FLOAT32_IEEE NO_COMPU_METHOD 0 0 1.175494351e-38 3.402823466e+38 ECU_ADDRESS 0 SYMBOL_LINK "Rte_HwTrq_AnaHwTorque_HwNm_f32" 0 DISPLAY_IDENTIFIER Ap_HaLFTO.ReceiverPorts.HwTorque.HwNm_f32 /end MEASUREMENT
/begin MEASUREMENT Ap_HaLFTO.LimitPercentFiltered.Uls_f32 "MICROSAR RTE" FLOAT32_IEEE NO_COMPU_METHOD 0 0 1.175494351e-38 3.402823466e+38 ECU_ADDRESS 0 SYMBOL_LINK "Rte_Ap_AstLmt_LimitPercentFiltered_Uls_f32" 0 DISPLAY_IDENTIFIER Ap_HaLFTO.ReceiverPorts.LimitPercentFiltered.Uls_f32 /end MEASUREMENT
/begin MEASUREMENT Ap_HaLFTO.PrevHaLFEnableRqst.Cnt_lgc "MICROSAR RTE" UBYTE RTE_CM_BOOLEAN 0 0 0 255 ECU_ADDRESS 0 SYMBOL_LINK "Rte_SrlComInput_PrevHaLFEnableRqst_Cnt_lgc" 0 DISPLAY_IDENTIFIER Ap_HaLFTO.ReceiverPorts.PrevHaLFEnableRqst.Cnt_lgc /end MEASUREMENT
/begin MEASUREMENT Ap_HaLFTO.PrevHaLFTrqOvCmdRqst.MtrNm_f32 "MICROSAR RTE" FLOAT32_IEEE NO_COMPU_METHOD 0 0 1.175494351e-38 3.402823466e+38 ECU_ADDRESS 0 SYMBOL_LINK "Rte_SrlComInput_PrevHaLFTrqOvCmdRqst_MtrNm_f32" 0 DISPLAY_IDENTIFIER Ap_HaLFTO.ReceiverPorts.PrevHaLFTrqOvCmdRqst.MtrNm_f32 /end MEASUREMENT
/begin MEASUREMENT Ap_HaLFTO.SystemState.Mode "MICROSAR RTE" UBYTE RTE_CM_ENUM_StaMd_Mode 0 0 0 255 ECU_ADDRESS 0 SYMBOL_LINK "Rte_ModeMachine_StaMd_SystemState_Mode" 0 DISPLAY_IDENTIFIER Ap_HaLFTO.ModeRequirePorts.SystemState.Mode /end MEASUREMENT
/begin MEASUREMENT Ap_HaLFTO.TOEOLDisable.Cnt_lgc "MICROSAR RTE" UBYTE RTE_CM_BOOLEAN 0 0 0 255 ECU_ADDRESS 0 SYMBOL_LINK "Rte_CDDInterface_TOEOLDisable_Cnt_lgc" 0 DISPLAY_IDENTIFIER Ap_HaLFTO.ReceiverPorts.TOEOLDisable.Cnt_lgc /end MEASUREMENT
/begin MEASUREMENT Ap_HaLFTO.VehicleSpeed.Kph_f32 "MICROSAR RTE" FLOAT32_IEEE NO_COMPU_METHOD 0 0 1.175494351e-38 3.402823466e+38 ECU_ADDRESS 0 SYMBOL_LINK "Rte_Ap_SignlCondn_VehicleSpeed_Kph_f32" 0 DISPLAY_IDENTIFIER Ap_HaLFTO.ReceiverPorts.VehicleSpeed.Kph_f32 /end MEASUREMENT
/begin MEASUREMENT Ap_HwPwUp.MtrDrvrInitComplete.Cnt_lgc "MICROSAR RTE" UBYTE RTE_CM_BOOLEAN 0 0 0 255 ECU_ADDRESS 0 SYMBOL_LINK "Rte_MtrDrvDiag_MtrDrvrInitComplete_Cnt_lgc" 0 DISPLAY_IDENTIFIER Ap_HwPwUp.ReceiverPorts.MtrDrvrInitComplete.Cnt_lgc /end MEASUREMENT
/begin MEASUREMENT Ap_HwPwUp.MtrDrvrInitStart.Cnt_lgc "MICROSAR RTE" UBYTE RTE_CM_BOOLEAN 0 0 0 255 ECU_ADDRESS 0 SYMBOL_LINK "Rte_Ap_HwPwUp_MtrDrvrInitStart_Cnt_lgc" 0 DISPLAY_IDENTIFIER Ap_HwPwUp.SenderPorts.MtrDrvrInitStart.Cnt_lgc /end MEASUREMENT
/begin MEASUREMENT Ap_HwPwUp.PwrDiscATestComplete.Cnt_lgc "MICROSAR RTE" UBYTE RTE_CM_BOOLEAN 0 0 0 255 ECU_ADDRESS 0 SYMBOL_LINK "Rte_Sa_BkCpPc_PwrDiscATestComplete_Cnt_lgc" 0 DISPLAY_IDENTIFIER Ap_HwPwUp.ReceiverPorts.PwrDiscATestComplete.Cnt_lgc /end MEASUREMENT
/begin MEASUREMENT Ap_HwPwUp.PwrDiscATestStart.Cnt_lgc "MICROSAR RTE" UBYTE RTE_CM_BOOLEAN 0 0 0 255 ECU_ADDRESS 0 SYMBOL_LINK "Rte_Ap_HwPwUp_PwrDiscATestStart_Cnt_lgc" 0 DISPLAY_IDENTIFIER Ap_HwPwUp.SenderPorts.PwrDiscATestStart.Cnt_lgc /end MEASUREMENT
/begin MEASUREMENT Ap_HwPwUp.PwrDiscBTestComplete.Cnt_lgc "MICROSAR RTE" UBYTE RTE_CM_BOOLEAN 0 0 0 255 ECU_ADDRESS 0 SYMBOL_LINK "Rte_Sa_BkCpPc_PwrDiscBTestComplete_Cnt_lgc" 0 DISPLAY_IDENTIFIER Ap_HwPwUp.ReceiverPorts.PwrDiscBTestComplete.Cnt_lgc /end MEASUREMENT
/begin MEASUREMENT Ap_HwPwUp.PwrDiscBTestStart.Cnt_lgc "MICROSAR RTE" UBYTE RTE_CM_BOOLEAN 0 0 0 255 ECU_ADDRESS 0 SYMBOL_LINK "Rte_Ap_HwPwUp_PwrDiscBTestStart_Cnt_lgc" 0 DISPLAY_IDENTIFIER Ap_HwPwUp.SenderPorts.PwrDiscBTestStart.Cnt_lgc /end MEASUREMENT
/begin MEASUREMENT Ap_HwPwUp.SystemState.Mode "MICROSAR RTE" UBYTE RTE_CM_ENUM_StaMd_Mode 0 0 0 255 ECU_ADDRESS 0 SYMBOL_LINK "Rte_ModeMachine_StaMd_SystemState_Mode" 0 DISPLAY_IDENTIFIER Ap_HwPwUp.ModeRequirePorts.SystemState.Mode /end MEASUREMENT
/begin MEASUREMENT Ap_HwPwUp.TMFTestComplete.Cnt_lgc "MICROSAR RTE" UBYTE RTE_CM_BOOLEAN 0 0 0 255 ECU_ADDRESS 0 SYMBOL_LINK "Rte_TmprlMon_TMFTestComplete_Cnt_lgc" 0 DISPLAY_IDENTIFIER Ap_HwPwUp.ReceiverPorts.TMFTestComplete.Cnt_lgc /end MEASUREMENT
/begin MEASUREMENT Ap_HwPwUp.TMFTestStart.Cnt_lgc "MICROSAR RTE" UBYTE RTE_CM_BOOLEAN 0 0 0 255 ECU_ADDRESS 0 SYMBOL_LINK "Rte_Ap_HwPwUp_TMFTestStart_Cnt_lgc" 0 DISPLAY_IDENTIFIER Ap_HwPwUp.SenderPorts.TMFTestStart.Cnt_lgc /end MEASUREMENT
/begin MEASUREMENT Ap_LmtCod.AssistEOTGain.Uls_f32 "MICROSAR RTE" FLOAT32_IEEE NO_COMPU_METHOD 0 0 1.175494351e-38 3.402823466e+38 ECU_ADDRESS 0 SYMBOL_LINK "Rte_EOTActuatorMng_AssistEOTGain_Uls_f32" 0 DISPLAY_IDENTIFIER Ap_LmtCod.ReceiverPorts.AssistEOTGain.Uls_f32 /end MEASUREMENT
/begin MEASUREMENT Ap_LmtCod.AssistEOTLimit.MtrNm_f32 "MICROSAR RTE" FLOAT32_IEEE NO_COMPU_METHOD 0 0 1.175494351e-38 3.402823466e+38 ECU_ADDRESS 0 SYMBOL_LINK "Rte_EOTActuatorMng_AssistEOTLimit_MtrNm_f32" 0 DISPLAY_IDENTIFIER Ap_LmtCod.ReceiverPorts.AssistEOTLimit.MtrNm_f32 /end MEASUREMENT
/begin MEASUREMENT Ap_LmtCod.AssistStallLimit.MtrNm_f32 "MICROSAR RTE" FLOAT32_IEEE NO_COMPU_METHOD 0 0 1.175494351e-38 3.402823466e+38 ECU_ADDRESS 0 SYMBOL_LINK "Rte_HiLoadStall_AssistStallLimit_MtrNm_f32" 0 DISPLAY_IDENTIFIER Ap_LmtCod.ReceiverPorts.AssistStallLimit.MtrNm_f32 /end MEASUREMENT
/begin MEASUREMENT Ap_LmtCod.AssistVehSpdLimit.MtrNm_f32 "MICROSAR RTE" FLOAT32_IEEE NO_COMPU_METHOD 0 0 1.175494351e-38 3.402823466e+38 ECU_ADDRESS 0 SYMBOL_LINK "Rte_VehSpdLmt_AstVehSpdLimit_MtrNm_f32" 0 DISPLAY_IDENTIFIER Ap_LmtCod.ReceiverPorts.AssistVehSpdLimit.MtrNm_f32 /end MEASUREMENT
/begin MEASUREMENT Ap_LmtCod.EOTGainLtd.Uls_f32 "MICROSAR RTE" FLOAT32_IEEE NO_COMPU_METHOD 0 0 1.175494351e-38 3.402823466e+38 ECU_ADDRESS 0 SYMBOL_LINK "Rte_Ap_LmtCod_EOTGainLtd_Uls_f32" 0 DISPLAY_IDENTIFIER Ap_LmtCod.SenderPorts.EOTGainLtd.Uls_f32 /end MEASUREMENT
/begin MEASUREMENT Ap_LmtCod.EOTLimitLtd.MtrNm_f32 "MICROSAR RTE" FLOAT32_IEEE NO_COMPU_METHOD 0 0 1.175494351e-38 3.402823466e+38 ECU_ADDRESS 0 SYMBOL_LINK "Rte_Ap_LmtCod_EOTLimitLtd_MtrNm_f32" 0 DISPLAY_IDENTIFIER Ap_LmtCod.SenderPorts.EOTLimitLtd.MtrNm_f32 /end MEASUREMENT
/begin MEASUREMENT Ap_LmtCod.OutputRampMult.Uls_f32 "MICROSAR RTE" FLOAT32_IEEE NO_COMPU_METHOD 0 0 1.175494351e-38 3.402823466e+38 ECU_ADDRESS 0 SYMBOL_LINK "Rte_StOpCtrl_OutputRampMult_Uls_f32" 0 DISPLAY_IDENTIFIER Ap_LmtCod.ReceiverPorts.OutputRampMult.Uls_f32 /end MEASUREMENT
/begin MEASUREMENT Ap_LmtCod.OutputRampMultLtd.Uls_f32 "MICROSAR RTE" FLOAT32_IEEE NO_COMPU_METHOD 0 0 1.175494351e-38 3.402823466e+38 ECU_ADDRESS 0 SYMBOL_LINK "Rte_Ap_LmtCod_OutputRampMultLtd_Uls_f32" 0 DISPLAY_IDENTIFIER Ap_LmtCod.SenderPorts.OutputRampMultLtd.Uls_f32 /end MEASUREMENT
/begin MEASUREMENT Ap_LmtCod.StallLimitLtd.MtrNm_f32 "MICROSAR RTE" FLOAT32_IEEE NO_COMPU_METHOD 0 0 1.175494351e-38 3.402823466e+38 ECU_ADDRESS 0 SYMBOL_LINK "Rte_Ap_LmtCod_StallLimitLtd_MtrNm_f32" 0 DISPLAY_IDENTIFIER Ap_LmtCod.SenderPorts.StallLimitLtd.MtrNm_f32 /end MEASUREMENT
/begin MEASUREMENT Ap_LmtCod.ThermalLimit.MtrNm_f32 "MICROSAR RTE" FLOAT32_IEEE NO_COMPU_METHOD 0 0 1.175494351e-38 3.402823466e+38 ECU_ADDRESS 0 SYMBOL_LINK "Rte_Ap_ThrmlDutyCycle_ThermalLimit_MtrNm_f32" 0 DISPLAY_IDENTIFIER Ap_LmtCod.ReceiverPorts.ThermalLimit.MtrNm_f32 /end MEASUREMENT
/begin MEASUREMENT Ap_LmtCod.ThermalLimitLtd.MtrNm_f32 "MICROSAR RTE" FLOAT32_IEEE NO_COMPU_METHOD 0 0 1.175494351e-38 3.402823466e+38 ECU_ADDRESS 0 SYMBOL_LINK "Rte_Ap_LmtCod_ThermalLimitLtd_MtrNm_f32" 0 DISPLAY_IDENTIFIER Ap_LmtCod.SenderPorts.ThermalLimitLtd.MtrNm_f32 /end MEASUREMENT
/begin MEASUREMENT Ap_LmtCod.VehSpdLimitLtd.MtrNm_f32 "MICROSAR RTE" FLOAT32_IEEE NO_COMPU_METHOD 0 0 1.175494351e-38 3.402823466e+38 ECU_ADDRESS 0 SYMBOL_LINK "Rte_Ap_LmtCod_VehSpdLimitLtd_MtrNm_f32" 0 DISPLAY_IDENTIFIER Ap_LmtCod.SenderPorts.VehSpdLimitLtd.MtrNm_f32 /end MEASUREMENT
/begin MEASUREMENT Ap_LmtCod.VehicleSpeed.Kph_f32 "MICROSAR RTE" FLOAT32_IEEE NO_COMPU_METHOD 0 0 1.175494351e-38 3.402823466e+38 ECU_ADDRESS 0 SYMBOL_LINK "Rte_Ap_SignlCondn_VehicleSpeed_Kph_f32" 0 DISPLAY_IDENTIFIER Ap_LmtCod.ReceiverPorts.VehicleSpeed.Kph_f32 /end MEASUREMENT
/begin MEASUREMENT Ap_LrnEOT.CCWFound.Cnt_lgc "MICROSAR RTE" UBYTE RTE_CM_BOOLEAN 0 0 0 255 ECU_ADDRESS 0 SYMBOL_LINK "Rte_Ap_LrnEOT_CCWFound_Cnt_lgc" 0 DISPLAY_IDENTIFIER Ap_LrnEOT.SenderPorts.CCWFound.Cnt_lgc /end MEASUREMENT
/begin MEASUREMENT Ap_LrnEOT.CCWPosition.HwDeg_f32 "MICROSAR RTE" FLOAT32_IEEE NO_COMPU_METHOD 0 0 1.175494351e-38 3.402823466e+38 ECU_ADDRESS 0 SYMBOL_LINK "Rte_Ap_LrnEOT_CCWPosition_HwDeg_f32" 0 DISPLAY_IDENTIFIER Ap_LrnEOT.SenderPorts.CCWPosition.HwDeg_f32 /end MEASUREMENT
/begin MEASUREMENT Ap_LrnEOT.CWFound.Cnt_lgc "MICROSAR RTE" UBYTE RTE_CM_BOOLEAN 0 0 0 255 ECU_ADDRESS 0 SYMBOL_LINK "Rte_Ap_LrnEOT_CWFound_Cnt_lgc" 0 DISPLAY_IDENTIFIER Ap_LrnEOT.SenderPorts.CWFound.Cnt_lgc /end MEASUREMENT
/begin MEASUREMENT Ap_LrnEOT.CWPosition.HwDeg_f32 "MICROSAR RTE" FLOAT32_IEEE NO_COMPU_METHOD 0 0 1.175494351e-38 3.402823466e+38 ECU_ADDRESS 0 SYMBOL_LINK "Rte_Ap_LrnEOT_CWPosition_HwDeg_f32" 0 DISPLAY_IDENTIFIER Ap_LrnEOT.SenderPorts.CWPosition.HwDeg_f32 /end MEASUREMENT
/begin MEASUREMENT Ap_LrnEOT.DiagStsHwPosDis.Cnt_lgc "MICROSAR RTE" UBYTE RTE_CM_BOOLEAN 0 0 0 255 ECU_ADDRESS 0 SYMBOL_LINK "Rte_DiagMgr_DiagStsHWASbSystmFltPres_Cnt_lgc" 0 DISPLAY_IDENTIFIER Ap_LrnEOT.ReceiverPorts.DiagStsHwPosDis.Cnt_lgc /end MEASUREMENT
/begin MEASUREMENT Ap_LrnEOT.HandwheelAuthority.Uls_f32 "MICROSAR RTE" FLOAT32_IEEE NO_COMPU_METHOD 0 0 1.175494351e-38 3.402823466e+38 ECU_ADDRESS 0 SYMBOL_LINK "Rte_Ap_AbsHwPosScom_HwPosAuthority_Uls_f32" 0 DISPLAY_IDENTIFIER Ap_LrnEOT.ReceiverPorts.HandwheelAuthority.Uls_f32 /end MEASUREMENT
/begin MEASUREMENT Ap_LrnEOT.HandwheelPosition.HwDeg_f32 "MICROSAR RTE" FLOAT32_IEEE NO_COMPU_METHOD 0 0 1.175494351e-38 3.402823466e+38 ECU_ADDRESS 0 SYMBOL_LINK "Rte_Ap_AbsHwPosScom_HwPos_HwDeg_f32" 0 DISPLAY_IDENTIFIER Ap_LrnEOT.ReceiverPorts.HandwheelPosition.HwDeg_f32 /end MEASUREMENT
/begin MEASUREMENT Ap_LrnEOT.HwTorque.HwNm_f32 "MICROSAR RTE" FLOAT32_IEEE NO_COMPU_METHOD 0 0 1.175494351e-38 3.402823466e+38 ECU_ADDRESS 0 SYMBOL_LINK "Rte_HwTrq_AnaHwTorque_HwNm_f32" 0 DISPLAY_IDENTIFIER Ap_LrnEOT.ReceiverPorts.HwTorque.HwNm_f32 /end MEASUREMENT
/begin MEASUREMENT Ap_LrnEOT.LearnedEOT.CCWEOTFound_Cnt_lgc "MICROSAR RTE" UBYTE RTE_CM_BOOLEAN 0 0 0 255 ECU_ADDRESS 0 SYMBOL_LINK "Rte_Ap_LrnEOT_LearnedEOT.CCWEOTFound_Cnt_lgc" 0 DISPLAY_IDENTIFIER Ap_LrnEOT.PerInstanceMemories.LearnedEOT.CCWEOTFound_Cnt_lgc READ_WRITE /end MEASUREMENT
/begin MEASUREMENT Ap_LrnEOT.LearnedEOT.CCWEOTPosition_HwDeg_f32 "MICROSAR RTE" FLOAT32_IEEE NO_COMPU_METHOD 0 0 1.175494351e-38 3.402823466e+38 ECU_ADDRESS 0 SYMBOL_LINK "Rte_Ap_LrnEOT_LearnedEOT.CCWEOTPosition_HwDeg_f32" 0 DISPLAY_IDENTIFIER Ap_LrnEOT.PerInstanceMemories.LearnedEOT.CCWEOTPosition_HwDeg_f32 READ_WRITE /end MEASUREMENT
/begin MEASUREMENT Ap_LrnEOT.LearnedEOT.CWEOTFound_Cnt_lgc "MICROSAR RTE" UBYTE RTE_CM_BOOLEAN 0 0 0 255 ECU_ADDRESS 0 SYMBOL_LINK "Rte_Ap_LrnEOT_LearnedEOT.CWEOTFound_Cnt_lgc" 0 DISPLAY_IDENTIFIER Ap_LrnEOT.PerInstanceMemories.LearnedEOT.CWEOTFound_Cnt_lgc READ_WRITE /end MEASUREMENT
/begin MEASUREMENT Ap_LrnEOT.LearnedEOT.CWEOTPosition_HwDeg_f32 "MICROSAR RTE" FLOAT32_IEEE NO_COMPU_METHOD 0 0 1.175494351e-38 3.402823466e+38 ECU_ADDRESS 0 SYMBOL_LINK "Rte_Ap_LrnEOT_LearnedEOT.CWEOTPosition_HwDeg_f32" 0 DISPLAY_IDENTIFIER Ap_LrnEOT.PerInstanceMemories.LearnedEOT.CWEOTPosition_HwDeg_f32 READ_WRITE /end MEASUREMENT
/begin MEASUREMENT Ap_LrnEOT.MtrVelCRF.MtrRadpS_f32 "MICROSAR RTE" FLOAT32_IEEE NO_COMPU_METHOD 0 0 1.175494351e-38 3.402823466e+38 ECU_ADDRESS 0 SYMBOL_LINK "Rte_MtrVel_CRFMotorVel_MtrRadpS_f32" 0 DISPLAY_IDENTIFIER Ap_LrnEOT.ReceiverPorts.MtrVelCRF.MtrRadpS_f32 /end MEASUREMENT
/begin MEASUREMENT Ap_LrnEOT.PostLimitTorque.MtrNm_f32 "MICROSAR RTE" FLOAT32_IEEE NO_COMPU_METHOD 0 0 1.175494351e-38 3.402823466e+38 ECU_ADDRESS 0 SYMBOL_LINK "Rte_Ap_AstLmt_SumLimTrqCmd_MtrNm_f32" 0 DISPLAY_IDENTIFIER Ap_LrnEOT.ReceiverPorts.PostLimitTorque.MtrNm_f32 /end MEASUREMENT
/begin MEASUREMENT Ap_MtrTempEst.AmbTemp.DegC_f32 "MICROSAR RTE" FLOAT32_IEEE NO_COMPU_METHOD 0 0 1.175494351e-38 3.402823466e+38 ECU_ADDRESS 0 SYMBOL_LINK "Rte_SrlComInput_AmbTempAvg_DegC_f32" 0 DISPLAY_IDENTIFIER Ap_MtrTempEst.ReceiverPorts.AmbTemp.DegC_f32 /end MEASUREMENT
/begin MEASUREMENT Ap_MtrTempEst.AssistMechTempEst.DegC_f32 "MICROSAR RTE" FLOAT32_IEEE NO_COMPU_METHOD 0 0 1.175494351e-38 3.402823466e+38 ECU_ADDRESS 0 SYMBOL_LINK "Rte_Ap_MtrTempEst_AssistMechTempEst_DegC_f32" 0 DISPLAY_IDENTIFIER Ap_MtrTempEst.SenderPorts.AssistMechTempEst.DegC_f32 /end MEASUREMENT
/begin MEASUREMENT Ap_MtrTempEst.CtrlTempFinal.DegC_f32 "MICROSAR RTE" FLOAT32_IEEE NO_COMPU_METHOD 0 0 1.175494351e-38 3.402823466e+38 ECU_ADDRESS 0 SYMBOL_LINK "Rte_CtrlTemp_FiltMeasTemp_DegC_f32" 0 DISPLAY_IDENTIFIER Ap_MtrTempEst.ReceiverPorts.CtrlTempFinal.DegC_f32 /end MEASUREMENT
/begin MEASUREMENT Ap_MtrTempEst.CuTempEst.DegC_f32 "MICROSAR RTE" FLOAT32_IEEE NO_COMPU_METHOD 0 0 1.175494351e-38 3.402823466e+38 ECU_ADDRESS 0 SYMBOL_LINK "Rte_Ap_MtrTempEst_CuTempEst_DegC_f32" 0 DISPLAY_IDENTIFIER Ap_MtrTempEst.SenderPorts.CuTempEst.DegC_f32 /end MEASUREMENT
/begin MEASUREMENT Ap_MtrTempEst.EngTemp.DegC_f32 "MICROSAR RTE" FLOAT32_IEEE NO_COMPU_METHOD 0 0 1.175494351e-38 3.402823466e+38 ECU_ADDRESS 0 SYMBOL_LINK "Rte_SrlComInput_EngOilTemp_DegC_f32" 0 DISPLAY_IDENTIFIER Ap_MtrTempEst.ReceiverPorts.EngTemp.DegC_f32 /end MEASUREMENT
/begin MEASUREMENT Ap_MtrTempEst.EstPkCurr.AmpSq_f32 "MICROSAR RTE" FLOAT32_IEEE NO_COMPU_METHOD 0 0 1.175494351e-38 3.402823466e+38 ECU_ADDRESS 0 SYMBOL_LINK "Rte_PeakCurrEst_EstPkCurr_AmpSq_f32" 0 DISPLAY_IDENTIFIER Ap_MtrTempEst.ReceiverPorts.EstPkCurr.AmpSq_f32 /end MEASUREMENT
/begin MEASUREMENT Ap_MtrTempEst.HwVel.HwRadpS_f32 "MICROSAR RTE" FLOAT32_IEEE NO_COMPU_METHOD 0 0 1.175494351e-38 3.402823466e+38 ECU_ADDRESS 0 SYMBOL_LINK "Rte_MtrVel_HandwheelVel_HwRadpS_f32" 0 DISPLAY_IDENTIFIER Ap_MtrTempEst.ReceiverPorts.HwVel.HwRadpS_f32 /end MEASUREMENT
/begin MEASUREMENT Ap_MtrTempEst.MagTempEst.DegC_f32 "MICROSAR RTE" FLOAT32_IEEE NO_COMPU_METHOD 0 0 1.175494351e-38 3.402823466e+38 ECU_ADDRESS 0 SYMBOL_LINK "Rte_Ap_MtrTempEst_MagTempEst_DegC_f32" 0 DISPLAY_IDENTIFIER Ap_MtrTempEst.SenderPorts.MagTempEst.DegC_f32 /end MEASUREMENT
/begin MEASUREMENT Ap_MtrTempEst.ScomAMDefeat.Cnt_lgc "MICROSAR RTE" UBYTE RTE_CM_BOOLEAN 0 0 0 255 ECU_ADDRESS 0 SYMBOL_LINK "Rte_Ap_MtrTempEst_ScomAMDefeat_Cnt_lgc" 0 DISPLAY_IDENTIFIER Ap_MtrTempEst.ReceiverPorts.ScomAMDefeat.Cnt_lgc /end MEASUREMENT
/begin MEASUREMENT Ap_MtrTempEst.ScomTempDataRcvd.Cnt_lgc "MICROSAR RTE" UBYTE RTE_CM_BOOLEAN 0 0 0 255 ECU_ADDRESS 0 SYMBOL_LINK "Rte_SrlComInput_CanMsgReceived_Cnt_lgc" 0 DISPLAY_IDENTIFIER Ap_MtrTempEst.ReceiverPorts.ScomTempDataRcvd.Cnt_lgc /end MEASUREMENT
/begin MEASUREMENT Ap_MtrTempEst.SiTempEst.DegC_f32 "MICROSAR RTE" FLOAT32_IEEE NO_COMPU_METHOD 0 0 1.175494351e-38 3.402823466e+38 ECU_ADDRESS 0 SYMBOL_LINK "Rte_Ap_MtrTempEst_SiTempEst_DegC_f32" 0 DISPLAY_IDENTIFIER Ap_MtrTempEst.SenderPorts.SiTempEst.DegC_f32 /end MEASUREMENT
/begin MEASUREMENT Ap_PAwTO.DiagStsNonRecRmpToZeroFltPres.Cnt_lgc "MICROSAR RTE" UBYTE RTE_CM_BOOLEAN 0 0 0 255 ECU_ADDRESS 0 SYMBOL_LINK "Rte_DiagMgr_DiagStsNonRecRmpToZeroFltPres_Cnt_lgc" 0 DISPLAY_IDENTIFIER Ap_PAwTO.ReceiverPorts.DiagStsNonRecRmpToZeroFltPres.Cnt_lgc /end MEASUREMENT
/begin MEASUREMENT Ap_PAwTO.DiagStsRecRmpToZeroFltPres.Cnt_lgc "MICROSAR RTE" UBYTE RTE_CM_BOOLEAN 0 0 0 255 ECU_ADDRESS 0 SYMBOL_LINK "Rte_DiagMgr_DiagStsRecRmpToZeroFltPres_Cnt_lgc" 0 DISPLAY_IDENTIFIER Ap_PAwTO.ReceiverPorts.DiagStsRecRmpToZeroFltPres.Cnt_lgc /end MEASUREMENT
/begin MEASUREMENT Ap_PAwTO.HandsOnDetect.Cnt_lgc "MICROSAR RTE" UBYTE RTE_CM_BOOLEAN 0 0 0 255 ECU_ADDRESS 0 SYMBOL_LINK "Rte_Ap_PAwTO_HandsOnDetect_Cnt_lgc" 0 DISPLAY_IDENTIFIER Ap_PAwTO.SenderPorts.HandsOnDetect.Cnt_lgc /end MEASUREMENT
/begin MEASUREMENT Ap_PAwTO.HwTorque.HwNm_f32 "MICROSAR RTE" FLOAT32_IEEE NO_COMPU_METHOD 0 0 1.175494351e-38 3.402823466e+38 ECU_ADDRESS 0 SYMBOL_LINK "Rte_HwTrq_AnaHwTorque_HwNm_f32" 0 DISPLAY_IDENTIFIER Ap_PAwTO.ReceiverPorts.HwTorque.HwNm_f32 /end MEASUREMENT
/begin MEASUREMENT Ap_PAwTO.IWSSCalcVspd.Kph_f32 "MICROSAR RTE" FLOAT32_IEEE NO_COMPU_METHOD 0 0 1.175494351e-38 3.402823466e+38 ECU_ADDRESS 0 SYMBOL_LINK "Rte_SrlComInput_IWSSCalcVspd_Kph_f32" 0 DISPLAY_IDENTIFIER Ap_PAwTO.ReceiverPorts.IWSSCalcVspd.Kph_f32 /end MEASUREMENT
/begin MEASUREMENT Ap_PAwTO.LimitPercentFiltered.Uls_f32 "MICROSAR RTE" FLOAT32_IEEE NO_COMPU_METHOD 0 0 1.175494351e-38 3.402823466e+38 ECU_ADDRESS 0 SYMBOL_LINK "Rte_Ap_AstLmt_LimitPercentFiltered_Uls_f32" 0 DISPLAY_IDENTIFIER Ap_PAwTO.ReceiverPorts.LimitPercentFiltered.Uls_f32 /end MEASUREMENT
/begin MEASUREMENT Ap_PAwTO.PABoostCurveSwitch.Cnt_lgc "MICROSAR RTE" UBYTE RTE_CM_BOOLEAN 0 0 0 255 ECU_ADDRESS 0 SYMBOL_LINK "Rte_Ap_PAwTO_PABoostCurveSwitch_Cnt_lgc" 0 DISPLAY_IDENTIFIER Ap_PAwTO.SenderPorts.PABoostCurveSwitch.Cnt_lgc /end MEASUREMENT
/begin MEASUREMENT Ap_PAwTO.PAEnableRqst.Cnt_lgc "MICROSAR RTE" UBYTE RTE_CM_BOOLEAN 0 0 0 255 ECU_ADDRESS 0 SYMBOL_LINK "Rte_SrlComInput_PAEnableRqst_Cnt_lgc" 0 DISPLAY_IDENTIFIER Ap_PAwTO.ReceiverPorts.PAEnableRqst.Cnt_lgc /end MEASUREMENT
/begin MEASUREMENT Ap_PAwTO.PAErrInterfaceActive.Cnt_lgc "MICROSAR RTE" UBYTE RTE_CM_BOOLEAN 0 0 0 255 ECU_ADDRESS 0 SYMBOL_LINK "Rte_SrlComInput_PAErrInterfaceActive_Cnt_lgc" 0 DISPLAY_IDENTIFIER Ap_PAwTO.ReceiverPorts.PAErrInterfaceActive.Cnt_lgc /end MEASUREMENT
/begin MEASUREMENT Ap_PAwTO.PAExtSystemFltActive.Cnt_lgc "MICROSAR RTE" UBYTE RTE_CM_BOOLEAN 0 0 0 255 ECU_ADDRESS 0 SYMBOL_LINK "Rte_SrlComInput_PAExtSystemFltActive_Cnt_lgc" 0 DISPLAY_IDENTIFIER Ap_PAwTO.ReceiverPorts.PAExtSystemFltActive.Cnt_lgc /end MEASUREMENT
/begin MEASUREMENT Ap_PAwTO.PAIntSystemFltActive.Cnt_lgc "MICROSAR RTE" UBYTE RTE_CM_BOOLEAN 0 0 0 255 ECU_ADDRESS 0 SYMBOL_LINK "Rte_SrlComInput_PAIntSystemFltActive_Cnt_lgc" 0 DISPLAY_IDENTIFIER Ap_PAwTO.ReceiverPorts.PAIntSystemFltActive.Cnt_lgc /end MEASUREMENT
/begin MEASUREMENT Ap_PAwTO.PAManoeuvrePhase.Cnt_u08 "MICROSAR RTE" UBYTE NO_COMPU_METHOD 0 0 0 255 ECU_ADDRESS 0 SYMBOL_LINK "Rte_SrlComInput_PAManoeuvrePhase_Cnt_u08" 0 DISPLAY_IDENTIFIER Ap_PAwTO.ReceiverPorts.PAManoeuvrePhase.Cnt_u08 /end MEASUREMENT
/begin MEASUREMENT Ap_PAwTO.PATrqOvCmdRqst.HwNm_f32 "MICROSAR RTE" FLOAT32_IEEE NO_COMPU_METHOD 0 0 1.175494351e-38 3.402823466e+38 ECU_ADDRESS 0 SYMBOL_LINK "Rte_SrlComInput_PATrqOvCmdRqst_HwNm_f32" 0 DISPLAY_IDENTIFIER Ap_PAwTO.ReceiverPorts.PATrqOvCmdRqst.HwNm_f32 /end MEASUREMENT
/begin MEASUREMENT Ap_PAwTO.PAWheelCriteriaMet.Cnt_lgc "MICROSAR RTE" UBYTE RTE_CM_BOOLEAN 0 0 0 255 ECU_ADDRESS 0 SYMBOL_LINK "Rte_SrlComInput_PAWheelCriteriaMet_Cnt_lgc" 0 DISPLAY_IDENTIFIER Ap_PAwTO.ReceiverPorts.PAWheelCriteriaMet.Cnt_lgc /end MEASUREMENT
/begin MEASUREMENT Ap_PAwTO.PAWhlDirRLStat.Cnt_u08 "MICROSAR RTE" UBYTE NO_COMPU_METHOD 0 0 0 255 ECU_ADDRESS 0 SYMBOL_LINK "Rte_SrlComInput_PAWhlDirRLStat_Cnt_u08" 0 DISPLAY_IDENTIFIER Ap_PAwTO.ReceiverPorts.PAWhlDirRLStat.Cnt_u08 /end MEASUREMENT
/begin MEASUREMENT Ap_PAwTO.PAWhlDirRRStat.Cnt_u08 "MICROSAR RTE" UBYTE NO_COMPU_METHOD 0 0 0 255 ECU_ADDRESS 0 SYMBOL_LINK "Rte_SrlComInput_PAWhlDirRRStat_Cnt_u08" 0 DISPLAY_IDENTIFIER Ap_PAwTO.ReceiverPorts.PAWhlDirRRStat.Cnt_u08 /end MEASUREMENT
/begin MEASUREMENT Ap_PAwTO.PAWhlPlsCntRLValid.Cnt_lgc "MICROSAR RTE" UBYTE RTE_CM_BOOLEAN 0 0 0 255 ECU_ADDRESS 0 SYMBOL_LINK "Rte_SrlComInput_PAWhlPlsCntRLValid_Cnt_lgc" 0 DISPLAY_IDENTIFIER Ap_PAwTO.ReceiverPorts.PAWhlPlsCntRLValid.Cnt_lgc /end MEASUREMENT
/**********************************************************************************************************************
* GROUP
*********************************************************************************************************************/
/begin GROUP Ap_AbsHwPosScom "MICROSAR RTE" /begin SUB_GROUP Ap_AbsHwPosScom.ReceiverPorts Ap_AbsHwPosScom.SenderPorts /end SUB_GROUP /begin FUNCTION_LIST /end FUNCTION_LIST /begin REF_CHARACTERISTIC /end REF_CHARACTERISTIC /begin REF_MEASUREMENT /end REF_MEASUREMENT /end GROUP
/begin GROUP Ap_AbsHwPosScom.CRFCumMtrPos.Deg_f32 "MICROSAR RTE" /begin SUB_GROUP /end SUB_GROUP /begin FUNCTION_LIST /end FUNCTION_LIST /begin REF_CHARACTERISTIC /end REF_CHARACTERISTIC /begin REF_MEASUREMENT Ap_AbsHwPosScom.CRFCumMtrPos.Deg_f32 /end REF_MEASUREMENT /end GROUP
/begin GROUP Ap_AbsHwPosScom.CRFMtrTrqCmd.MtrNm_f32 "MICROSAR RTE" /begin SUB_GROUP /end SUB_GROUP /begin FUNCTION_LIST /end FUNCTION_LIST /begin REF_CHARACTERISTIC /end REF_CHARACTERISTIC /begin REF_MEASUREMENT Ap_AbsHwPosScom.CRFMtrTrqCmd.MtrNm_f32 /end REF_MEASUREMENT /end GROUP
/begin GROUP Ap_AbsHwPosScom.CRFMtrVel.MtrRadpS_f32 "MICROSAR RTE" /begin SUB_GROUP /end SUB_GROUP /begin FUNCTION_LIST /end FUNCTION_LIST /begin REF_CHARACTERISTIC /end REF_CHARACTERISTIC /begin REF_MEASUREMENT Ap_AbsHwPosScom.CRFMtrVel.MtrRadpS_f32 /end REF_MEASUREMENT /end GROUP
/begin GROUP Ap_AbsHwPosScom.DiagStsHwPosDis.Cnt_lgc "MICROSAR RTE" /begin SUB_GROUP /end SUB_GROUP /begin FUNCTION_LIST /end FUNCTION_LIST /begin REF_CHARACTERISTIC /end REF_CHARACTERISTIC /begin REF_MEASUREMENT Ap_AbsHwPosScom.DiagStsHwPosDis.Cnt_lgc /end REF_MEASUREMENT /end GROUP
/begin GROUP Ap_AbsHwPosScom.HwPos.HwDeg_f32 "MICROSAR RTE" /begin SUB_GROUP /end SUB_GROUP /begin FUNCTION_LIST /end FUNCTION_LIST /begin REF_CHARACTERISTIC /end REF_CHARACTERISTIC /begin REF_MEASUREMENT Ap_AbsHwPosScom.HwPos.HwDeg_f32 /end REF_MEASUREMENT /end GROUP
/begin GROUP Ap_AbsHwPosScom.HwPosAuthority.Uls_f32 "MICROSAR RTE" /begin SUB_GROUP /end SUB_GROUP /begin FUNCTION_LIST /end FUNCTION_LIST /begin REF_CHARACTERISTIC /end REF_CHARACTERISTIC /begin REF_MEASUREMENT Ap_AbsHwPosScom.HwPosAuthority.Uls_f32 /end REF_MEASUREMENT /end GROUP
/begin GROUP Ap_AbsHwPosScom.HwTrq.HwNm_f32 "MICROSAR RTE" /begin SUB_GROUP /end SUB_GROUP /begin FUNCTION_LIST /end FUNCTION_LIST /begin REF_CHARACTERISTIC /end REF_CHARACTERISTIC /begin REF_MEASUREMENT Ap_AbsHwPosScom.HwTrq.HwNm_f32 /end REF_MEASUREMENT /end GROUP
/begin GROUP Ap_AbsHwPosScom.KinIntDiagSrlComSvcDft.Cnt_lgc "MICROSAR RTE" /begin SUB_GROUP /end SUB_GROUP /begin FUNCTION_LIST /end FUNCTION_LIST /begin REF_CHARACTERISTIC /end REF_CHARACTERISTIC /begin REF_MEASUREMENT Ap_AbsHwPosScom.KinIntDiagSrlComSvcDft.Cnt_lgc /end REF_MEASUREMENT /end GROUP
/begin GROUP Ap_AbsHwPosScom.ReceiverPorts "MICROSAR RTE"
 /begin SUB_GROUP Ap_AbsHwPosScom.CRFCumMtrPos.Deg_f32 Ap_AbsHwPosScom.CRFMtrTrqCmd.MtrNm_f32 Ap_AbsHwPosScom.CRFMtrVel.MtrRadpS_f32 Ap_AbsHwPosScom.DiagStsHwPosDis.Cnt_lgc Ap_AbsHwPosScom.HwTrq.HwNm_f32 Ap_AbsHwPosScom.KinIntDiagSrlComSvcDft.Cnt_lgc Ap_AbsHwPosScom.SComInpHwA.HwDeg_f32 Ap_AbsHwPosScom.SComInpHwAValid.Cnt_lgc Ap_AbsHwPosScom.VehicleSpeed.Kph_f32 Ap_AbsHwPosScom.VehicleSpeedValid.Cnt_lgc /end SUB_GROUP
 /begin FUNCTION_LIST /end FUNCTION_LIST
 /begin REF_CHARACTERISTIC /end REF_CHARACTERISTIC
 /begin REF_MEASUREMENT /end REF_MEASUREMENT
/end GROUP
/begin GROUP Ap_AbsHwPosScom.SComInpHwA.HwDeg_f32 "MICROSAR RTE" /begin SUB_GROUP /end SUB_GROUP /begin FUNCTION_LIST /end FUNCTION_LIST /begin REF_CHARACTERISTIC /end REF_CHARACTERISTIC /begin REF_MEASUREMENT Ap_AbsHwPosScom.SComInpHwA.HwDeg_f32 /end REF_MEASUREMENT /end GROUP
/begin GROUP Ap_AbsHwPosScom.SComInpHwAValid.Cnt_lgc "MICROSAR RTE" /begin SUB_GROUP /end SUB_GROUP /begin FUNCTION_LIST /end FUNCTION_LIST /begin REF_CHARACTERISTIC /end REF_CHARACTERISTIC /begin REF_MEASUREMENT Ap_AbsHwPosScom.SComInpHwAValid.Cnt_lgc /end REF_MEASUREMENT /end GROUP
/begin GROUP Ap_AbsHwPosScom.SenderPorts "MICROSAR RTE"
 /begin SUB_GROUP Ap_AbsHwPosScom.HwPos.HwDeg_f32 Ap_AbsHwPosScom.HwPosAuthority.Uls_f32 /end SUB_GROUP
 /begin FUNCTION_LIST /end FUNCTION_LIST
 /begin REF_CHARACTERISTIC /end REF_CHARACTERISTIC
 /begin REF_MEASUREMENT /end REF_MEASUREMENT
/end GROUP
/begin GROUP Ap_AbsHwPosScom.VehicleSpeed.Kph_f32 "MICROSAR RTE" /begin SUB_GROUP /end SUB_GROUP /begin FUNCTION_LIST /end FUNCTION_LIST /begin REF_CHARACTERISTIC /end REF_CHARACTERISTIC /begin REF_MEASUREMENT Ap_AbsHwPosScom.VehicleSpeed.Kph_f32 /end REF_MEASUREMENT /end GROUP
/begin GROUP Ap_AbsHwPosScom.VehicleSpeedValid.Cnt_lgc "MICROSAR RTE" /begin SUB_GROUP /end SUB_GROUP /begin FUNCTION_LIST /end FUNCTION_LIST /begin REF_CHARACTERISTIC /end REF_CHARACTERISTIC /begin REF_MEASUREMENT Ap_AbsHwPosScom.VehicleSpeedValid.Cnt_lgc /end REF_MEASUREMENT /end GROUP
/begin GROUP Ap_ActivePull "MICROSAR RTE"
 /begin SUB_GROUP Ap_ActivePull.ModeRequirePorts Ap_ActivePull.ReceiverPorts Ap_ActivePull.SenderPorts /end SUB_GROUP
 /begin FUNCTION_LIST /end FUNCTION_LIST
 /begin REF_CHARACTERISTIC /end REF_CHARACTERISTIC
 /begin REF_MEASUREMENT /end REF_MEASUREMENT
/end GROUP
/begin GROUP Ap_ActivePull.DisableLearning.Cnt_lgc "MICROSAR RTE" /begin SUB_GROUP /end SUB_GROUP /begin FUNCTION_LIST /end FUNCTION_LIST /begin REF_CHARACTERISTIC /end REF_CHARACTERISTIC /begin REF_MEASUREMENT Ap_ActivePull.DisableLearning.Cnt_lgc /end REF_MEASUREMENT /end GROUP
/begin GROUP Ap_ActivePull.DisableOutput.Cnt_lgc "MICROSAR RTE" /begin SUB_GROUP /end SUB_GROUP /begin FUNCTION_LIST /end FUNCTION_LIST /begin REF_CHARACTERISTIC /end REF_CHARACTERISTIC /begin REF_MEASUREMENT Ap_ActivePull.DisableOutput.Cnt_lgc /end REF_MEASUREMENT /end GROUP
/begin GROUP Ap_ActivePull.HandwheelAuthority.Uls_f32 "MICROSAR RTE" /begin SUB_GROUP /end SUB_GROUP /begin FUNCTION_LIST /end FUNCTION_LIST /begin REF_CHARACTERISTIC /end REF_CHARACTERISTIC /begin REF_MEASUREMENT Ap_ActivePull.HandwheelAuthority.Uls_f32 /end REF_MEASUREMENT /end GROUP
/begin GROUP Ap_ActivePull.HandwheelPosition.HwDeg_f32 "MICROSAR RTE" /begin SUB_GROUP /end SUB_GROUP /begin FUNCTION_LIST /end FUNCTION_LIST /begin REF_CHARACTERISTIC /end REF_CHARACTERISTIC /begin REF_MEASUREMENT Ap_ActivePull.HandwheelPosition.HwDeg_f32 /end REF_MEASUREMENT /end GROUP
/begin GROUP Ap_ActivePull.HandwheelVelocity.HwRadpS_f32 "MICROSAR RTE" /begin SUB_GROUP /end SUB_GROUP /begin FUNCTION_LIST /end FUNCTION_LIST /begin REF_CHARACTERISTIC /end REF_CHARACTERISTIC /begin REF_MEASUREMENT Ap_ActivePull.HandwheelVelocity.HwRadpS_f32 /end REF_MEASUREMENT /end GROUP
/begin GROUP Ap_ActivePull.HwTorque.HwNm_f32 "MICROSAR RTE" /begin SUB_GROUP /end SUB_GROUP /begin FUNCTION_LIST /end FUNCTION_LIST /begin REF_CHARACTERISTIC /end REF_CHARACTERISTIC /begin REF_MEASUREMENT Ap_ActivePull.HwTorque.HwNm_f32 /end REF_MEASUREMENT /end GROUP
/begin GROUP Ap_ActivePull.ModeRequirePorts "MICROSAR RTE" /begin SUB_GROUP Ap_ActivePull.SystemState.Mode /end SUB_GROUP /begin FUNCTION_LIST /end FUNCTION_LIST /begin REF_CHARACTERISTIC /end REF_CHARACTERISTIC /begin REF_MEASUREMENT /end REF_MEASUREMENT /end GROUP
/begin GROUP Ap_ActivePull.PullCompCmd.MtrNm_f32 "MICROSAR RTE" /begin SUB_GROUP /end SUB_GROUP /begin FUNCTION_LIST /end FUNCTION_LIST /begin REF_CHARACTERISTIC /end REF_CHARACTERISTIC /begin REF_MEASUREMENT Ap_ActivePull.PullCompCmd.MtrNm_f32 /end REF_MEASUREMENT /end GROUP
/begin GROUP Ap_ActivePull.ReceiverPorts "MICROSAR RTE"
 /begin SUB_GROUP Ap_ActivePull.DisableLearning.Cnt_lgc Ap_ActivePull.DisableOutput.Cnt_lgc Ap_ActivePull.HandwheelAuthority.Uls_f32 Ap_ActivePull.HandwheelPosition.HwDeg_f32 Ap_ActivePull.HandwheelVelocity.HwRadpS_f32 Ap_ActivePull.HwTorque.HwNm_f32 Ap_ActivePull.SrlComYawRate.DegpS_f32 Ap_ActivePull.VehicleSpeed.Kph_f32 Ap_ActivePull.VehicleSpeedValid.Cnt_lgc /end SUB_GROUP
 /begin FUNCTION_LIST /end FUNCTION_LIST
 /begin REF_CHARACTERISTIC /end REF_CHARACTERISTIC
 /begin REF_MEASUREMENT /end REF_MEASUREMENT
/end GROUP
/begin GROUP Ap_ActivePull.SenderPorts "MICROSAR RTE" /begin SUB_GROUP Ap_ActivePull.PullCompCmd.MtrNm_f32 /end SUB_GROUP /begin FUNCTION_LIST /end FUNCTION_LIST /begin REF_CHARACTERISTIC /end REF_CHARACTERISTIC /begin REF_MEASUREMENT /end REF_MEASUREMENT /end GROUP
/begin GROUP Ap_ActivePull.SrlComYawRate.DegpS_f32 "MICROSAR RTE" /begin SUB_GROUP /end SUB_GROUP /begin FUNCTION_LIST /end FUNCTION_LIST /begin REF_CHARACTERISTIC /end REF_CHARACTERISTIC /begin REF_MEASUREMENT Ap_ActivePull.SrlComYawRate.DegpS_f32 /end REF_MEASUREMENT /end GROUP
/begin GROUP Ap_ActivePull.SystemState.Mode "MICROSAR RTE" /begin SUB_GROUP /end SUB_GROUP /begin FUNCTION_LIST /end FUNCTION_LIST /begin REF_CHARACTERISTIC /end REF_CHARACTERISTIC /begin REF_MEASUREMENT Ap_ActivePull.SystemState.Mode /end REF_MEASUREMENT /end GROUP
/begin GROUP Ap_ActivePull.VehicleSpeed.Kph_f32 "MICROSAR RTE" /begin SUB_GROUP /end SUB_GROUP /begin FUNCTION_LIST /end FUNCTION_LIST /begin REF_CHARACTERISTIC /end REF_CHARACTERISTIC /begin REF_MEASUREMENT Ap_ActivePull.VehicleSpeed.Kph_f32 /end REF_MEASUREMENT /end GROUP
/begin GROUP Ap_ActivePull.VehicleSpeedValid.Cnt_lgc "MICROSAR RTE" /begin SUB_GROUP /end SUB_GROUP /begin FUNCTION_LIST /end FUNCTION_LIST /begin REF_CHARACTERISTIC /end REF_CHARACTERISTIC /begin REF_MEASUREMENT Ap_ActivePull.VehicleSpeedValid.Cnt_lgc /end REF_MEASUREMENT /end GROUP
/begin GROUP Ap_ArbLmt "MICROSAR RTE" /begin SUB_GROUP Ap_ArbLmt.ReceiverPorts Ap_ArbLmt.SenderPorts /end SUB_GROUP /begin FUNCTION_LIST /end FUNCTION_LIST /begin REF_CHARACTERISTIC /end REF_CHARACTERISTIC /begin REF_MEASUREMENT /end REF_MEASUREMENT /end GROUP
/begin GROUP Ap_ArbLmt.ActiveFunctionBits.Cnt_u08 "MICROSAR RTE" /begin SUB_GROUP /end SUB_GROUP /begin FUNCTION_LIST /end FUNCTION_LIST /begin REF_CHARACTERISTIC /end REF_CHARACTERISTIC /begin REF_MEASUREMENT Ap_ArbLmt.ActiveFunctionBits.Cnt_u08 /end REF_MEASUREMENT /end GROUP
/begin GROUP Ap_ArbLmt.DSTActive.Cnt_lgc "MICROSAR RTE" /begin SUB_GROUP /end SUB_GROUP /begin FUNCTION_LIST /end FUNCTION_LIST /begin REF_CHARACTERISTIC /end REF_CHARACTERISTIC /begin REF_MEASUREMENT Ap_ArbLmt.DSTActive.Cnt_lgc /end REF_MEASUREMENT /end GROUP
/begin GROUP Ap_ArbLmt.DSTSlewComplete.Cnt_lgc "MICROSAR RTE" /begin SUB_GROUP /end SUB_GROUP /begin FUNCTION_LIST /end FUNCTION_LIST /begin REF_CHARACTERISTIC /end REF_CHARACTERISTIC /begin REF_MEASUREMENT Ap_ArbLmt.DSTSlewComplete.Cnt_lgc /end REF_MEASUREMENT /end GROUP
/begin GROUP Ap_ArbLmt.DSTState.Cnt_u08 "MICROSAR RTE" /begin SUB_GROUP /end SUB_GROUP /begin FUNCTION_LIST /end FUNCTION_LIST /begin REF_CHARACTERISTIC /end REF_CHARACTERISTIC /begin REF_MEASUREMENT Ap_ArbLmt.DSTState.Cnt_u08 /end REF_MEASUREMENT /end GROUP
/begin GROUP Ap_ArbLmt.DSTTrqOvCmdRqst.HwNm_f32 "MICROSAR RTE" /begin SUB_GROUP /end SUB_GROUP /begin FUNCTION_LIST /end FUNCTION_LIST /begin REF_CHARACTERISTIC /end REF_CHARACTERISTIC /begin REF_MEASUREMENT Ap_ArbLmt.DSTTrqOvCmdRqst.HwNm_f32 /end REF_MEASUREMENT /end GROUP
/begin GROUP Ap_ArbLmt.HaLFActive.Cnt_lgc "MICROSAR RTE" /begin SUB_GROUP /end SUB_GROUP /begin FUNCTION_LIST /end FUNCTION_LIST /begin REF_CHARACTERISTIC /end REF_CHARACTERISTIC /begin REF_MEASUREMENT Ap_ArbLmt.HaLFActive.Cnt_lgc /end REF_MEASUREMENT /end GROUP
/begin GROUP Ap_ArbLmt.HaLFSlewComplete.Cnt_lgc "MICROSAR RTE" /begin SUB_GROUP /end SUB_GROUP /begin FUNCTION_LIST /end FUNCTION_LIST /begin REF_CHARACTERISTIC /end REF_CHARACTERISTIC /begin REF_MEASUREMENT Ap_ArbLmt.HaLFSlewComplete.Cnt_lgc /end REF_MEASUREMENT /end GROUP
/begin GROUP Ap_ArbLmt.HaLFTOState.Cnt_u08 "MICROSAR RTE" /begin SUB_GROUP /end SUB_GROUP /begin FUNCTION_LIST /end FUNCTION_LIST /begin REF_CHARACTERISTIC /end REF_CHARACTERISTIC /begin REF_MEASUREMENT Ap_ArbLmt.HaLFTOState.Cnt_u08 /end REF_MEASUREMENT /end GROUP
/begin GROUP Ap_ArbLmt.HaLFTrqOvCmdRqst.MtrNm_f32 "MICROSAR RTE" /begin SUB_GROUP /end SUB_GROUP /begin FUNCTION_LIST /end FUNCTION_LIST /begin REF_CHARACTERISTIC /end REF_CHARACTERISTIC /begin REF_MEASUREMENT Ap_ArbLmt.HaLFTrqOvCmdRqst.MtrNm_f32 /end REF_MEASUREMENT /end GROUP
/begin GROUP Ap_ArbLmt.IpTrqOvr.HwNm_f32 "MICROSAR RTE" /begin SUB_GROUP /end SUB_GROUP /begin FUNCTION_LIST /end FUNCTION_LIST /begin REF_CHARACTERISTIC /end REF_CHARACTERISTIC /begin REF_MEASUREMENT Ap_ArbLmt.IpTrqOvr.HwNm_f32 /end REF_MEASUREMENT /end GROUP
/begin GROUP Ap_ArbLmt.OpTrqOvr.MtrNm_f32 "MICROSAR RTE" /begin SUB_GROUP /end SUB_GROUP /begin FUNCTION_LIST /end FUNCTION_LIST /begin REF_CHARACTERISTIC /end REF_CHARACTERISTIC /begin REF_MEASUREMENT Ap_ArbLmt.OpTrqOvr.MtrNm_f32 /end REF_MEASUREMENT /end GROUP
/begin GROUP Ap_ArbLmt.PAReturnSclFct.Uls_f32 "MICROSAR RTE" /begin SUB_GROUP /end SUB_GROUP /begin FUNCTION_LIST /end FUNCTION_LIST /begin REF_CHARACTERISTIC /end REF_CHARACTERISTIC /begin REF_MEASUREMENT Ap_ArbLmt.PAReturnSclFct.Uls_f32 /end REF_MEASUREMENT /end GROUP
/begin GROUP Ap_ArbLmt.PATrqOvCmdRqst.HwNm_f32 "MICROSAR RTE" /begin SUB_GROUP /end SUB_GROUP /begin FUNCTION_LIST /end FUNCTION_LIST /begin REF_CHARACTERISTIC /end REF_CHARACTERISTIC /begin REF_MEASUREMENT Ap_ArbLmt.PATrqOvCmdRqst.HwNm_f32 /end REF_MEASUREMENT /end GROUP
/begin GROUP Ap_ArbLmt.PrkAssistState.Cnt_u08 "MICROSAR RTE" /begin SUB_GROUP /end SUB_GROUP /begin FUNCTION_LIST /end FUNCTION_LIST /begin REF_CHARACTERISTIC /end REF_CHARACTERISTIC /begin REF_MEASUREMENT Ap_ArbLmt.PrkAssistState.Cnt_u08 /end REF_MEASUREMENT /end GROUP
/begin GROUP Ap_ArbLmt.PrkAsstSlewComplete.Cnt_lgc "MICROSAR RTE" /begin SUB_GROUP /end SUB_GROUP /begin FUNCTION_LIST /end FUNCTION_LIST /begin REF_CHARACTERISTIC /end REF_CHARACTERISTIC /begin REF_MEASUREMENT Ap_ArbLmt.PrkAsstSlewComplete.Cnt_lgc /end REF_MEASUREMENT /end GROUP
/begin GROUP Ap_ArbLmt.ReceiverPorts "MICROSAR RTE"
 /begin SUB_GROUP Ap_ArbLmt.DSTActive.Cnt_lgc Ap_ArbLmt.DSTState.Cnt_u08 Ap_ArbLmt.DSTTrqOvCmdRqst.HwNm_f32 Ap_ArbLmt.HaLFActive.Cnt_lgc Ap_ArbLmt.HaLFTOState.Cnt_u08 Ap_ArbLmt.HaLFTrqOvCmdRqst.MtrNm_f32 Ap_ArbLmt.PATrqOvCmdRqst.HwNm_f32 Ap_ArbLmt.PrkAssistState.Cnt_u08 Ap_ArbLmt.VehicleSpeed.Kph_f32 /end SUB_GROUP
 /begin FUNCTION_LIST /end FUNCTION_LIST
 /begin REF_CHARACTERISTIC /end REF_CHARACTERISTIC
 /begin REF_MEASUREMENT /end REF_MEASUREMENT
/end GROUP
/begin GROUP Ap_ArbLmt.SenderPorts "MICROSAR RTE"
 /begin SUB_GROUP Ap_ArbLmt.ActiveFunctionBits.Cnt_u08 Ap_ArbLmt.DSTSlewComplete.Cnt_lgc Ap_ArbLmt.HaLFSlewComplete.Cnt_lgc Ap_ArbLmt.IpTrqOvr.HwNm_f32 Ap_ArbLmt.OpTrqOvr.MtrNm_f32 Ap_ArbLmt.PAReturnSclFct.Uls_f32 Ap_ArbLmt.PrkAsstSlewComplete.Cnt_lgc /end SUB_GROUP
 /begin FUNCTION_LIST /end FUNCTION_LIST
 /begin REF_CHARACTERISTIC /end REF_CHARACTERISTIC
 /begin REF_MEASUREMENT /end REF_MEASUREMENT
/end GROUP
/begin GROUP Ap_ArbLmt.VehicleSpeed.Kph_f32 "MICROSAR RTE" /begin SUB_GROUP /end SUB_GROUP /begin FUNCTION_LIST /end FUNCTION_LIST /begin REF_CHARACTERISTIC /end REF_CHARACTERISTIC /begin REF_MEASUREMENT Ap_ArbLmt.VehicleSpeed.Kph_f32 /end REF_MEASUREMENT /end GROUP
/begin GROUP Ap_AssistFirewall "MICROSAR RTE"
 /begin SUB_GROUP Ap_AssistFirewall.ReceiverPorts Ap_AssistFirewall.SenderPorts /end SUB_GROUP
 /begin FUNCTION_LIST /end FUNCTION_LIST
 /begin REF_CHARACTERISTIC /end REF_CHARACTERISTIC
 /begin REF_MEASUREMENT /end REF_MEASUREMENT
/end GROUP
/begin GROUP Ap_AssistFirewall.AsstFirewallActive.Uls_f32 "MICROSAR RTE" /begin SUB_GROUP /end SUB_GROUP /begin FUNCTION_LIST /end FUNCTION_LIST /begin REF_CHARACTERISTIC /end REF_CHARACTERISTIC /begin REF_MEASUREMENT Ap_AssistFirewall.AsstFirewallActive.Uls_f32 /end REF_MEASUREMENT /end GROUP
/begin GROUP Ap_AssistFirewall.BaseAssistCmd.MtrNm_f32 "MICROSAR RTE" /begin SUB_GROUP /end SUB_GROUP /begin FUNCTION_LIST /end FUNCTION_LIST /begin REF_CHARACTERISTIC /end REF_CHARACTERISTIC /begin REF_MEASUREMENT Ap_AssistFirewall.BaseAssistCmd.MtrNm_f32 /end REF_MEASUREMENT /end GROUP
/begin GROUP Ap_AssistFirewall.CombinedAssist.MtrNm_f32 "MICROSAR RTE" /begin SUB_GROUP /end SUB_GROUP /begin FUNCTION_LIST /end FUNCTION_LIST /begin REF_CHARACTERISTIC /end REF_CHARACTERISTIC /begin REF_MEASUREMENT Ap_AssistFirewall.CombinedAssist.MtrNm_f32 /end REF_MEASUREMENT /end GROUP
/begin GROUP Ap_AssistFirewall.Defeat_AsstTbl_Service.Cnt_lgc "MICROSAR RTE" /begin SUB_GROUP /end SUB_GROUP /begin FUNCTION_LIST /end FUNCTION_LIST /begin REF_CHARACTERISTIC /end REF_CHARACTERISTIC /begin REF_MEASUREMENT Ap_AssistFirewall.Defeat_AsstTbl_Service.Cnt_lgc /end REF_MEASUREMENT /end GROUP
/begin GROUP Ap_AssistFirewall.HighFreqAssist.MtrNm_f32 "MICROSAR RTE" /begin SUB_GROUP /end SUB_GROUP /begin FUNCTION_LIST /end FUNCTION_LIST /begin REF_CHARACTERISTIC /end REF_CHARACTERISTIC /begin REF_MEASUREMENT Ap_AssistFirewall.HighFreqAssist.MtrNm_f32 /end REF_MEASUREMENT /end GROUP
/begin GROUP Ap_AssistFirewall.HwTorque.HwNm_f32 "MICROSAR RTE" /begin SUB_GROUP /end SUB_GROUP /begin FUNCTION_LIST /end FUNCTION_LIST /begin REF_CHARACTERISTIC /end REF_CHARACTERISTIC /begin REF_MEASUREMENT Ap_AssistFirewall.HwTorque.HwNm_f32 /end REF_MEASUREMENT /end GROUP
/begin GROUP Ap_AssistFirewall.HysteresisComp.MtrNm_f32 "MICROSAR RTE" /begin SUB_GROUP /end SUB_GROUP /begin FUNCTION_LIST /end FUNCTION_LIST /begin REF_CHARACTERISTIC /end REF_CHARACTERISTIC /begin REF_MEASUREMENT Ap_AssistFirewall.HysteresisComp.MtrNm_f32 /end REF_MEASUREMENT /end GROUP
/begin GROUP Ap_AssistFirewall.MEC_Counter.Cnt_enum "MICROSAR RTE" /begin SUB_GROUP /end SUB_GROUP /begin FUNCTION_LIST /end FUNCTION_LIST /begin REF_CHARACTERISTIC /end REF_CHARACTERISTIC /begin REF_MEASUREMENT Ap_AssistFirewall.MEC_Counter.Cnt_enum /end REF_MEASUREMENT /end GROUP
/begin GROUP Ap_AssistFirewall.ReceiverPorts "MICROSAR RTE"
 /begin SUB_GROUP Ap_AssistFirewall.BaseAssistCmd.MtrNm_f32 Ap_AssistFirewall.Defeat_AsstTbl_Service.Cnt_lgc Ap_AssistFirewall.HighFreqAssist.MtrNm_f32 Ap_AssistFirewall.HwTorque.HwNm_f32 Ap_AssistFirewall.HysteresisComp.MtrNm_f32 Ap_AssistFirewall.MEC_Counter.Cnt_enum Ap_AssistFirewall.VehicleSpeed.Kph_f32 /end SUB_GROUP
 /begin FUNCTION_LIST /end FUNCTION_LIST
 /begin REF_CHARACTERISTIC /end REF_CHARACTERISTIC
 /begin REF_MEASUREMENT /end REF_MEASUREMENT
/end GROUP
/begin GROUP Ap_AssistFirewall.SenderPorts "MICROSAR RTE"
 /begin SUB_GROUP Ap_AssistFirewall.AsstFirewallActive.Uls_f32 Ap_AssistFirewall.CombinedAssist.MtrNm_f32 /end SUB_GROUP
 /begin FUNCTION_LIST /end FUNCTION_LIST
 /begin REF_CHARACTERISTIC /end REF_CHARACTERISTIC
 /begin REF_MEASUREMENT /end REF_MEASUREMENT
/end GROUP
/begin GROUP Ap_AssistFirewall.VehicleSpeed.Kph_f32 "MICROSAR RTE" /begin SUB_GROUP /end SUB_GROUP /begin FUNCTION_LIST /end FUNCTION_LIST /begin REF_CHARACTERISTIC /end REF_CHARACTERISTIC /begin REF_MEASUREMENT Ap_AssistFirewall.VehicleSpeed.Kph_f32 /end REF_MEASUREMENT /end GROUP
/begin GROUP Ap_AstLmt "MICROSAR RTE"
 /begin SUB_GROUP Ap_AstLmt.PerInstanceMemories Ap_AstLmt.ReceiverPorts Ap_AstLmt.SenderPorts /end SUB_GROUP
 /begin FUNCTION_LIST /end FUNCTION_LIST
 /begin REF_CHARACTERISTIC /end REF_CHARACTERISTIC
 /begin REF_MEASUREMENT /end REF_MEASUREMENT
/end GROUP
/begin GROUP Ap_AstLmt.AssistCmd.MtrNm_f32 "MICROSAR RTE" /begin SUB_GROUP /end SUB_GROUP /begin FUNCTION_LIST /end FUNCTION_LIST /begin REF_CHARACTERISTIC /end REF_CHARACTERISTIC /begin REF_MEASUREMENT Ap_AstLmt.AssistCmd.MtrNm_f32 /end REF_MEASUREMENT /end GROUP
/begin GROUP Ap_AstLmt.AssistEOTDamping.MtrNm_f32 "MICROSAR RTE" /begin SUB_GROUP /end SUB_GROUP /begin FUNCTION_LIST /end FUNCTION_LIST /begin REF_CHARACTERISTIC /end REF_CHARACTERISTIC /begin REF_MEASUREMENT Ap_AstLmt.AssistEOTDamping.MtrNm_f32 /end REF_MEASUREMENT /end GROUP
/begin GROUP Ap_AstLmt.AssistEOTGain.Uls_f32 "MICROSAR RTE" /begin SUB_GROUP /end SUB_GROUP /begin FUNCTION_LIST /end FUNCTION_LIST /begin REF_CHARACTERISTIC /end REF_CHARACTERISTIC /begin REF_MEASUREMENT Ap_AstLmt.AssistEOTGain.Uls_f32 /end REF_MEASUREMENT /end GROUP
/begin GROUP Ap_AstLmt.AssistEOTLimit.MtrNm_f32 "MICROSAR RTE" /begin SUB_GROUP /end SUB_GROUP /begin FUNCTION_LIST /end FUNCTION_LIST /begin REF_CHARACTERISTIC /end REF_CHARACTERISTIC /begin REF_MEASUREMENT Ap_AstLmt.AssistEOTLimit.MtrNm_f32 /end REF_MEASUREMENT /end GROUP
/begin GROUP Ap_AstLmt.AssistStallLimit.MtrNm_f32 "MICROSAR RTE" /begin SUB_GROUP /end SUB_GROUP /begin FUNCTION_LIST /end FUNCTION_LIST /begin REF_CHARACTERISTIC /end REF_CHARACTERISTIC /begin REF_MEASUREMENT Ap_AstLmt.AssistStallLimit.MtrNm_f32 /end REF_MEASUREMENT /end GROUP
/begin GROUP Ap_AstLmt.AssistVehSpdLimit.MtrNm_f32 "MICROSAR RTE" /begin SUB_GROUP /end SUB_GROUP /begin FUNCTION_LIST /end FUNCTION_LIST /begin REF_CHARACTERISTIC /end REF_CHARACTERISTIC /begin REF_MEASUREMENT Ap_AstLmt.AssistVehSpdLimit.MtrNm_f32 /end REF_MEASUREMENT /end GROUP
/begin GROUP Ap_AstLmt.CombinedDamping.MtrNm_f32 "MICROSAR RTE" /begin SUB_GROUP /end SUB_GROUP /begin FUNCTION_LIST /end FUNCTION_LIST /begin REF_CHARACTERISTIC /end REF_CHARACTERISTIC /begin REF_MEASUREMENT Ap_AstLmt.CombinedDamping.MtrNm_f32 /end REF_MEASUREMENT /end GROUP
/begin GROUP Ap_AstLmt.DefeatLimitService.Cnt_lgc "MICROSAR RTE" /begin SUB_GROUP /end SUB_GROUP /begin FUNCTION_LIST /end FUNCTION_LIST /begin REF_CHARACTERISTIC /end REF_CHARACTERISTIC /begin REF_MEASUREMENT Ap_AstLmt.DefeatLimitService.Cnt_lgc /end REF_MEASUREMENT /end GROUP
/begin GROUP Ap_AstLmt.LimitPercentFiltered.Uls_f32 "MICROSAR RTE" /begin SUB_GROUP /end SUB_GROUP /begin FUNCTION_LIST /end FUNCTION_LIST /begin REF_CHARACTERISTIC /end REF_CHARACTERISTIC /begin REF_MEASUREMENT Ap_AstLmt.LimitPercentFiltered.Uls_f32 /end REF_MEASUREMENT /end GROUP
/begin GROUP Ap_AstLmt.LimitedReturn.MtrNm_f32 "MICROSAR RTE" /begin SUB_GROUP /end SUB_GROUP /begin FUNCTION_LIST /end FUNCTION_LIST /begin REF_CHARACTERISTIC /end REF_CHARACTERISTIC /begin REF_MEASUREMENT Ap_AstLmt.LimitedReturn.MtrNm_f32 /end REF_MEASUREMENT /end GROUP
/begin GROUP Ap_AstLmt.LrnPnCtrCCDisable.Cnt_lgc "MICROSAR RTE" /begin SUB_GROUP /end SUB_GROUP /begin FUNCTION_LIST /end FUNCTION_LIST /begin REF_CHARACTERISTIC /end REF_CHARACTERISTIC /begin REF_MEASUREMENT Ap_AstLmt.LrnPnCtrCCDisable.Cnt_lgc /end REF_MEASUREMENT /end GROUP
/begin GROUP Ap_AstLmt.LrnPnCtrEnable.Cnt_lgc "MICROSAR RTE" /begin SUB_GROUP /end SUB_GROUP /begin FUNCTION_LIST /end FUNCTION_LIST /begin REF_CHARACTERISTIC /end REF_CHARACTERISTIC /begin REF_MEASUREMENT Ap_AstLmt.LrnPnCtrEnable.Cnt_lgc /end REF_MEASUREMENT /end GROUP
/begin GROUP Ap_AstLmt.LrnPnCtrTCmd.MtrNm_f32 "MICROSAR RTE" /begin SUB_GROUP /end SUB_GROUP /begin FUNCTION_LIST /end FUNCTION_LIST /begin REF_CHARACTERISTIC /end REF_CHARACTERISTIC /begin REF_MEASUREMENT Ap_AstLmt.LrnPnCtrTCmd.MtrNm_f32 /end REF_MEASUREMENT /end GROUP
/begin GROUP Ap_AstLmt.OpTrqOvr.MtrNm_f32 "MICROSAR RTE" /begin SUB_GROUP /end SUB_GROUP /begin FUNCTION_LIST /end FUNCTION_LIST /begin REF_CHARACTERISTIC /end REF_CHARACTERISTIC /begin REF_MEASUREMENT Ap_AstLmt.OpTrqOvr.MtrNm_f32 /end REF_MEASUREMENT /end GROUP
/begin GROUP Ap_AstLmt.OutputRampMult.Uls_f32 "MICROSAR RTE" /begin SUB_GROUP /end SUB_GROUP /begin FUNCTION_LIST /end FUNCTION_LIST /begin REF_CHARACTERISTIC /end REF_CHARACTERISTIC /begin REF_MEASUREMENT Ap_AstLmt.OutputRampMult.Uls_f32 /end REF_MEASUREMENT /end GROUP
/begin GROUP Ap_AstLmt.PerInstanceMemories "MICROSAR RTE" /begin SUB_GROUP Ap_AstLmt.SteerAsstDefeat /end SUB_GROUP /begin FUNCTION_LIST /end FUNCTION_LIST /begin REF_CHARACTERISTIC /end REF_CHARACTERISTIC /begin REF_MEASUREMENT /end REF_MEASUREMENT /end GROUP
/begin GROUP Ap_AstLmt.PosServCCDisable.Cnt_lgc "MICROSAR RTE" /begin SUB_GROUP /end SUB_GROUP /begin FUNCTION_LIST /end FUNCTION_LIST /begin REF_CHARACTERISTIC /end REF_CHARACTERISTIC /begin REF_MEASUREMENT Ap_AstLmt.PosServCCDisable.Cnt_lgc /end REF_MEASUREMENT /end GROUP
/begin GROUP Ap_AstLmt.PowerLimitPerc.Uls_f32 "MICROSAR RTE" /begin SUB_GROUP /end SUB_GROUP /begin FUNCTION_LIST /end FUNCTION_LIST /begin REF_CHARACTERISTIC /end REF_CHARACTERISTIC /begin REF_MEASUREMENT Ap_AstLmt.PowerLimitPerc.Uls_f32 /end REF_MEASUREMENT /end GROUP
/begin GROUP Ap_AstLmt.PreLimitForStall.MtrNm_f32 "MICROSAR RTE" /begin SUB_GROUP /end SUB_GROUP /begin FUNCTION_LIST /end FUNCTION_LIST /begin REF_CHARACTERISTIC /end REF_CHARACTERISTIC /begin REF_MEASUREMENT Ap_AstLmt.PreLimitForStall.MtrNm_f32 /end REF_MEASUREMENT /end GROUP
/begin GROUP Ap_AstLmt.PreLimitTorque.MtrNm_f32 "MICROSAR RTE" /begin SUB_GROUP /end SUB_GROUP /begin FUNCTION_LIST /end FUNCTION_LIST /begin REF_CHARACTERISTIC /end REF_CHARACTERISTIC /begin REF_MEASUREMENT Ap_AstLmt.PreLimitTorque.MtrNm_f32 /end REF_MEASUREMENT /end GROUP
/begin GROUP Ap_AstLmt.PrkAssistCmd.MtrNm_f32 "MICROSAR RTE" /begin SUB_GROUP /end SUB_GROUP /begin FUNCTION_LIST /end FUNCTION_LIST /begin REF_CHARACTERISTIC /end REF_CHARACTERISTIC /begin REF_MEASUREMENT Ap_AstLmt.PrkAssistCmd.MtrNm_f32 /end REF_MEASUREMENT /end GROUP
/begin GROUP Ap_AstLmt.PullCompCmd.MtrNm_f32 "MICROSAR RTE" /begin SUB_GROUP /end SUB_GROUP /begin FUNCTION_LIST /end FUNCTION_LIST /begin REF_CHARACTERISTIC /end REF_CHARACTERISTIC /begin REF_MEASUREMENT Ap_AstLmt.PullCompCmd.MtrNm_f32 /end REF_MEASUREMENT /end GROUP
/begin GROUP Ap_AstLmt.ReceiverPorts "MICROSAR RTE"
 /begin SUB_GROUP Ap_AstLmt.AssistCmd.MtrNm_f32 Ap_AstLmt.AssistEOTDamping.MtrNm_f32 Ap_AstLmt.AssistEOTGain.Uls_f32 Ap_AstLmt.AssistEOTLimit.MtrNm_f32 Ap_AstLmt.AssistStallLimit.MtrNm_f32 Ap_AstLmt.AssistVehSpdLimit.MtrNm_f32 Ap_AstLmt.CombinedDamping.MtrNm_f32 Ap_AstLmt.DefeatLimitService.Cnt_lgc Ap_AstLmt.LimitedReturn.MtrNm_f32 Ap_AstLmt.LrnPnCtrCCDisable.Cnt_lgc Ap_AstLmt.LrnPnCtrEnable.Cnt_lgc Ap_AstLmt.LrnPnCtrTCmd.MtrNm_f32 Ap_AstLmt.OpTrqOvr.MtrNm_f32 Ap_AstLmt.OutputRampMult.Uls_f32 Ap_AstLmt.PosServCCDisable.Cnt_lgc Ap_AstLmt.PowerLimitPerc.Uls_f32 Ap_AstLmt.PrkAssistCmd.MtrNm_f32 Ap_AstLmt.PullCompCmd.MtrNm_f32 Ap_AstLmt.ThermalLimit.MtrNm_f32 Ap_AstLmt.ThermalLimitPerc.Uls_f32 Ap_AstLmt.VehSpd.Kph_f32 Ap_AstLmt.WheelImbalanceCmd.MtrNm_f32 /end SUB_GROUP
 /begin FUNCTION_LIST /end FUNCTION_LIST
 /begin REF_CHARACTERISTIC /end REF_CHARACTERISTIC
 /begin REF_MEASUREMENT /end REF_MEASUREMENT
/end GROUP
/begin GROUP Ap_AstLmt.SenderPorts "MICROSAR RTE"
 /begin SUB_GROUP Ap_AstLmt.LimitPercentFiltered.Uls_f32 Ap_AstLmt.PreLimitForStall.MtrNm_f32 Ap_AstLmt.PreLimitTorque.MtrNm_f32 Ap_AstLmt.SumLimTrqCmd.MtrNm_f32 Ap_AstLmt.TrqLimitMin.MtrNm_f32 /end SUB_GROUP
 /begin FUNCTION_LIST /end FUNCTION_LIST
 /begin REF_CHARACTERISTIC /end REF_CHARACTERISTIC
 /begin REF_MEASUREMENT /end REF_MEASUREMENT
/end GROUP
/begin GROUP Ap_AstLmt.SteerAsstDefeat "MICROSAR RTE" /begin SUB_GROUP /end SUB_GROUP /begin FUNCTION_LIST /end FUNCTION_LIST /begin REF_CHARACTERISTIC /end REF_CHARACTERISTIC /begin REF_MEASUREMENT Ap_AstLmt.SteerAsstDefeat /end REF_MEASUREMENT /end GROUP
/begin GROUP Ap_AstLmt.SumLimTrqCmd.MtrNm_f32 "MICROSAR RTE" /begin SUB_GROUP /end SUB_GROUP /begin FUNCTION_LIST /end FUNCTION_LIST /begin REF_CHARACTERISTIC /end REF_CHARACTERISTIC /begin REF_MEASUREMENT Ap_AstLmt.SumLimTrqCmd.MtrNm_f32 /end REF_MEASUREMENT /end GROUP
/begin GROUP Ap_AstLmt.ThermalLimit.MtrNm_f32 "MICROSAR RTE" /begin SUB_GROUP /end SUB_GROUP /begin FUNCTION_LIST /end FUNCTION_LIST /begin REF_CHARACTERISTIC /end REF_CHARACTERISTIC /begin REF_MEASUREMENT Ap_AstLmt.ThermalLimit.MtrNm_f32 /end REF_MEASUREMENT /end GROUP
/begin GROUP Ap_AstLmt.ThermalLimitPerc.Uls_f32 "MICROSAR RTE" /begin SUB_GROUP /end SUB_GROUP /begin FUNCTION_LIST /end FUNCTION_LIST /begin REF_CHARACTERISTIC /end REF_CHARACTERISTIC /begin REF_MEASUREMENT Ap_AstLmt.ThermalLimitPerc.Uls_f32 /end REF_MEASUREMENT /end GROUP
/begin GROUP Ap_AstLmt.TrqLimitMin.MtrNm_f32 "MICROSAR RTE" /begin SUB_GROUP /end SUB_GROUP /begin FUNCTION_LIST /end FUNCTION_LIST /begin REF_CHARACTERISTIC /end REF_CHARACTERISTIC /begin REF_MEASUREMENT Ap_AstLmt.TrqLimitMin.MtrNm_f32 /end REF_MEASUREMENT /end GROUP
/begin GROUP Ap_AstLmt.VehSpd.Kph_f32 "MICROSAR RTE" /begin SUB_GROUP /end SUB_GROUP /begin FUNCTION_LIST /end FUNCTION_LIST /begin REF_CHARACTERISTIC /end REF_CHARACTERISTIC /begin REF_MEASUREMENT Ap_AstLmt.VehSpd.Kph_f32 /end REF_MEASUREMENT /end GROUP
/begin GROUP Ap_AstLmt.WheelImbalanceCmd.MtrNm_f32 "MICROSAR RTE" /begin SUB_GROUP /end SUB_GROUP /begin FUNCTION_LIST /end FUNCTION_LIST /begin REF_CHARACTERISTIC /end REF_CHARACTERISTIC /begin REF_MEASUREMENT Ap_AstLmt.WheelImbalanceCmd.MtrNm_f32 /end REF_MEASUREMENT /end GROUP
/begin GROUP Ap_AvgFricLrn "MICROSAR RTE"
 /begin SUB_GROUP Ap_AvgFricLrn.ModeRequirePorts Ap_AvgFricLrn.PerInstanceMemories Ap_AvgFricLrn.ReceiverPorts Ap_AvgFricLrn.SenderPorts /end SUB_GROUP
 /begin FUNCTION_LIST /end FUNCTION_LIST
 /begin REF_CHARACTERISTIC /end REF_CHARACTERISTIC
 /begin REF_MEASUREMENT /end REF_MEASUREMENT
/end GROUP
/begin GROUP Ap_AvgFricLrn.AvgFricLrnData "MICROSAR RTE" /begin SUB_GROUP /end SUB_GROUP /begin FUNCTION_LIST /end FUNCTION_LIST /begin REF_CHARACTERISTIC /end REF_CHARACTERISTIC
 /begin REF_MEASUREMENT Ap_AvgFricLrn.AvgFricLrnData.EOLFric_HwNm_f32 Ap_AvgFricLrn.AvgFricLrnData.EnableFricLearning_Cnt_lgc Ap_AvgFricLrn.AvgFricLrnData.EnableFricOffsetOutput_Cnt_lgc Ap_AvgFricLrn.AvgFricLrnData.FricOffset_HwNm_f32 Ap_AvgFricLrn.AvgFricLrnData.OpMode_Cnt_enum Ap_AvgFricLrn.AvgFricLrnData.RangeCounter_Cnt_u16 Ap_AvgFricLrn.AvgFricLrnData.Theta_HwNm_f32 Ap_AvgFricLrn.AvgFricLrnData.VehLearnedFric_HwNm_f32 /end REF_MEASUREMENT
/end GROUP
/begin GROUP Ap_AvgFricLrn.CRFMtrTrq.MtrNm_f32 "MICROSAR RTE" /begin SUB_GROUP /end SUB_GROUP /begin FUNCTION_LIST /end FUNCTION_LIST /begin REF_CHARACTERISTIC /end REF_CHARACTERISTIC /begin REF_MEASUREMENT Ap_AvgFricLrn.CRFMtrTrq.MtrNm_f32 /end REF_MEASUREMENT /end GROUP
/begin GROUP Ap_AvgFricLrn.DefeatFricLearning.Cnt_lgc "MICROSAR RTE" /begin SUB_GROUP /end SUB_GROUP /begin FUNCTION_LIST /end FUNCTION_LIST /begin REF_CHARACTERISTIC /end REF_CHARACTERISTIC /begin REF_MEASUREMENT Ap_AvgFricLrn.DefeatFricLearning.Cnt_lgc /end REF_MEASUREMENT /end GROUP
/begin GROUP Ap_AvgFricLrn.EstFric.HwNm_f32 "MICROSAR RTE" /begin SUB_GROUP /end SUB_GROUP /begin FUNCTION_LIST /end FUNCTION_LIST /begin REF_CHARACTERISTIC /end REF_CHARACTERISTIC /begin REF_MEASUREMENT Ap_AvgFricLrn.EstFric.HwNm_f32 /end REF_MEASUREMENT /end GROUP
/begin GROUP Ap_AvgFricLrn.FricOffset.HwNm_f32 "MICROSAR RTE" /begin SUB_GROUP /end SUB_GROUP /begin FUNCTION_LIST /end FUNCTION_LIST /begin REF_CHARACTERISTIC /end REF_CHARACTERISTIC /begin REF_MEASUREMENT Ap_AvgFricLrn.FricOffset.HwNm_f32 /end REF_MEASUREMENT /end GROUP
/begin GROUP Ap_AvgFricLrn.HwAng.HwDeg_f32 "MICROSAR RTE" /begin SUB_GROUP /end SUB_GROUP /begin FUNCTION_LIST /end FUNCTION_LIST /begin REF_CHARACTERISTIC /end REF_CHARACTERISTIC /begin REF_MEASUREMENT Ap_AvgFricLrn.HwAng.HwDeg_f32 /end REF_MEASUREMENT /end GROUP
/begin GROUP Ap_AvgFricLrn.HwPosAuthority.Uls_f32 "MICROSAR RTE" /begin SUB_GROUP /end SUB_GROUP /begin FUNCTION_LIST /end FUNCTION_LIST /begin REF_CHARACTERISTIC /end REF_CHARACTERISTIC /begin REF_MEASUREMENT Ap_AvgFricLrn.HwPosAuthority.Uls_f32 /end REF_MEASUREMENT /end GROUP
/begin GROUP Ap_AvgFricLrn.HwTrq.HwNm_f32 "MICROSAR RTE" /begin SUB_GROUP /end SUB_GROUP /begin FUNCTION_LIST /end FUNCTION_LIST /begin REF_CHARACTERISTIC /end REF_CHARACTERISTIC /begin REF_MEASUREMENT Ap_AvgFricLrn.HwTrq.HwNm_f32 /end REF_MEASUREMENT /end GROUP
/begin GROUP Ap_AvgFricLrn.HwVel.HwRadpS_f32 "MICROSAR RTE" /begin SUB_GROUP /end SUB_GROUP /begin FUNCTION_LIST /end FUNCTION_LIST /begin REF_CHARACTERISTIC /end REF_CHARACTERISTIC /begin REF_MEASUREMENT Ap_AvgFricLrn.HwVel.HwRadpS_f32 /end REF_MEASUREMENT /end GROUP
/begin GROUP Ap_AvgFricLrn.ModeRequirePorts "MICROSAR RTE" /begin SUB_GROUP Ap_AvgFricLrn.SystemState.Mode /end SUB_GROUP /begin FUNCTION_LIST /end FUNCTION_LIST /begin REF_CHARACTERISTIC /end REF_CHARACTERISTIC /begin REF_MEASUREMENT /end REF_MEASUREMENT /end GROUP
/begin GROUP Ap_AvgFricLrn.PerInstanceMemories "MICROSAR RTE" /begin SUB_GROUP Ap_AvgFricLrn.AvgFricLrnData /end SUB_GROUP /begin FUNCTION_LIST /end FUNCTION_LIST /begin REF_CHARACTERISTIC /end REF_CHARACTERISTIC /begin REF_MEASUREMENT /end REF_MEASUREMENT /end GROUP
/begin GROUP Ap_AvgFricLrn.ReceiverPorts "MICROSAR RTE"
 /begin SUB_GROUP Ap_AvgFricLrn.CRFMtrTrq.MtrNm_f32 Ap_AvgFricLrn.DefeatFricLearning.Cnt_lgc Ap_AvgFricLrn.HwAng.HwDeg_f32 Ap_AvgFricLrn.HwPosAuthority.Uls_f32 Ap_AvgFricLrn.HwTrq.HwNm_f32 Ap_AvgFricLrn.HwVel.HwRadpS_f32 Ap_AvgFricLrn.Temperature.DegC_f32 Ap_AvgFricLrn.VehSpd.Kph_f32 Ap_AvgFricLrn.VehicleSpeedValid.Cnt_lgc /end SUB_GROUP
 /begin FUNCTION_LIST /end FUNCTION_LIST
 /begin REF_CHARACTERISTIC /end REF_CHARACTERISTIC
 /begin REF_MEASUREMENT /end REF_MEASUREMENT
/end GROUP
/begin GROUP Ap_AvgFricLrn.SatEstFric.HwNm_f32 "MICROSAR RTE" /begin SUB_GROUP /end SUB_GROUP /begin FUNCTION_LIST /end FUNCTION_LIST /begin REF_CHARACTERISTIC /end REF_CHARACTERISTIC /begin REF_MEASUREMENT Ap_AvgFricLrn.SatEstFric.HwNm_f32 /end REF_MEASUREMENT /end GROUP
/begin GROUP Ap_AvgFricLrn.SenderPorts "MICROSAR RTE"
 /begin SUB_GROUP Ap_AvgFricLrn.EstFric.HwNm_f32 Ap_AvgFricLrn.FricOffset.HwNm_f32 Ap_AvgFricLrn.SatEstFric.HwNm_f32 /end SUB_GROUP
 /begin FUNCTION_LIST /end FUNCTION_LIST
 /begin REF_CHARACTERISTIC /end REF_CHARACTERISTIC
 /begin REF_MEASUREMENT /end REF_MEASUREMENT
/end GROUP
/begin GROUP Ap_AvgFricLrn.SystemState.Mode "MICROSAR RTE" /begin SUB_GROUP /end SUB_GROUP /begin FUNCTION_LIST /end FUNCTION_LIST /begin REF_CHARACTERISTIC /end REF_CHARACTERISTIC /begin REF_MEASUREMENT Ap_AvgFricLrn.SystemState.Mode /end REF_MEASUREMENT /end GROUP
/begin GROUP Ap_AvgFricLrn.Temperature.DegC_f32 "MICROSAR RTE" /begin SUB_GROUP /end SUB_GROUP /begin FUNCTION_LIST /end FUNCTION_LIST /begin REF_CHARACTERISTIC /end REF_CHARACTERISTIC /begin REF_MEASUREMENT Ap_AvgFricLrn.Temperature.DegC_f32 /end REF_MEASUREMENT /end GROUP
/begin GROUP Ap_AvgFricLrn.VehSpd.Kph_f32 "MICROSAR RTE" /begin SUB_GROUP /end SUB_GROUP /begin FUNCTION_LIST /end FUNCTION_LIST /begin REF_CHARACTERISTIC /end REF_CHARACTERISTIC /begin REF_MEASUREMENT Ap_AvgFricLrn.VehSpd.Kph_f32 /end REF_MEASUREMENT /end GROUP
/begin GROUP Ap_AvgFricLrn.VehicleSpeedValid.Cnt_lgc "MICROSAR RTE" /begin SUB_GROUP /end SUB_GROUP /begin FUNCTION_LIST /end FUNCTION_LIST /begin REF_CHARACTERISTIC /end REF_CHARACTERISTIC /begin REF_MEASUREMENT Ap_AvgFricLrn.VehicleSpeedValid.Cnt_lgc /end REF_MEASUREMENT /end GROUP
/begin GROUP Ap_BVDiag "MICROSAR RTE" /begin SUB_GROUP Ap_BVDiag.ReceiverPorts /end SUB_GROUP /begin FUNCTION_LIST /end FUNCTION_LIST /begin REF_CHARACTERISTIC /end REF_CHARACTERISTIC /begin REF_MEASUREMENT /end REF_MEASUREMENT /end GROUP
/begin GROUP Ap_BVDiag.Batt.Volt_f32 "MICROSAR RTE" /begin SUB_GROUP /end SUB_GROUP /begin FUNCTION_LIST /end FUNCTION_LIST /begin REF_CHARACTERISTIC /end REF_CHARACTERISTIC /begin REF_MEASUREMENT Ap_BVDiag.Batt.Volt_f32 /end REF_MEASUREMENT /end GROUP
/begin GROUP Ap_BVDiag.CCLMSAActive.Cnt_lgc "MICROSAR RTE" /begin SUB_GROUP /end SUB_GROUP /begin FUNCTION_LIST /end FUNCTION_LIST /begin REF_CHARACTERISTIC /end REF_CHARACTERISTIC /begin REF_MEASUREMENT Ap_BVDiag.CCLMSAActive.Cnt_lgc /end REF_MEASUREMENT /end GROUP
/begin GROUP Ap_BVDiag.ReceiverPorts "MICROSAR RTE" /begin SUB_GROUP Ap_BVDiag.Batt.Volt_f32 Ap_BVDiag.CCLMSAActive.Cnt_lgc /end SUB_GROUP /begin FUNCTION_LIST /end FUNCTION_LIST /begin REF_CHARACTERISTIC /end REF_CHARACTERISTIC /begin REF_MEASUREMENT /end REF_MEASUREMENT /end GROUP
/begin GROUP Ap_DampingFirewall "MICROSAR RTE"
 /begin SUB_GROUP Ap_DampingFirewall.ReceiverPorts Ap_DampingFirewall.SenderPorts /end SUB_GROUP
 /begin FUNCTION_LIST /end FUNCTION_LIST
 /begin REF_CHARACTERISTIC /end REF_CHARACTERISTIC
 /begin REF_MEASUREMENT /end REF_MEASUREMENT
/end GROUP
/begin GROUP Ap_DampingFirewall.AsstFirewallActive.Uls_f32 "MICROSAR RTE" /begin SUB_GROUP /end SUB_GROUP /begin FUNCTION_LIST /end FUNCTION_LIST /begin REF_CHARACTERISTIC /end REF_CHARACTERISTIC /begin REF_MEASUREMENT Ap_DampingFirewall.AsstFirewallActive.Uls_f32 /end REF_MEASUREMENT /end GROUP
/begin GROUP Ap_DampingFirewall.BaseAssistCmd.MtrNm_f32 "MICROSAR RTE" /begin SUB_GROUP /end SUB_GROUP /begin FUNCTION_LIST /end FUNCTION_LIST /begin REF_CHARACTERISTIC /end REF_CHARACTERISTIC /begin REF_MEASUREMENT Ap_DampingFirewall.BaseAssistCmd.MtrNm_f32 /end REF_MEASUREMENT /end GROUP
/begin GROUP Ap_DampingFirewall.CombinedDamping.MtrNm_f32 "MICROSAR RTE" /begin SUB_GROUP /end SUB_GROUP /begin FUNCTION_LIST /end FUNCTION_LIST /begin REF_CHARACTERISTIC /end REF_CHARACTERISTIC /begin REF_MEASUREMENT Ap_DampingFirewall.CombinedDamping.MtrNm_f32 /end REF_MEASUREMENT /end GROUP
/begin GROUP Ap_DampingFirewall.DampingCmd.MtrNm_f32 "MICROSAR RTE" /begin SUB_GROUP /end SUB_GROUP /begin FUNCTION_LIST /end FUNCTION_LIST /begin REF_CHARACTERISTIC /end REF_CHARACTERISTIC /begin REF_MEASUREMENT Ap_DampingFirewall.DampingCmd.MtrNm_f32 /end REF_MEASUREMENT /end GROUP
/begin GROUP Ap_DampingFirewall.Defeat_Damping_Svc.Cnt_lgc "MICROSAR RTE" /begin SUB_GROUP /end SUB_GROUP /begin FUNCTION_LIST /end FUNCTION_LIST /begin REF_CHARACTERISTIC /end REF_CHARACTERISTIC /begin REF_MEASUREMENT Ap_DampingFirewall.Defeat_Damping_Svc.Cnt_lgc /end REF_MEASUREMENT /end GROUP
/begin GROUP Ap_DampingFirewall.FreqDepDmpSrlComSvcDft.Cnt_lgc "MICROSAR RTE" /begin SUB_GROUP /end SUB_GROUP /begin FUNCTION_LIST /end FUNCTION_LIST /begin REF_CHARACTERISTIC /end REF_CHARACTERISTIC /begin REF_MEASUREMENT Ap_DampingFirewall.FreqDepDmpSrlComSvcDft.Cnt_lgc /end REF_MEASUREMENT /end GROUP
/begin GROUP Ap_DampingFirewall.HwTorque.HwNm_f32 "MICROSAR RTE" /begin SUB_GROUP /end SUB_GROUP /begin FUNCTION_LIST /end FUNCTION_LIST /begin REF_CHARACTERISTIC /end REF_CHARACTERISTIC /begin REF_MEASUREMENT Ap_DampingFirewall.HwTorque.HwNm_f32 /end REF_MEASUREMENT /end GROUP
/begin GROUP Ap_DampingFirewall.InertiaComp.MtrNm_f32 "MICROSAR RTE" /begin SUB_GROUP /end SUB_GROUP /begin FUNCTION_LIST /end FUNCTION_LIST /begin REF_CHARACTERISTIC /end REF_CHARACTERISTIC /begin REF_MEASUREMENT Ap_DampingFirewall.InertiaComp.MtrNm_f32 /end REF_MEASUREMENT /end GROUP
/begin GROUP Ap_DampingFirewall.MEC_Counter.Cnt_enum "MICROSAR RTE" /begin SUB_GROUP /end SUB_GROUP /begin FUNCTION_LIST /end FUNCTION_LIST /begin REF_CHARACTERISTIC /end REF_CHARACTERISTIC /begin REF_MEASUREMENT Ap_DampingFirewall.MEC_Counter.Cnt_enum /end REF_MEASUREMENT /end GROUP
/begin GROUP Ap_DampingFirewall.MtrVelCRF.MtrRadpS_f32 "MICROSAR RTE" /begin SUB_GROUP /end SUB_GROUP /begin FUNCTION_LIST /end FUNCTION_LIST /begin REF_CHARACTERISTIC /end REF_CHARACTERISTIC /begin REF_MEASUREMENT Ap_DampingFirewall.MtrVelCRF.MtrRadpS_f32 /end REF_MEASUREMENT /end GROUP
/begin GROUP Ap_DampingFirewall.ReceiverPorts "MICROSAR RTE"
 /begin SUB_GROUP Ap_DampingFirewall.AsstFirewallActive.Uls_f32 Ap_DampingFirewall.BaseAssistCmd.MtrNm_f32 Ap_DampingFirewall.DampingCmd.MtrNm_f32 Ap_DampingFirewall.Defeat_Damping_Svc.Cnt_lgc Ap_DampingFirewall.FreqDepDmpSrlComSvcDft.Cnt_lgc Ap_DampingFirewall.HwTorque.HwNm_f32 Ap_DampingFirewall.InertiaComp.MtrNm_f32 Ap_DampingFirewall.MEC_Counter.Cnt_enum Ap_DampingFirewall.MtrVelCRF.MtrRadpS_f32 Ap_DampingFirewall.VehicleLonAccel.KphpS_f32 Ap_DampingFirewall.VehicleSpeed.Kph_f32 Ap_DampingFirewall.WIRCmdAmpBlnd.MtrNm_f32 /end SUB_GROUP
 /begin FUNCTION_LIST /end FUNCTION_LIST
 /begin REF_CHARACTERISTIC /end REF_CHARACTERISTIC
 /begin REF_MEASUREMENT /end REF_MEASUREMENT
/end GROUP
/begin GROUP Ap_DampingFirewall.SenderPorts "MICROSAR RTE" /begin SUB_GROUP Ap_DampingFirewall.CombinedDamping.MtrNm_f32 /end SUB_GROUP /begin FUNCTION_LIST /end FUNCTION_LIST /begin REF_CHARACTERISTIC /end REF_CHARACTERISTIC /begin REF_MEASUREMENT /end REF_MEASUREMENT /end GROUP
/begin GROUP Ap_DampingFirewall.VehicleLonAccel.KphpS_f32 "MICROSAR RTE" /begin SUB_GROUP /end SUB_GROUP /begin FUNCTION_LIST /end FUNCTION_LIST /begin REF_CHARACTERISTIC /end REF_CHARACTERISTIC /begin REF_MEASUREMENT Ap_DampingFirewall.VehicleLonAccel.KphpS_f32 /end REF_MEASUREMENT /end GROUP
/begin GROUP Ap_DampingFirewall.VehicleSpeed.Kph_f32 "MICROSAR RTE" /begin SUB_GROUP /end SUB_GROUP /begin FUNCTION_LIST /end FUNCTION_LIST /begin REF_CHARACTERISTIC /end REF_CHARACTERISTIC /begin REF_MEASUREMENT Ap_DampingFirewall.VehicleSpeed.Kph_f32 /end REF_MEASUREMENT /end GROUP
/begin GROUP Ap_DampingFirewall.WIRCmdAmpBlnd.MtrNm_f32 "MICROSAR RTE" /begin SUB_GROUP /end SUB_GROUP /begin FUNCTION_LIST /end FUNCTION_LIST /begin REF_CHARACTERISTIC /end REF_CHARACTERISTIC /begin REF_MEASUREMENT Ap_DampingFirewall.WIRCmdAmpBlnd.MtrNm_f32 /end REF_MEASUREMENT /end GROUP
/begin GROUP Ap_DiagMgr8 "MICROSAR RTE" /begin SUB_GROUP Ap_DiagMgr8.ModeRequirePorts Ap_DiagMgr8.ReceiverPorts /end SUB_GROUP /begin FUNCTION_LIST /end FUNCTION_LIST /begin REF_CHARACTERISTIC /end REF_CHARACTERISTIC /begin REF_MEASUREMENT /end REF_MEASUREMENT /end GROUP
/begin GROUP Ap_DiagMgr8.HwTrq.HwNm_f32 "MICROSAR RTE" /begin SUB_GROUP /end SUB_GROUP /begin FUNCTION_LIST /end FUNCTION_LIST /begin REF_CHARACTERISTIC /end REF_CHARACTERISTIC /begin REF_MEASUREMENT Ap_DiagMgr8.HwTrq.HwNm_f32 /end REF_MEASUREMENT /end GROUP
/begin GROUP Ap_DiagMgr8.IgnCnt.Cnt_u16 "MICROSAR RTE" /begin SUB_GROUP /end SUB_GROUP /begin FUNCTION_LIST /end FUNCTION_LIST /begin REF_CHARACTERISTIC /end REF_CHARACTERISTIC /begin REF_MEASUREMENT Ap_DiagMgr8.IgnCnt.Cnt_u16 /end REF_MEASUREMENT /end GROUP
/begin GROUP Ap_DiagMgr8.MEC.Cnt_enum "MICROSAR RTE" /begin SUB_GROUP /end SUB_GROUP /begin FUNCTION_LIST /end FUNCTION_LIST /begin REF_CHARACTERISTIC /end REF_CHARACTERISTIC /begin REF_MEASUREMENT Ap_DiagMgr8.MEC.Cnt_enum /end REF_MEASUREMENT /end GROUP
/begin GROUP Ap_DiagMgr8.MfgDiagInhibit.Cnt_lgc "MICROSAR RTE" /begin SUB_GROUP /end SUB_GROUP /begin FUNCTION_LIST /end FUNCTION_LIST /begin REF_CHARACTERISTIC /end REF_CHARACTERISTIC /begin REF_MEASUREMENT Ap_DiagMgr8.MfgDiagInhibit.Cnt_lgc /end REF_MEASUREMENT /end GROUP
/begin GROUP Ap_DiagMgr8.ModeRequirePorts "MICROSAR RTE" /begin SUB_GROUP Ap_DiagMgr8.SystemState.Mode /end SUB_GROUP /begin FUNCTION_LIST /end FUNCTION_LIST /begin REF_CHARACTERISTIC /end REF_CHARACTERISTIC /begin REF_MEASUREMENT /end REF_MEASUREMENT /end GROUP
/begin GROUP Ap_DiagMgr8.MtrTrq.MtrNm_f32 "MICROSAR RTE" /begin SUB_GROUP /end SUB_GROUP /begin FUNCTION_LIST /end FUNCTION_LIST /begin REF_CHARACTERISTIC /end REF_CHARACTERISTIC /begin REF_MEASUREMENT Ap_DiagMgr8.MtrTrq.MtrNm_f32 /end REF_MEASUREMENT /end GROUP
/begin GROUP Ap_DiagMgr8.ReceiverPorts "MICROSAR RTE"
 /begin SUB_GROUP Ap_DiagMgr8.HwTrq.HwNm_f32 Ap_DiagMgr8.IgnCnt.Cnt_u16 Ap_DiagMgr8.MEC.Cnt_enum Ap_DiagMgr8.MfgDiagInhibit.Cnt_lgc Ap_DiagMgr8.MtrTrq.MtrNm_f32 Ap_DiagMgr8.VehSpd.Kph_f32 /end SUB_GROUP
 /begin FUNCTION_LIST /end FUNCTION_LIST
 /begin REF_CHARACTERISTIC /end REF_CHARACTERISTIC
 /begin REF_MEASUREMENT /end REF_MEASUREMENT
/end GROUP
/begin GROUP Ap_DiagMgr8.SystemState.Mode "MICROSAR RTE" /begin SUB_GROUP /end SUB_GROUP /begin FUNCTION_LIST /end FUNCTION_LIST /begin REF_CHARACTERISTIC /end REF_CHARACTERISTIC /begin REF_MEASUREMENT Ap_DiagMgr8.SystemState.Mode /end REF_MEASUREMENT /end GROUP
/begin GROUP Ap_DiagMgr8.VehSpd.Kph_f32 "MICROSAR RTE" /begin SUB_GROUP /end SUB_GROUP /begin FUNCTION_LIST /end FUNCTION_LIST /begin REF_CHARACTERISTIC /end REF_CHARACTERISTIC /begin REF_MEASUREMENT Ap_DiagMgr8.VehSpd.Kph_f32 /end REF_MEASUREMENT /end GROUP
/begin GROUP Ap_DiagMgr9 "MICROSAR RTE" /begin SUB_GROUP Ap_DiagMgr9.ModeRequirePorts Ap_DiagMgr9.ReceiverPorts /end SUB_GROUP /begin FUNCTION_LIST /end FUNCTION_LIST /begin REF_CHARACTERISTIC /end REF_CHARACTERISTIC /begin REF_MEASUREMENT /end REF_MEASUREMENT /end GROUP
/begin GROUP Ap_DiagMgr9.HwTrq.HwNm_f32 "MICROSAR RTE" /begin SUB_GROUP /end SUB_GROUP /begin FUNCTION_LIST /end FUNCTION_LIST /begin REF_CHARACTERISTIC /end REF_CHARACTERISTIC /begin REF_MEASUREMENT Ap_DiagMgr9.HwTrq.HwNm_f32 /end REF_MEASUREMENT /end GROUP
/begin GROUP Ap_DiagMgr9.IgnCnt.Cnt_u16 "MICROSAR RTE" /begin SUB_GROUP /end SUB_GROUP /begin FUNCTION_LIST /end FUNCTION_LIST /begin REF_CHARACTERISTIC /end REF_CHARACTERISTIC /begin REF_MEASUREMENT Ap_DiagMgr9.IgnCnt.Cnt_u16 /end REF_MEASUREMENT /end GROUP
/begin GROUP Ap_DiagMgr9.MEC.Cnt_enum "MICROSAR RTE" /begin SUB_GROUP /end SUB_GROUP /begin FUNCTION_LIST /end FUNCTION_LIST /begin REF_CHARACTERISTIC /end REF_CHARACTERISTIC /begin REF_MEASUREMENT Ap_DiagMgr9.MEC.Cnt_enum /end REF_MEASUREMENT /end GROUP
/begin GROUP Ap_DiagMgr9.MfgDiagInhibit.Cnt_lgc "MICROSAR RTE" /begin SUB_GROUP /end SUB_GROUP /begin FUNCTION_LIST /end FUNCTION_LIST /begin REF_CHARACTERISTIC /end REF_CHARACTERISTIC /begin REF_MEASUREMENT Ap_DiagMgr9.MfgDiagInhibit.Cnt_lgc /end REF_MEASUREMENT /end GROUP
/begin GROUP Ap_DiagMgr9.ModeRequirePorts "MICROSAR RTE" /begin SUB_GROUP Ap_DiagMgr9.SystemState.Mode /end SUB_GROUP /begin FUNCTION_LIST /end FUNCTION_LIST /begin REF_CHARACTERISTIC /end REF_CHARACTERISTIC /begin REF_MEASUREMENT /end REF_MEASUREMENT /end GROUP
/begin GROUP Ap_DiagMgr9.MtrTrq.MtrNm_f32 "MICROSAR RTE" /begin SUB_GROUP /end SUB_GROUP /begin FUNCTION_LIST /end FUNCTION_LIST /begin REF_CHARACTERISTIC /end REF_CHARACTERISTIC /begin REF_MEASUREMENT Ap_DiagMgr9.MtrTrq.MtrNm_f32 /end REF_MEASUREMENT /end GROUP
/begin GROUP Ap_DiagMgr9.ReceiverPorts "MICROSAR RTE"
 /begin SUB_GROUP Ap_DiagMgr9.HwTrq.HwNm_f32 Ap_DiagMgr9.IgnCnt.Cnt_u16 Ap_DiagMgr9.MEC.Cnt_enum Ap_DiagMgr9.MfgDiagInhibit.Cnt_lgc Ap_DiagMgr9.MtrTrq.MtrNm_f32 Ap_DiagMgr9.VehSpd.Kph_f32 /end SUB_GROUP
 /begin FUNCTION_LIST /end FUNCTION_LIST
 /begin REF_CHARACTERISTIC /end REF_CHARACTERISTIC
 /begin REF_MEASUREMENT /end REF_MEASUREMENT
/end GROUP
/begin GROUP Ap_DiagMgr9.SystemState.Mode "MICROSAR RTE" /begin SUB_GROUP /end SUB_GROUP /begin FUNCTION_LIST /end FUNCTION_LIST /begin REF_CHARACTERISTIC /end REF_CHARACTERISTIC /begin REF_MEASUREMENT Ap_DiagMgr9.SystemState.Mode /end REF_MEASUREMENT /end GROUP
/begin GROUP Ap_DiagMgr9.VehSpd.Kph_f32 "MICROSAR RTE" /begin SUB_GROUP /end SUB_GROUP /begin FUNCTION_LIST /end FUNCTION_LIST /begin REF_CHARACTERISTIC /end REF_CHARACTERISTIC /begin REF_MEASUREMENT Ap_DiagMgr9.VehSpd.Kph_f32 /end REF_MEASUREMENT /end GROUP
/begin GROUP Ap_ElePwr "MICROSAR RTE" /begin SUB_GROUP Ap_ElePwr.ReceiverPorts Ap_ElePwr.SenderPorts /end SUB_GROUP /begin FUNCTION_LIST /end FUNCTION_LIST /begin REF_CHARACTERISTIC /end REF_CHARACTERISTIC /begin REF_MEASUREMENT /end REF_MEASUREMENT /end GROUP
/begin GROUP Ap_ElePwr.ElectricPower.Watt_f32 "MICROSAR RTE" /begin SUB_GROUP /end SUB_GROUP /begin FUNCTION_LIST /end FUNCTION_LIST /begin REF_CHARACTERISTIC /end REF_CHARACTERISTIC /begin REF_MEASUREMENT Ap_ElePwr.ElectricPower.Watt_f32 /end REF_MEASUREMENT /end GROUP
/begin GROUP Ap_ElePwr.MtrCurrDax.Amp_f32 "MICROSAR RTE" /begin SUB_GROUP /end SUB_GROUP /begin FUNCTION_LIST /end FUNCTION_LIST /begin REF_CHARACTERISTIC /end REF_CHARACTERISTIC /begin REF_MEASUREMENT Ap_ElePwr.MtrCurrDax.Amp_f32 /end REF_MEASUREMENT /end GROUP
/begin GROUP Ap_ElePwr.MtrCurrQax.Amp_f32 "MICROSAR RTE" /begin SUB_GROUP /end SUB_GROUP /begin FUNCTION_LIST /end FUNCTION_LIST /begin REF_CHARACTERISTIC /end REF_CHARACTERISTIC /begin REF_MEASUREMENT Ap_ElePwr.MtrCurrQax.Amp_f32 /end REF_MEASUREMENT /end GROUP
/begin GROUP Ap_ElePwr.MtrVoltDax.Volt_f32 "MICROSAR RTE" /begin SUB_GROUP /end SUB_GROUP /begin FUNCTION_LIST /end FUNCTION_LIST /begin REF_CHARACTERISTIC /end REF_CHARACTERISTIC /begin REF_MEASUREMENT Ap_ElePwr.MtrVoltDax.Volt_f32 /end REF_MEASUREMENT /end GROUP
/begin GROUP Ap_ElePwr.MtrVoltQax.Volt_f32 "MICROSAR RTE" /begin SUB_GROUP /end SUB_GROUP /begin FUNCTION_LIST /end FUNCTION_LIST /begin REF_CHARACTERISTIC /end REF_CHARACTERISTIC /begin REF_MEASUREMENT Ap_ElePwr.MtrVoltQax.Volt_f32 /end REF_MEASUREMENT /end GROUP
/begin GROUP Ap_ElePwr.ReceiverPorts "MICROSAR RTE"
 /begin SUB_GROUP Ap_ElePwr.MtrCurrDax.Amp_f32 Ap_ElePwr.MtrCurrQax.Amp_f32 Ap_ElePwr.MtrVoltDax.Volt_f32 Ap_ElePwr.MtrVoltQax.Volt_f32 Ap_ElePwr.Vecu.Volt_f32 /end SUB_GROUP
 /begin FUNCTION_LIST /end FUNCTION_LIST
 /begin REF_CHARACTERISTIC /end REF_CHARACTERISTIC
 /begin REF_MEASUREMENT /end REF_MEASUREMENT
/end GROUP
/begin GROUP Ap_ElePwr.SenderPorts "MICROSAR RTE"
 /begin SUB_GROUP Ap_ElePwr.ElectricPower.Watt_f32 Ap_ElePwr.SupplyCurrent.Amp_f32 /end SUB_GROUP
 /begin FUNCTION_LIST /end FUNCTION_LIST
 /begin REF_CHARACTERISTIC /end REF_CHARACTERISTIC
 /begin REF_MEASUREMENT /end REF_MEASUREMENT
/end GROUP
/begin GROUP Ap_ElePwr.SupplyCurrent.Amp_f32 "MICROSAR RTE" /begin SUB_GROUP /end SUB_GROUP /begin FUNCTION_LIST /end FUNCTION_LIST /begin REF_CHARACTERISTIC /end REF_CHARACTERISTIC /begin REF_MEASUREMENT Ap_ElePwr.SupplyCurrent.Amp_f32 /end REF_MEASUREMENT /end GROUP
/begin GROUP Ap_ElePwr.Vecu.Volt_f32 "MICROSAR RTE" /begin SUB_GROUP /end SUB_GROUP /begin FUNCTION_LIST /end FUNCTION_LIST /begin REF_CHARACTERISTIC /end REF_CHARACTERISTIC /begin REF_MEASUREMENT Ap_ElePwr.Vecu.Volt_f32 /end REF_MEASUREMENT /end GROUP
/begin GROUP Ap_Gsod "MICROSAR RTE" /begin SUB_GROUP Ap_Gsod.ModeRequirePorts Ap_Gsod.ReceiverPorts /end SUB_GROUP /begin FUNCTION_LIST /end FUNCTION_LIST /begin REF_CHARACTERISTIC /end REF_CHARACTERISTIC /begin REF_MEASUREMENT /end REF_MEASUREMENT /end GROUP
/begin GROUP Ap_Gsod.Ana_Hw_Torque.HwNm_f32 "MICROSAR RTE" /begin SUB_GROUP /end SUB_GROUP /begin FUNCTION_LIST /end FUNCTION_LIST /begin REF_CHARACTERISTIC /end REF_CHARACTERISTIC /begin REF_MEASUREMENT Ap_Gsod.Ana_Hw_Torque.HwNm_f32 /end REF_MEASUREMENT /end GROUP
/begin GROUP Ap_Gsod.Corrected_MtrPos.Rev_f32 "MICROSAR RTE" /begin SUB_GROUP /end SUB_GROUP /begin FUNCTION_LIST /end FUNCTION_LIST /begin REF_CHARACTERISTIC /end REF_CHARACTERISTIC /begin REF_MEASUREMENT Ap_Gsod.Corrected_MtrPos.Rev_f32 /end REF_MEASUREMENT /end GROUP
/begin GROUP Ap_Gsod.Cum_Mtr_Pos_CRF.Deg_f32 "MICROSAR RTE" /begin SUB_GROUP /end SUB_GROUP /begin FUNCTION_LIST /end FUNCTION_LIST /begin REF_CHARACTERISTIC /end REF_CHARACTERISTIC /begin REF_MEASUREMENT Ap_Gsod.Cum_Mtr_Pos_CRF.Deg_f32 /end REF_MEASUREMENT /end GROUP
/begin GROUP Ap_Gsod.ModeRequirePorts "MICROSAR RTE" /begin SUB_GROUP Ap_Gsod.SystemState.Mode /end SUB_GROUP /begin FUNCTION_LIST /end FUNCTION_LIST /begin REF_CHARACTERISTIC /end REF_CHARACTERISTIC /begin REF_MEASUREMENT /end REF_MEASUREMENT /end GROUP
/begin GROUP Ap_Gsod.MtrElecMech_Polarity.Cnt_s08 "MICROSAR RTE" /begin SUB_GROUP /end SUB_GROUP /begin FUNCTION_LIST /end FUNCTION_LIST /begin REF_CHARACTERISTIC /end REF_CHARACTERISTIC /begin REF_MEASUREMENT Ap_Gsod.MtrElecMech_Polarity.Cnt_s08 /end REF_MEASUREMENT /end GROUP
/begin GROUP Ap_Gsod.ReceiverPorts "MICROSAR RTE"
 /begin SUB_GROUP Ap_Gsod.Ana_Hw_Torque.HwNm_f32 Ap_Gsod.Corrected_MtrPos.Rev_f32 Ap_Gsod.Cum_Mtr_Pos_CRF.Deg_f32 Ap_Gsod.MtrElecMech_Polarity.Cnt_s08 Ap_Gsod.SysC_Ana_Hw_Torque.HwNm_f32 Ap_Gsod.SysC_Corrected_MtrPos.Rev_f32 Ap_Gsod.SysC_Cum_Mtr_Pos_CRF.Deg_f32 Ap_Gsod.SysC_MtrElecMech_Polarity.Cnt_s32 Ap_Gsod.SysC_Torque_Cmd_CRF.MtrNm_f32 Ap_Gsod.SysC_Torque_Cmd_MRF.MtrNm_f32 Ap_Gsod.SysC_Vecu.Volt_f32 Ap_Gsod.Torque_Cmd_CRF.MtrNm_f32 Ap_Gsod.Torque_Cmd_MRF.MtrNm_f32 Ap_Gsod.Vecu.Volt_f32 /end SUB_GROUP
 /begin FUNCTION_LIST /end FUNCTION_LIST
 /begin REF_CHARACTERISTIC /end REF_CHARACTERISTIC
 /begin REF_MEASUREMENT /end REF_MEASUREMENT
/end GROUP
/begin GROUP Ap_Gsod.SysC_Ana_Hw_Torque.HwNm_f32 "MICROSAR RTE" /begin SUB_GROUP /end SUB_GROUP /begin FUNCTION_LIST /end FUNCTION_LIST /begin REF_CHARACTERISTIC /end REF_CHARACTERISTIC /begin REF_MEASUREMENT Ap_Gsod.SysC_Ana_Hw_Torque.HwNm_f32 /end REF_MEASUREMENT /end GROUP
/begin GROUP Ap_Gsod.SysC_Corrected_MtrPos.Rev_f32 "MICROSAR RTE" /begin SUB_GROUP /end SUB_GROUP /begin FUNCTION_LIST /end FUNCTION_LIST /begin REF_CHARACTERISTIC /end REF_CHARACTERISTIC /begin REF_MEASUREMENT Ap_Gsod.SysC_Corrected_MtrPos.Rev_f32 /end REF_MEASUREMENT /end GROUP
/begin GROUP Ap_Gsod.SysC_Cum_Mtr_Pos_CRF.Deg_f32 "MICROSAR RTE" /begin SUB_GROUP /end SUB_GROUP /begin FUNCTION_LIST /end FUNCTION_LIST /begin REF_CHARACTERISTIC /end REF_CHARACTERISTIC /begin REF_MEASUREMENT Ap_Gsod.SysC_Cum_Mtr_Pos_CRF.Deg_f32 /end REF_MEASUREMENT /end GROUP
/begin GROUP Ap_Gsod.SysC_MtrElecMech_Polarity.Cnt_s32 "MICROSAR RTE" /begin SUB_GROUP /end SUB_GROUP /begin FUNCTION_LIST /end FUNCTION_LIST /begin REF_CHARACTERISTIC /end REF_CHARACTERISTIC /begin REF_MEASUREMENT Ap_Gsod.SysC_MtrElecMech_Polarity.Cnt_s32 /end REF_MEASUREMENT /end GROUP
/begin GROUP Ap_Gsod.SysC_Torque_Cmd_CRF.MtrNm_f32 "MICROSAR RTE" /begin SUB_GROUP /end SUB_GROUP /begin FUNCTION_LIST /end FUNCTION_LIST /begin REF_CHARACTERISTIC /end REF_CHARACTERISTIC /begin REF_MEASUREMENT Ap_Gsod.SysC_Torque_Cmd_CRF.MtrNm_f32 /end REF_MEASUREMENT /end GROUP
/begin GROUP Ap_Gsod.SysC_Torque_Cmd_MRF.MtrNm_f32 "MICROSAR RTE" /begin SUB_GROUP /end SUB_GROUP /begin FUNCTION_LIST /end FUNCTION_LIST /begin REF_CHARACTERISTIC /end REF_CHARACTERISTIC /begin REF_MEASUREMENT Ap_Gsod.SysC_Torque_Cmd_MRF.MtrNm_f32 /end REF_MEASUREMENT /end GROUP
/begin GROUP Ap_Gsod.SysC_Vecu.Volt_f32 "MICROSAR RTE" /begin SUB_GROUP /end SUB_GROUP /begin FUNCTION_LIST /end FUNCTION_LIST /begin REF_CHARACTERISTIC /end REF_CHARACTERISTIC /begin REF_MEASUREMENT Ap_Gsod.SysC_Vecu.Volt_f32 /end REF_MEASUREMENT /end GROUP
/begin GROUP Ap_Gsod.SystemState.Mode "MICROSAR RTE" /begin SUB_GROUP /end SUB_GROUP /begin FUNCTION_LIST /end FUNCTION_LIST /begin REF_CHARACTERISTIC /end REF_CHARACTERISTIC /begin REF_MEASUREMENT Ap_Gsod.SystemState.Mode /end REF_MEASUREMENT /end GROUP
/begin GROUP Ap_Gsod.Torque_Cmd_CRF.MtrNm_f32 "MICROSAR RTE" /begin SUB_GROUP /end SUB_GROUP /begin FUNCTION_LIST /end FUNCTION_LIST /begin REF_CHARACTERISTIC /end REF_CHARACTERISTIC /begin REF_MEASUREMENT Ap_Gsod.Torque_Cmd_CRF.MtrNm_f32 /end REF_MEASUREMENT /end GROUP
/begin GROUP Ap_Gsod.Torque_Cmd_MRF.MtrNm_f32 "MICROSAR RTE" /begin SUB_GROUP /end SUB_GROUP /begin FUNCTION_LIST /end FUNCTION_LIST /begin REF_CHARACTERISTIC /end REF_CHARACTERISTIC /begin REF_MEASUREMENT Ap_Gsod.Torque_Cmd_MRF.MtrNm_f32 /end REF_MEASUREMENT /end GROUP
/begin GROUP Ap_Gsod.Vecu.Volt_f32 "MICROSAR RTE" /begin SUB_GROUP /end SUB_GROUP /begin FUNCTION_LIST /end FUNCTION_LIST /begin REF_CHARACTERISTIC /end REF_CHARACTERISTIC /begin REF_MEASUREMENT Ap_Gsod.Vecu.Volt_f32 /end REF_MEASUREMENT /end GROUP
/begin GROUP Ap_HaLFTO "MICROSAR RTE"
 /begin SUB_GROUP Ap_HaLFTO.ModeRequirePorts Ap_HaLFTO.ReceiverPorts Ap_HaLFTO.SenderPorts /end SUB_GROUP
 /begin FUNCTION_LIST /end FUNCTION_LIST
 /begin REF_CHARACTERISTIC /end REF_CHARACTERISTIC
 /begin REF_MEASUREMENT /end REF_MEASUREMENT
/end GROUP
/begin GROUP Ap_HaLFTO.DSTState.Cnt_u08 "MICROSAR RTE" /begin SUB_GROUP /end SUB_GROUP /begin FUNCTION_LIST /end FUNCTION_LIST /begin REF_CHARACTERISTIC /end REF_CHARACTERISTIC /begin REF_MEASUREMENT Ap_HaLFTO.DSTState.Cnt_u08 /end REF_MEASUREMENT /end GROUP
/begin GROUP Ap_HaLFTO.DiagStsNonRecRmpToZeroFltPres.Cnt_lgc "MICROSAR RTE" /begin SUB_GROUP /end SUB_GROUP /begin FUNCTION_LIST /end FUNCTION_LIST /begin REF_CHARACTERISTIC /end REF_CHARACTERISTIC /begin REF_MEASUREMENT Ap_HaLFTO.DiagStsNonRecRmpToZeroFltPres.Cnt_lgc /end REF_MEASUREMENT /end GROUP
/begin GROUP Ap_HaLFTO.DiagStsRecRmpToZeroFltPres.Cnt_lgc "MICROSAR RTE" /begin SUB_GROUP /end SUB_GROUP /begin FUNCTION_LIST /end FUNCTION_LIST /begin REF_CHARACTERISTIC /end REF_CHARACTERISTIC /begin REF_MEASUREMENT Ap_HaLFTO.DiagStsRecRmpToZeroFltPres.Cnt_lgc /end REF_MEASUREMENT /end GROUP
/begin GROUP Ap_HaLFTO.HaLFActive.Cnt_lgc "MICROSAR RTE" /begin SUB_GROUP /end SUB_GROUP /begin FUNCTION_LIST /end FUNCTION_LIST /begin REF_CHARACTERISTIC /end REF_CHARACTERISTIC /begin REF_MEASUREMENT Ap_HaLFTO.HaLFActive.Cnt_lgc /end REF_MEASUREMENT /end GROUP
/begin GROUP Ap_HaLFTO.HaLFEnableRqst.Cnt_lgc "MICROSAR RTE" /begin SUB_GROUP /end SUB_GROUP /begin FUNCTION_LIST /end FUNCTION_LIST /begin REF_CHARACTERISTIC /end REF_CHARACTERISTIC /begin REF_MEASUREMENT Ap_HaLFTO.HaLFEnableRqst.Cnt_lgc /end REF_MEASUREMENT /end GROUP
/begin GROUP Ap_HaLFTO.HaLFErrInterfaceActive.Cnt_lgc "MICROSAR RTE" /begin SUB_GROUP /end SUB_GROUP /begin FUNCTION_LIST /end FUNCTION_LIST /begin REF_CHARACTERISTIC /end REF_CHARACTERISTIC /begin REF_MEASUREMENT Ap_HaLFTO.HaLFErrInterfaceActive.Cnt_lgc /end REF_MEASUREMENT /end GROUP
/begin GROUP Ap_HaLFTO.HaLFExtSystemFltActive.Cnt_lgc "MICROSAR RTE" /begin SUB_GROUP /end SUB_GROUP /begin FUNCTION_LIST /end FUNCTION_LIST /begin REF_CHARACTERISTIC /end REF_CHARACTERISTIC /begin REF_MEASUREMENT Ap_HaLFTO.HaLFExtSystemFltActive.Cnt_lgc /end REF_MEASUREMENT /end GROUP
/begin GROUP Ap_HaLFTO.HaLFFuncPresent.Cnt_lgc "MICROSAR RTE" /begin SUB_GROUP /end SUB_GROUP /begin FUNCTION_LIST /end FUNCTION_LIST /begin REF_CHARACTERISTIC /end REF_CHARACTERISTIC /begin REF_MEASUREMENT Ap_HaLFTO.HaLFFuncPresent.Cnt_lgc /end REF_MEASUREMENT /end GROUP
/begin GROUP Ap_HaLFTO.HaLFIntSystemFltActive.Cnt_lgc "MICROSAR RTE" /begin SUB_GROUP /end SUB_GROUP /begin FUNCTION_LIST /end FUNCTION_LIST /begin REF_CHARACTERISTIC /end REF_CHARACTERISTIC /begin REF_MEASUREMENT Ap_HaLFTO.HaLFIntSystemFltActive.Cnt_lgc /end REF_MEASUREMENT /end GROUP
/begin GROUP Ap_HaLFTO.HaLFSWATrqFail.Cnt_lgc "MICROSAR RTE" /begin SUB_GROUP /end SUB_GROUP /begin FUNCTION_LIST /end FUNCTION_LIST /begin REF_CHARACTERISTIC /end REF_CHARACTERISTIC /begin REF_MEASUREMENT Ap_HaLFTO.HaLFSWATrqFail.Cnt_lgc /end REF_MEASUREMENT /end GROUP
/begin GROUP Ap_HaLFTO.HaLFSlewComplete.Cnt_lgc "MICROSAR RTE" /begin SUB_GROUP /end SUB_GROUP /begin FUNCTION_LIST /end FUNCTION_LIST /begin REF_CHARACTERISTIC /end REF_CHARACTERISTIC /begin REF_MEASUREMENT Ap_HaLFTO.HaLFSlewComplete.Cnt_lgc /end REF_MEASUREMENT /end GROUP
/begin GROUP Ap_HaLFTO.HaLFState.Cnt_u08 "MICROSAR RTE" /begin SUB_GROUP /end SUB_GROUP /begin FUNCTION_LIST /end FUNCTION_LIST /begin REF_CHARACTERISTIC /end REF_CHARACTERISTIC /begin REF_MEASUREMENT Ap_HaLFTO.HaLFState.Cnt_u08 /end REF_MEASUREMENT /end GROUP
/begin GROUP Ap_HaLFTO.HaLFSuspend.Cnt_lgc "MICROSAR RTE" /begin SUB_GROUP /end SUB_GROUP /begin FUNCTION_LIST /end FUNCTION_LIST /begin REF_CHARACTERISTIC /end REF_CHARACTERISTIC /begin REF_MEASUREMENT Ap_HaLFTO.HaLFSuspend.Cnt_lgc /end REF_MEASUREMENT /end GROUP
/begin GROUP Ap_HaLFTO.HaLFTrqOvReverseGearEngage.Cnt_lgc "MICROSAR RTE" /begin SUB_GROUP /end SUB_GROUP /begin FUNCTION_LIST /end FUNCTION_LIST /begin REF_CHARACTERISTIC /end REF_CHARACTERISTIC /begin REF_MEASUREMENT Ap_HaLFTO.HaLFTrqOvReverseGearEngage.Cnt_lgc /end REF_MEASUREMENT /end GROUP
/begin GROUP Ap_HaLFTO.HwTorque.HwNm_f32 "MICROSAR RTE" /begin SUB_GROUP /end SUB_GROUP /begin FUNCTION_LIST /end FUNCTION_LIST /begin REF_CHARACTERISTIC /end REF_CHARACTERISTIC /begin REF_MEASUREMENT Ap_HaLFTO.HwTorque.HwNm_f32 /end REF_MEASUREMENT /end GROUP
/begin GROUP Ap_HaLFTO.LimitPercentFiltered.Uls_f32 "MICROSAR RTE" /begin SUB_GROUP /end SUB_GROUP /begin FUNCTION_LIST /end FUNCTION_LIST /begin REF_CHARACTERISTIC /end REF_CHARACTERISTIC /begin REF_MEASUREMENT Ap_HaLFTO.LimitPercentFiltered.Uls_f32 /end REF_MEASUREMENT /end GROUP
/begin GROUP Ap_HaLFTO.ModeRequirePorts "MICROSAR RTE" /begin SUB_GROUP Ap_HaLFTO.SystemState.Mode /end SUB_GROUP /begin FUNCTION_LIST /end FUNCTION_LIST /begin REF_CHARACTERISTIC /end REF_CHARACTERISTIC /begin REF_MEASUREMENT /end REF_MEASUREMENT /end GROUP
/begin GROUP Ap_HaLFTO.PrevHaLFEnableRqst.Cnt_lgc "MICROSAR RTE" /begin SUB_GROUP /end SUB_GROUP /begin FUNCTION_LIST /end FUNCTION_LIST /begin REF_CHARACTERISTIC /end REF_CHARACTERISTIC /begin REF_MEASUREMENT Ap_HaLFTO.PrevHaLFEnableRqst.Cnt_lgc /end REF_MEASUREMENT /end GROUP
/begin GROUP Ap_HaLFTO.PrevHaLFTrqOvCmdRqst.MtrNm_f32 "MICROSAR RTE" /begin SUB_GROUP /end SUB_GROUP /begin FUNCTION_LIST /end FUNCTION_LIST /begin REF_CHARACTERISTIC /end REF_CHARACTERISTIC /begin REF_MEASUREMENT Ap_HaLFTO.PrevHaLFTrqOvCmdRqst.MtrNm_f32 /end REF_MEASUREMENT /end GROUP
/begin GROUP Ap_HaLFTO.ReceiverPorts "MICROSAR RTE"
 /begin SUB_GROUP Ap_HaLFTO.DSTState.Cnt_u08 Ap_HaLFTO.DiagStsNonRecRmpToZeroFltPres.Cnt_lgc Ap_HaLFTO.DiagStsRecRmpToZeroFltPres.Cnt_lgc Ap_HaLFTO.HaLFEnableRqst.Cnt_lgc Ap_HaLFTO.HaLFErrInterfaceActive.Cnt_lgc Ap_HaLFTO.HaLFExtSystemFltActive.Cnt_lgc Ap_HaLFTO.HaLFFuncPresent.Cnt_lgc Ap_HaLFTO.HaLFIntSystemFltActive.Cnt_lgc Ap_HaLFTO.HaLFSWATrqFail.Cnt_lgc Ap_HaLFTO.HaLFSlewComplete.Cnt_lgc Ap_HaLFTO.HaLFTrqOvReverseGearEngage.Cnt_lgc Ap_HaLFTO.HwTorque.HwNm_f32 Ap_HaLFTO.LimitPercentFiltered.Uls_f32 Ap_HaLFTO.PrevHaLFEnableRqst.Cnt_lgc Ap_HaLFTO.PrevHaLFTrqOvCmdRqst.MtrNm_f32 Ap_HaLFTO.TOEOLDisable.Cnt_lgc Ap_HaLFTO.VehicleSpeed.Kph_f32 /end SUB_GROUP
 /begin FUNCTION_LIST /end FUNCTION_LIST
 /begin REF_CHARACTERISTIC /end REF_CHARACTERISTIC
 /begin REF_MEASUREMENT /end REF_MEASUREMENT
/end GROUP
/begin GROUP Ap_HaLFTO.SenderPorts "MICROSAR RTE"
 /begin SUB_GROUP Ap_HaLFTO.HaLFActive.Cnt_lgc Ap_HaLFTO.HaLFState.Cnt_u08 Ap_HaLFTO.HaLFSuspend.Cnt_lgc /end SUB_GROUP
 /begin FUNCTION_LIST /end FUNCTION_LIST
 /begin REF_CHARACTERISTIC /end REF_CHARACTERISTIC
 /begin REF_MEASUREMENT /end REF_MEASUREMENT
/end GROUP
/begin GROUP Ap_HaLFTO.SystemState.Mode "MICROSAR RTE" /begin SUB_GROUP /end SUB_GROUP /begin FUNCTION_LIST /end FUNCTION_LIST /begin REF_CHARACTERISTIC /end REF_CHARACTERISTIC /begin REF_MEASUREMENT Ap_HaLFTO.SystemState.Mode /end REF_MEASUREMENT /end GROUP
/begin GROUP Ap_HaLFTO.TOEOLDisable.Cnt_lgc "MICROSAR RTE" /begin SUB_GROUP /end SUB_GROUP /begin FUNCTION_LIST /end FUNCTION_LIST /begin REF_CHARACTERISTIC /end REF_CHARACTERISTIC /begin REF_MEASUREMENT Ap_HaLFTO.TOEOLDisable.Cnt_lgc /end REF_MEASUREMENT /end GROUP
/begin GROUP Ap_HaLFTO.VehicleSpeed.Kph_f32 "MICROSAR RTE" /begin SUB_GROUP /end SUB_GROUP /begin FUNCTION_LIST /end FUNCTION_LIST /begin REF_CHARACTERISTIC /end REF_CHARACTERISTIC /begin REF_MEASUREMENT Ap_HaLFTO.VehicleSpeed.Kph_f32 /end REF_MEASUREMENT /end GROUP
/begin GROUP Ap_HwPwUp "MICROSAR RTE"
 /begin SUB_GROUP Ap_HwPwUp.ModeRequirePorts Ap_HwPwUp.ReceiverPorts Ap_HwPwUp.SenderPorts /end SUB_GROUP
 /begin FUNCTION_LIST /end FUNCTION_LIST
 /begin REF_CHARACTERISTIC /end REF_CHARACTERISTIC
 /begin REF_MEASUREMENT /end REF_MEASUREMENT
/end GROUP
/begin GROUP Ap_HwPwUp.ModeRequirePorts "MICROSAR RTE" /begin SUB_GROUP Ap_HwPwUp.SystemState.Mode /end SUB_GROUP /begin FUNCTION_LIST /end FUNCTION_LIST /begin REF_CHARACTERISTIC /end REF_CHARACTERISTIC /begin REF_MEASUREMENT /end REF_MEASUREMENT /end GROUP
/begin GROUP Ap_HwPwUp.MtrDrvrInitComplete.Cnt_lgc "MICROSAR RTE" /begin SUB_GROUP /end SUB_GROUP /begin FUNCTION_LIST /end FUNCTION_LIST /begin REF_CHARACTERISTIC /end REF_CHARACTERISTIC /begin REF_MEASUREMENT Ap_HwPwUp.MtrDrvrInitComplete.Cnt_lgc /end REF_MEASUREMENT /end GROUP
/begin GROUP Ap_HwPwUp.MtrDrvrInitStart.Cnt_lgc "MICROSAR RTE" /begin SUB_GROUP /end SUB_GROUP /begin FUNCTION_LIST /end FUNCTION_LIST /begin REF_CHARACTERISTIC /end REF_CHARACTERISTIC /begin REF_MEASUREMENT Ap_HwPwUp.MtrDrvrInitStart.Cnt_lgc /end REF_MEASUREMENT /end GROUP
/begin GROUP Ap_HwPwUp.PwrDiscATestComplete.Cnt_lgc "MICROSAR RTE" /begin SUB_GROUP /end SUB_GROUP /begin FUNCTION_LIST /end FUNCTION_LIST /begin REF_CHARACTERISTIC /end REF_CHARACTERISTIC /begin REF_MEASUREMENT Ap_HwPwUp.PwrDiscATestComplete.Cnt_lgc /end REF_MEASUREMENT /end GROUP
/begin GROUP Ap_HwPwUp.PwrDiscATestStart.Cnt_lgc "MICROSAR RTE" /begin SUB_GROUP /end SUB_GROUP /begin FUNCTION_LIST /end FUNCTION_LIST /begin REF_CHARACTERISTIC /end REF_CHARACTERISTIC /begin REF_MEASUREMENT Ap_HwPwUp.PwrDiscATestStart.Cnt_lgc /end REF_MEASUREMENT /end GROUP
/begin GROUP Ap_HwPwUp.PwrDiscBTestComplete.Cnt_lgc "MICROSAR RTE" /begin SUB_GROUP /end SUB_GROUP /begin FUNCTION_LIST /end FUNCTION_LIST /begin REF_CHARACTERISTIC /end REF_CHARACTERISTIC /begin REF_MEASUREMENT Ap_HwPwUp.PwrDiscBTestComplete.Cnt_lgc /end REF_MEASUREMENT /end GROUP
/begin GROUP Ap_HwPwUp.PwrDiscBTestStart.Cnt_lgc "MICROSAR RTE" /begin SUB_GROUP /end SUB_GROUP /begin FUNCTION_LIST /end FUNCTION_LIST /begin REF_CHARACTERISTIC /end REF_CHARACTERISTIC /begin REF_MEASUREMENT Ap_HwPwUp.PwrDiscBTestStart.Cnt_lgc /end REF_MEASUREMENT /end GROUP
/begin GROUP Ap_HwPwUp.ReceiverPorts "MICROSAR RTE"
 /begin SUB_GROUP Ap_HwPwUp.MtrDrvrInitComplete.Cnt_lgc Ap_HwPwUp.PwrDiscATestComplete.Cnt_lgc Ap_HwPwUp.PwrDiscBTestComplete.Cnt_lgc Ap_HwPwUp.TMFTestComplete.Cnt_lgc /end SUB_GROUP
 /begin FUNCTION_LIST /end FUNCTION_LIST
 /begin REF_CHARACTERISTIC /end REF_CHARACTERISTIC
 /begin REF_MEASUREMENT /end REF_MEASUREMENT
/end GROUP
/begin GROUP Ap_HwPwUp.SenderPorts "MICROSAR RTE"
 /begin SUB_GROUP Ap_HwPwUp.MtrDrvrInitStart.Cnt_lgc Ap_HwPwUp.PwrDiscATestStart.Cnt_lgc Ap_HwPwUp.PwrDiscBTestStart.Cnt_lgc Ap_HwPwUp.TMFTestStart.Cnt_lgc /end SUB_GROUP
 /begin FUNCTION_LIST /end FUNCTION_LIST
 /begin REF_CHARACTERISTIC /end REF_CHARACTERISTIC
 /begin REF_MEASUREMENT /end REF_MEASUREMENT
/end GROUP
/begin GROUP Ap_HwPwUp.SystemState.Mode "MICROSAR RTE" /begin SUB_GROUP /end SUB_GROUP /begin FUNCTION_LIST /end FUNCTION_LIST /begin REF_CHARACTERISTIC /end REF_CHARACTERISTIC /begin REF_MEASUREMENT Ap_HwPwUp.SystemState.Mode /end REF_MEASUREMENT /end GROUP
/begin GROUP Ap_HwPwUp.TMFTestComplete.Cnt_lgc "MICROSAR RTE" /begin SUB_GROUP /end SUB_GROUP /begin FUNCTION_LIST /end FUNCTION_LIST /begin REF_CHARACTERISTIC /end REF_CHARACTERISTIC /begin REF_MEASUREMENT Ap_HwPwUp.TMFTestComplete.Cnt_lgc /end REF_MEASUREMENT /end GROUP
/begin GROUP Ap_HwPwUp.TMFTestStart.Cnt_lgc "MICROSAR RTE" /begin SUB_GROUP /end SUB_GROUP /begin FUNCTION_LIST /end FUNCTION_LIST /begin REF_CHARACTERISTIC /end REF_CHARACTERISTIC /begin REF_MEASUREMENT Ap_HwPwUp.TMFTestStart.Cnt_lgc /end REF_MEASUREMENT /end GROUP
/begin GROUP Ap_LmtCod "MICROSAR RTE" /begin SUB_GROUP Ap_LmtCod.ReceiverPorts Ap_LmtCod.SenderPorts /end SUB_GROUP /begin FUNCTION_LIST /end FUNCTION_LIST /begin REF_CHARACTERISTIC /end REF_CHARACTERISTIC /begin REF_MEASUREMENT /end REF_MEASUREMENT /end GROUP
/begin GROUP Ap_LmtCod.AssistEOTGain.Uls_f32 "MICROSAR RTE" /begin SUB_GROUP /end SUB_GROUP /begin FUNCTION_LIST /end FUNCTION_LIST /begin REF_CHARACTERISTIC /end REF_CHARACTERISTIC /begin REF_MEASUREMENT Ap_LmtCod.AssistEOTGain.Uls_f32 /end REF_MEASUREMENT /end GROUP
/begin GROUP Ap_LmtCod.AssistEOTLimit.MtrNm_f32 "MICROSAR RTE" /begin SUB_GROUP /end SUB_GROUP /begin FUNCTION_LIST /end FUNCTION_LIST /begin REF_CHARACTERISTIC /end REF_CHARACTERISTIC /begin REF_MEASUREMENT Ap_LmtCod.AssistEOTLimit.MtrNm_f32 /end REF_MEASUREMENT /end GROUP
/begin GROUP Ap_LmtCod.AssistStallLimit.MtrNm_f32 "MICROSAR RTE" /begin SUB_GROUP /end SUB_GROUP /begin FUNCTION_LIST /end FUNCTION_LIST /begin REF_CHARACTERISTIC /end REF_CHARACTERISTIC /begin REF_MEASUREMENT Ap_LmtCod.AssistStallLimit.MtrNm_f32 /end REF_MEASUREMENT /end GROUP
/begin GROUP Ap_LmtCod.AssistVehSpdLimit.MtrNm_f32 "MICROSAR RTE" /begin SUB_GROUP /end SUB_GROUP /begin FUNCTION_LIST /end FUNCTION_LIST /begin REF_CHARACTERISTIC /end REF_CHARACTERISTIC /begin REF_MEASUREMENT Ap_LmtCod.AssistVehSpdLimit.MtrNm_f32 /end REF_MEASUREMENT /end GROUP
/begin GROUP Ap_LmtCod.EOTGainLtd.Uls_f32 "MICROSAR RTE" /begin SUB_GROUP /end SUB_GROUP /begin FUNCTION_LIST /end FUNCTION_LIST /begin REF_CHARACTERISTIC /end REF_CHARACTERISTIC /begin REF_MEASUREMENT Ap_LmtCod.EOTGainLtd.Uls_f32 /end REF_MEASUREMENT /end GROUP
/begin GROUP Ap_LmtCod.EOTLimitLtd.MtrNm_f32 "MICROSAR RTE" /begin SUB_GROUP /end SUB_GROUP /begin FUNCTION_LIST /end FUNCTION_LIST /begin REF_CHARACTERISTIC /end REF_CHARACTERISTIC /begin REF_MEASUREMENT Ap_LmtCod.EOTLimitLtd.MtrNm_f32 /end REF_MEASUREMENT /end GROUP
/begin GROUP Ap_LmtCod.OutputRampMult.Uls_f32 "MICROSAR RTE" /begin SUB_GROUP /end SUB_GROUP /begin FUNCTION_LIST /end FUNCTION_LIST /begin REF_CHARACTERISTIC /end REF_CHARACTERISTIC /begin REF_MEASUREMENT Ap_LmtCod.OutputRampMult.Uls_f32 /end REF_MEASUREMENT /end GROUP
/begin GROUP Ap_LmtCod.OutputRampMultLtd.Uls_f32 "MICROSAR RTE" /begin SUB_GROUP /end SUB_GROUP /begin FUNCTION_LIST /end FUNCTION_LIST /begin REF_CHARACTERISTIC /end REF_CHARACTERISTIC /begin REF_MEASUREMENT Ap_LmtCod.OutputRampMultLtd.Uls_f32 /end REF_MEASUREMENT /end GROUP
/begin GROUP Ap_LmtCod.ReceiverPorts "MICROSAR RTE"
 /begin SUB_GROUP Ap_LmtCod.AssistEOTGain.Uls_f32 Ap_LmtCod.AssistEOTLimit.MtrNm_f32 Ap_LmtCod.AssistStallLimit.MtrNm_f32 Ap_LmtCod.AssistVehSpdLimit.MtrNm_f32 Ap_LmtCod.OutputRampMult.Uls_f32 Ap_LmtCod.ThermalLimit.MtrNm_f32 Ap_LmtCod.VehicleSpeed.Kph_f32 /end SUB_GROUP
 /begin FUNCTION_LIST /end FUNCTION_LIST
 /begin REF_CHARACTERISTIC /end REF_CHARACTERISTIC
 /begin REF_MEASUREMENT /end REF_MEASUREMENT
/end GROUP
/begin GROUP Ap_LmtCod.SenderPorts "MICROSAR RTE"
 /begin SUB_GROUP Ap_LmtCod.EOTGainLtd.Uls_f32 Ap_LmtCod.EOTLimitLtd.MtrNm_f32 Ap_LmtCod.OutputRampMultLtd.Uls_f32 Ap_LmtCod.StallLimitLtd.MtrNm_f32 Ap_LmtCod.ThermalLimitLtd.MtrNm_f32 Ap_LmtCod.VehSpdLimitLtd.MtrNm_f32 /end SUB_GROUP
 /begin FUNCTION_LIST /end FUNCTION_LIST
 /begin REF_CHARACTERISTIC /end REF_CHARACTERISTIC
 /begin REF_MEASUREMENT /end REF_MEASUREMENT
/end GROUP
/begin GROUP Ap_LmtCod.StallLimitLtd.MtrNm_f32 "MICROSAR RTE" /begin SUB_GROUP /end SUB_GROUP /begin FUNCTION_LIST /end FUNCTION_LIST /begin REF_CHARACTERISTIC /end REF_CHARACTERISTIC /begin REF_MEASUREMENT Ap_LmtCod.StallLimitLtd.MtrNm_f32 /end REF_MEASUREMENT /end GROUP
/begin GROUP Ap_LmtCod.ThermalLimit.MtrNm_f32 "MICROSAR RTE" /begin SUB_GROUP /end SUB_GROUP /begin FUNCTION_LIST /end FUNCTION_LIST /begin REF_CHARACTERISTIC /end REF_CHARACTERISTIC /begin REF_MEASUREMENT Ap_LmtCod.ThermalLimit.MtrNm_f32 /end REF_MEASUREMENT /end GROUP
/begin GROUP Ap_LmtCod.ThermalLimitLtd.MtrNm_f32 "MICROSAR RTE" /begin SUB_GROUP /end SUB_GROUP /begin FUNCTION_LIST /end FUNCTION_LIST /begin REF_CHARACTERISTIC /end REF_CHARACTERISTIC /begin REF_MEASUREMENT Ap_LmtCod.ThermalLimitLtd.MtrNm_f32 /end REF_MEASUREMENT /end GROUP
/begin GROUP Ap_LmtCod.VehSpdLimitLtd.MtrNm_f32 "MICROSAR RTE" /begin SUB_GROUP /end SUB_GROUP /begin FUNCTION_LIST /end FUNCTION_LIST /begin REF_CHARACTERISTIC /end REF_CHARACTERISTIC /begin REF_MEASUREMENT Ap_LmtCod.VehSpdLimitLtd.MtrNm_f32 /end REF_MEASUREMENT /end GROUP
/begin GROUP Ap_LmtCod.VehicleSpeed.Kph_f32 "MICROSAR RTE" /begin SUB_GROUP /end SUB_GROUP /begin FUNCTION_LIST /end FUNCTION_LIST /begin REF_CHARACTERISTIC /end REF_CHARACTERISTIC /begin REF_MEASUREMENT Ap_LmtCod.VehicleSpeed.Kph_f32 /end REF_MEASUREMENT /end GROUP
/begin GROUP Ap_LrnEOT "MICROSAR RTE"
 /begin SUB_GROUP Ap_LrnEOT.PerInstanceMemories Ap_LrnEOT.ReceiverPorts Ap_LrnEOT.SenderPorts /end SUB_GROUP
 /begin FUNCTION_LIST /end FUNCTION_LIST
 /begin REF_CHARACTERISTIC /end REF_CHARACTERISTIC
 /begin REF_MEASUREMENT /end REF_MEASUREMENT
/end GROUP
/begin GROUP Ap_LrnEOT.CCWFound.Cnt_lgc "MICROSAR RTE" /begin SUB_GROUP /end SUB_GROUP /begin FUNCTION_LIST /end FUNCTION_LIST /begin REF_CHARACTERISTIC /end REF_CHARACTERISTIC /begin REF_MEASUREMENT Ap_LrnEOT.CCWFound.Cnt_lgc /end REF_MEASUREMENT /end GROUP
/begin GROUP Ap_LrnEOT.CCWPosition.HwDeg_f32 "MICROSAR RTE" /begin SUB_GROUP /end SUB_GROUP /begin FUNCTION_LIST /end FUNCTION_LIST /begin REF_CHARACTERISTIC /end REF_CHARACTERISTIC /begin REF_MEASUREMENT Ap_LrnEOT.CCWPosition.HwDeg_f32 /end REF_MEASUREMENT /end GROUP
/begin GROUP Ap_LrnEOT.CWFound.Cnt_lgc "MICROSAR RTE" /begin SUB_GROUP /end SUB_GROUP /begin FUNCTION_LIST /end FUNCTION_LIST /begin REF_CHARACTERISTIC /end REF_CHARACTERISTIC /begin REF_MEASUREMENT Ap_LrnEOT.CWFound.Cnt_lgc /end REF_MEASUREMENT /end GROUP
/begin GROUP Ap_LrnEOT.CWPosition.HwDeg_f32 "MICROSAR RTE" /begin SUB_GROUP /end SUB_GROUP /begin FUNCTION_LIST /end FUNCTION_LIST /begin REF_CHARACTERISTIC /end REF_CHARACTERISTIC /begin REF_MEASUREMENT Ap_LrnEOT.CWPosition.HwDeg_f32 /end REF_MEASUREMENT /end GROUP
/begin GROUP Ap_LrnEOT.DiagStsHwPosDis.Cnt_lgc "MICROSAR RTE" /begin SUB_GROUP /end SUB_GROUP /begin FUNCTION_LIST /end FUNCTION_LIST /begin REF_CHARACTERISTIC /end REF_CHARACTERISTIC /begin REF_MEASUREMENT Ap_LrnEOT.DiagStsHwPosDis.Cnt_lgc /end REF_MEASUREMENT /end GROUP
/begin GROUP Ap_LrnEOT.HandwheelAuthority.Uls_f32 "MICROSAR RTE" /begin SUB_GROUP /end SUB_GROUP /begin FUNCTION_LIST /end FUNCTION_LIST /begin REF_CHARACTERISTIC /end REF_CHARACTERISTIC /begin REF_MEASUREMENT Ap_LrnEOT.HandwheelAuthority.Uls_f32 /end REF_MEASUREMENT /end GROUP
/begin GROUP Ap_LrnEOT.HandwheelPosition.HwDeg_f32 "MICROSAR RTE" /begin SUB_GROUP /end SUB_GROUP /begin FUNCTION_LIST /end FUNCTION_LIST /begin REF_CHARACTERISTIC /end REF_CHARACTERISTIC /begin REF_MEASUREMENT Ap_LrnEOT.HandwheelPosition.HwDeg_f32 /end REF_MEASUREMENT /end GROUP
/begin GROUP Ap_LrnEOT.HwTorque.HwNm_f32 "MICROSAR RTE" /begin SUB_GROUP /end SUB_GROUP /begin FUNCTION_LIST /end FUNCTION_LIST /begin REF_CHARACTERISTIC /end REF_CHARACTERISTIC /begin REF_MEASUREMENT Ap_LrnEOT.HwTorque.HwNm_f32 /end REF_MEASUREMENT /end GROUP
/begin GROUP Ap_LrnEOT.LearnedEOT "MICROSAR RTE" /begin SUB_GROUP /end SUB_GROUP /begin FUNCTION_LIST /end FUNCTION_LIST /begin REF_CHARACTERISTIC /end REF_CHARACTERISTIC
 /begin REF_MEASUREMENT Ap_LrnEOT.LearnedEOT.CCWEOTFound_Cnt_lgc Ap_LrnEOT.LearnedEOT.CCWEOTPosition_HwDeg_f32 Ap_LrnEOT.LearnedEOT.CWEOTFound_Cnt_lgc Ap_LrnEOT.LearnedEOT.CWEOTPosition_HwDeg_f32 /end REF_MEASUREMENT
/end GROUP
/begin GROUP Ap_LrnEOT.MtrVelCRF.MtrRadpS_f32 "MICROSAR RTE" /begin SUB_GROUP /end SUB_GROUP /begin FUNCTION_LIST /end FUNCTION_LIST /begin REF_CHARACTERISTIC /end REF_CHARACTERISTIC /begin REF_MEASUREMENT Ap_LrnEOT.MtrVelCRF.MtrRadpS_f32 /end REF_MEASUREMENT /end GROUP
/begin GROUP Ap_LrnEOT.PerInstanceMemories "MICROSAR RTE" /begin SUB_GROUP Ap_LrnEOT.LearnedEOT /end SUB_GROUP /begin FUNCTION_LIST /end FUNCTION_LIST /begin REF_CHARACTERISTIC /end REF_CHARACTERISTIC /begin REF_MEASUREMENT /end REF_MEASUREMENT /end GROUP
/begin GROUP Ap_LrnEOT.PostLimitTorque.MtrNm_f32 "MICROSAR RTE" /begin SUB_GROUP /end SUB_GROUP /begin FUNCTION_LIST /end FUNCTION_LIST /begin REF_CHARACTERISTIC /end REF_CHARACTERISTIC /begin REF_MEASUREMENT Ap_LrnEOT.PostLimitTorque.MtrNm_f32 /end REF_MEASUREMENT /end GROUP
/begin GROUP Ap_LrnEOT.ReceiverPorts "MICROSAR RTE"
 /begin SUB_GROUP Ap_LrnEOT.DiagStsHwPosDis.Cnt_lgc Ap_LrnEOT.HandwheelAuthority.Uls_f32 Ap_LrnEOT.HandwheelPosition.HwDeg_f32 Ap_LrnEOT.HwTorque.HwNm_f32 Ap_LrnEOT.MtrVelCRF.MtrRadpS_f32 Ap_LrnEOT.PostLimitTorque.MtrNm_f32 /end SUB_GROUP
 /begin FUNCTION_LIST /end FUNCTION_LIST
 /begin REF_CHARACTERISTIC /end REF_CHARACTERISTIC
 /begin REF_MEASUREMENT /end REF_MEASUREMENT
/end GROUP
/begin GROUP Ap_LrnEOT.SenderPorts "MICROSAR RTE"
 /begin SUB_GROUP Ap_LrnEOT.CCWFound.Cnt_lgc Ap_LrnEOT.CCWPosition.HwDeg_f32 Ap_LrnEOT.CWFound.Cnt_lgc Ap_LrnEOT.CWPosition.HwDeg_f32 /end SUB_GROUP
 /begin FUNCTION_LIST /end FUNCTION_LIST
 /begin REF_CHARACTERISTIC /end REF_CHARACTERISTIC
 /begin REF_MEASUREMENT /end REF_MEASUREMENT
/end GROUP
/begin GROUP Ap_MtrTempEst "MICROSAR RTE" /begin SUB_GROUP Ap_MtrTempEst.ReceiverPorts Ap_MtrTempEst.SenderPorts /end SUB_GROUP /begin FUNCTION_LIST /end FUNCTION_LIST /begin REF_CHARACTERISTIC /end REF_CHARACTERISTIC /begin REF_MEASUREMENT /end REF_MEASUREMENT /end GROUP
/begin GROUP Ap_MtrTempEst.AmbTemp.DegC_f32 "MICROSAR RTE" /begin SUB_GROUP /end SUB_GROUP /begin FUNCTION_LIST /end FUNCTION_LIST /begin REF_CHARACTERISTIC /end REF_CHARACTERISTIC /begin REF_MEASUREMENT Ap_MtrTempEst.AmbTemp.DegC_f32 /end REF_MEASUREMENT /end GROUP
/begin GROUP Ap_MtrTempEst.AssistMechTempEst.DegC_f32 "MICROSAR RTE" /begin SUB_GROUP /end SUB_GROUP /begin FUNCTION_LIST /end FUNCTION_LIST /begin REF_CHARACTERISTIC /end REF_CHARACTERISTIC /begin REF_MEASUREMENT Ap_MtrTempEst.AssistMechTempEst.DegC_f32 /end REF_MEASUREMENT /end GROUP
/begin GROUP Ap_MtrTempEst.CtrlTempFinal.DegC_f32 "MICROSAR RTE" /begin SUB_GROUP /end SUB_GROUP /begin FUNCTION_LIST /end FUNCTION_LIST /begin REF_CHARACTERISTIC /end REF_CHARACTERISTIC /begin REF_MEASUREMENT Ap_MtrTempEst.CtrlTempFinal.DegC_f32 /end REF_MEASUREMENT /end GROUP
/begin GROUP Ap_MtrTempEst.CuTempEst.DegC_f32 "MICROSAR RTE" /begin SUB_GROUP /end SUB_GROUP /begin FUNCTION_LIST /end FUNCTION_LIST /begin REF_CHARACTERISTIC /end REF_CHARACTERISTIC /begin REF_MEASUREMENT Ap_MtrTempEst.CuTempEst.DegC_f32 /end REF_MEASUREMENT /end GROUP
/begin GROUP Ap_MtrTempEst.EngTemp.DegC_f32 "MICROSAR RTE" /begin SUB_GROUP /end SUB_GROUP /begin FUNCTION_LIST /end FUNCTION_LIST /begin REF_CHARACTERISTIC /end REF_CHARACTERISTIC /begin REF_MEASUREMENT Ap_MtrTempEst.EngTemp.DegC_f32 /end REF_MEASUREMENT /end GROUP
/begin GROUP Ap_MtrTempEst.EstPkCurr.AmpSq_f32 "MICROSAR RTE" /begin SUB_GROUP /end SUB_GROUP /begin FUNCTION_LIST /end FUNCTION_LIST /begin REF_CHARACTERISTIC /end REF_CHARACTERISTIC /begin REF_MEASUREMENT Ap_MtrTempEst.EstPkCurr.AmpSq_f32 /end REF_MEASUREMENT /end GROUP
/begin GROUP Ap_MtrTempEst.HwVel.HwRadpS_f32 "MICROSAR RTE" /begin SUB_GROUP /end SUB_GROUP /begin FUNCTION_LIST /end FUNCTION_LIST /begin REF_CHARACTERISTIC /end REF_CHARACTERISTIC /begin REF_MEASUREMENT Ap_MtrTempEst.HwVel.HwRadpS_f32 /end REF_MEASUREMENT /end GROUP
/begin GROUP Ap_MtrTempEst.MagTempEst.DegC_f32 "MICROSAR RTE" /begin SUB_GROUP /end SUB_GROUP /begin FUNCTION_LIST /end FUNCTION_LIST /begin REF_CHARACTERISTIC /end REF_CHARACTERISTIC /begin REF_MEASUREMENT Ap_MtrTempEst.MagTempEst.DegC_f32 /end REF_MEASUREMENT /end GROUP
/begin GROUP Ap_MtrTempEst.ReceiverPorts "MICROSAR RTE"
 /begin SUB_GROUP Ap_MtrTempEst.AmbTemp.DegC_f32 Ap_MtrTempEst.CtrlTempFinal.DegC_f32 Ap_MtrTempEst.EngTemp.DegC_f32 Ap_MtrTempEst.EstPkCurr.AmpSq_f32 Ap_MtrTempEst.HwVel.HwRadpS_f32 Ap_MtrTempEst.ScomAMDefeat.Cnt_lgc Ap_MtrTempEst.ScomTempDataRcvd.Cnt_lgc /end SUB_GROUP
 /begin FUNCTION_LIST /end FUNCTION_LIST
 /begin REF_CHARACTERISTIC /end REF_CHARACTERISTIC
 /begin REF_MEASUREMENT /end REF_MEASUREMENT
/end GROUP
/begin GROUP Ap_MtrTempEst.ScomAMDefeat.Cnt_lgc "MICROSAR RTE" /begin SUB_GROUP /end SUB_GROUP /begin FUNCTION_LIST /end FUNCTION_LIST /begin REF_CHARACTERISTIC /end REF_CHARACTERISTIC /begin REF_MEASUREMENT Ap_MtrTempEst.ScomAMDefeat.Cnt_lgc /end REF_MEASUREMENT /end GROUP
/begin GROUP Ap_MtrTempEst.ScomTempDataRcvd.Cnt_lgc "MICROSAR RTE" /begin SUB_GROUP /end SUB_GROUP /begin FUNCTION_LIST /end FUNCTION_LIST /begin REF_CHARACTERISTIC /end REF_CHARACTERISTIC /begin REF_MEASUREMENT Ap_MtrTempEst.ScomTempDataRcvd.Cnt_lgc /end REF_MEASUREMENT /end GROUP
/begin GROUP Ap_MtrTempEst.SenderPorts "MICROSAR RTE"
 /begin SUB_GROUP Ap_MtrTempEst.AssistMechTempEst.DegC_f32 Ap_MtrTempEst.CuTempEst.DegC_f32 Ap_MtrTempEst.MagTempEst.DegC_f32 Ap_MtrTempEst.SiTempEst.DegC_f32 /end SUB_GROUP
 /begin FUNCTION_LIST /end FUNCTION_LIST
 /begin REF_CHARACTERISTIC /end REF_CHARACTERISTIC
 /begin REF_MEASUREMENT /end REF_MEASUREMENT
/end GROUP
/begin GROUP Ap_MtrTempEst.SiTempEst.DegC_f32 "MICROSAR RTE" /begin SUB_GROUP /end SUB_GROUP /begin FUNCTION_LIST /end FUNCTION_LIST /begin REF_CHARACTERISTIC /end REF_CHARACTERISTIC /begin REF_MEASUREMENT Ap_MtrTempEst.SiTempEst.DegC_f32 /end REF_MEASUREMENT /end GROUP
/begin GROUP Ap_PAwTO "MICROSAR RTE"
 /begin SUB_GROUP Ap_PAwTO.ModeRequirePorts Ap_PAwTO.ReceiverPorts Ap_PAwTO.SenderPorts /end SUB_GROUP
 /begin FUNCTION_LIST /end FUNCTION_LIST
 /begin REF_CHARACTERISTIC /end REF_CHARACTERISTIC
 /begin REF_MEASUREMENT /end REF_MEASUREMENT
/end GROUP
/begin GROUP Ap_PAwTO.DiagStsNonRecRmpToZeroFltPres.Cnt_lgc "MICROSAR RTE" /begin SUB_GROUP /end SUB_GROUP /begin FUNCTION_LIST /end FUNCTION_LIST /begin REF_CHARACTERISTIC /end REF_CHARACTERISTIC /begin REF_MEASUREMENT Ap_PAwTO.DiagStsNonRecRmpToZeroFltPres.Cnt_lgc /end REF_MEASUREMENT /end GROUP
/begin GROUP Ap_PAwTO.DiagStsRecRmpToZeroFltPres.Cnt_lgc "MICROSAR RTE" /begin SUB_GROUP /end SUB_GROUP /begin FUNCTION_LIST /end FUNCTION_LIST /begin REF_CHARACTERISTIC /end REF_CHARACTERISTIC /begin REF_MEASUREMENT Ap_PAwTO.DiagStsRecRmpToZeroFltPres.Cnt_lgc /end REF_MEASUREMENT /end GROUP
/begin GROUP Ap_PAwTO.HandsOnDetect.Cnt_lgc "MICROSAR RTE" /begin SUB_GROUP /end SUB_GROUP /begin FUNCTION_LIST /end FUNCTION_LIST /begin REF_CHARACTERISTIC /end REF_CHARACTERISTIC /begin REF_MEASUREMENT Ap_PAwTO.HandsOnDetect.Cnt_lgc /end REF_MEASUREMENT /end GROUP
/begin GROUP Ap_PAwTO.HwTorque.HwNm_f32 "MICROSAR RTE" /begin SUB_GROUP /end SUB_GROUP /begin FUNCTION_LIST /end FUNCTION_LIST /begin REF_CHARACTERISTIC /end REF_CHARACTERISTIC /begin REF_MEASUREMENT Ap_PAwTO.HwTorque.HwNm_f32 /end REF_MEASUREMENT /end GROUP
/begin GROUP Ap_PAwTO.IWSSCalcVspd.Kph_f32 "MICROSAR RTE" /begin SUB_GROUP /end SUB_GROUP /begin FUNCTION_LIST /end FUNCTION_LIST /begin REF_CHARACTERISTIC /end REF_CHARACTERISTIC /begin REF_MEASUREMENT Ap_PAwTO.IWSSCalcVspd.Kph_f32 /end REF_MEASUREMENT /end GROUP
/begin GROUP Ap_PAwTO.LimitPercentFiltered.Uls_f32 "MICROSAR RTE" /begin SUB_GROUP /end SUB_GROUP /begin FUNCTION_LIST /end FUNCTION_LIST /begin REF_CHARACTERISTIC /end REF_CHARACTERISTIC /begin REF_MEASUREMENT Ap_PAwTO.LimitPercentFiltered.Uls_f32 /end REF_MEASUREMENT /end GROUP
/begin GROUP Ap_PAwTO.ModeRequirePorts "MICROSAR RTE" /begin SUB_GROUP Ap_PAwTO.SystemState.Mode /end SUB_GROUP /begin FUNCTION_LIST /end FUNCTION_LIST /begin REF_CHARACTERISTIC /end REF_CHARACTERISTIC /begin REF_MEASUREMENT /end REF_MEASUREMENT /end GROUP
/begin GROUP Ap_PAwTO.PABoostCurveSwitch.Cnt_lgc "MICROSAR RTE" /begin SUB_GROUP /end SUB_GROUP /begin FUNCTION_LIST /end FUNCTION_LIST /begin REF_CHARACTERISTIC /end REF_CHARACTERISTIC /begin REF_MEASUREMENT Ap_PAwTO.PABoostCurveSwitch.Cnt_lgc /end REF_MEASUREMENT /end GROUP
/begin GROUP Ap_PAwTO.PAEnableRqst.Cnt_lgc "MICROSAR RTE" /begin SUB_GROUP /end SUB_GROUP /begin FUNCTION_LIST /end FUNCTION_LIST /begin REF_CHARACTERISTIC /end REF_CHARACTERISTIC /begin REF_MEASUREMENT Ap_PAwTO.PAEnableRqst.Cnt_lgc /end REF_MEASUREMENT /end GROUP
/begin GROUP Ap_PAwTO.PAErrInterfaceActive.Cnt_lgc "MICROSAR RTE" /begin SUB_GROUP /end SUB_GROUP /begin FUNCTION_LIST /end FUNCTION_LIST /begin REF_CHARACTERISTIC /end REF_CHARACTERISTIC /begin REF_MEASUREMENT Ap_PAwTO.PAErrInterfaceActive.Cnt_lgc /end REF_MEASUREMENT /end GROUP
/begin GROUP Ap_PAwTO.PAExtSystemFltActive.Cnt_lgc "MICROSAR RTE" /begin SUB_GROUP /end SUB_GROUP /begin FUNCTION_LIST /end FUNCTION_LIST /begin REF_CHARACTERISTIC /end REF_CHARACTERISTIC /begin REF_MEASUREMENT Ap_PAwTO.PAExtSystemFltActive.Cnt_lgc /end REF_MEASUREMENT /end GROUP
/begin GROUP Ap_PAwTO.PAIntSystemFltActive.Cnt_lgc "MICROSAR RTE" /begin SUB_GROUP /end SUB_GROUP /begin FUNCTION_LIST /end FUNCTION_LIST /begin REF_CHARACTERISTIC /end REF_CHARACTERISTIC /begin REF_MEASUREMENT Ap_PAwTO.PAIntSystemFltActive.Cnt_lgc /end REF_MEASUREMENT /end GROUP
/begin GROUP Ap_PAwTO.PAManoeuvrePhase.Cnt_u08 "MICROSAR RTE" /begin SUB_GROUP /end SUB_GROUP /begin FUNCTION_LIST /end FUNCTION_LIST /begin REF_CHARACTERISTIC /end REF_CHARACTERISTIC /begin REF_MEASUREMENT Ap_PAwTO.PAManoeuvrePhase.Cnt_u08 /end REF_MEASUREMENT /end GROUP
/begin GROUP Ap_PAwTO.PATrqOvCmdRqst.HwNm_f32 "MICROSAR RTE" /begin SUB_GROUP /end SUB_GROUP /begin FUNCTION_LIST /end FUNCTION_LIST /begin REF_CHARACTERISTIC /end REF_CHARACTERISTIC /begin REF_MEASUREMENT Ap_PAwTO.PATrqOvCmdRqst.HwNm_f32 /end REF_MEASUREMENT /end GROUP
/begin GROUP Ap_PAwTO.PAWheelCriteriaMet.Cnt_lgc "MICROSAR RTE" /begin SUB_GROUP /end SUB_GROUP /begin FUNCTION_LIST /end FUNCTION_LIST /begin REF_CHARACTERISTIC /end REF_CHARACTERISTIC /begin REF_MEASUREMENT Ap_PAwTO.PAWheelCriteriaMet.Cnt_lgc /end REF_MEASUREMENT /end GROUP
/begin GROUP Ap_PAwTO.PAWhlDirRLStat.Cnt_u08 "MICROSAR RTE" /begin SUB_GROUP /end SUB_GROUP /begin FUNCTION_LIST /end FUNCTION_LIST /begin REF_CHARACTERISTIC /end REF_CHARACTERISTIC /begin REF_MEASUREMENT Ap_PAwTO.PAWhlDirRLStat.Cnt_u08 /end REF_MEASUREMENT /end GROUP
/begin GROUP Ap_PAwTO.PAWhlDirRRStat.Cnt_u08 "MICROSAR RTE" /begin SUB_GROUP /end SUB_GROUP /begin FUNCTION_LIST /end FUNCTION_LIST /begin REF_CHARACTERISTIC /end REF_CHARACTERISTIC /begin REF_MEASUREMENT Ap_PAwTO.PAWhlDirRRStat.Cnt_u08 /end REF_MEASUREMENT /end GROUP
/begin GROUP Ap_PAwTO.PAWhlPlsCntRLValid.Cnt_lgc "MICROSAR RTE" /begin SUB_GROUP /end SUB_GROUP /begin FUNCTION_LIST /end FUNCTION_LIST /begin REF_CHARACTERISTIC /end REF_CHARACTERISTIC /begin REF_MEASUREMENT Ap_PAwTO.PAWhlPlsCntRLValid.Cnt_lgc /end REF_MEASUREMENT /end GROUP
/**********************************************************************************************************************
* RECORD_LAYOUT
*********************************************************************************************************************/
/begin RECORD_LAYOUT RTE_RL_UBYTE FNC_VALUES 1 UBYTE ROW_DIR DIRECT /end RECORD_LAYOUT
/begin RECORD_LAYOUT RTE_RL_UWORD FNC_VALUES 1 UWORD ROW_DIR DIRECT /end RECORD_LAYOUT
/**********************************************************************************************************************
* COMPU_METHOD / COMPU_VTAB_RANGE
*********************************************************************************************************************/
/begin COMPU_METHOD RTE_CM_BOOLEAN "" TAB_VERB "%3.1" "" COMPU_TAB_REF RTE_CM_BOOLEAN /end COMPU_METHOD
/begin COMPU_VTAB_RANGE RTE_CM_BOOLEAN "" 2 0 0 "false" 1 255 "true" /end COMPU_VTAB_RANGE
/begin COMPU_METHOD RTE_CM_ENUM_StaMd_Mode "" TAB_VERB "%.1" "" COMPU_TAB_REF RTE_CM_ENUM_StaMd_Mode /end COMPU_METHOD
/begin COMPU_VTAB_RANGE RTE_CM_ENUM_StaMd_Mode "" 5 0 0 "RTE_MODE_StaMd_Mode_DISABLE" 1 1 "RTE_MODE_StaMd_Mode_OFF" 2 2 "RTE_MODE_StaMd_Mode_OPERATE" 3 3 "RTE_MODE_StaMd_Mode_WARMINIT" 4 4 "RTE_TRANSITION_StaMd_Mode" /end COMPU_VTAB_RANGE
/begin COMPU_METHOD RTE_CM_ENUM_ManufModeType "" TAB_VERB "%.1" "" COMPU_TAB_REF RTE_CM_ENUM_ManufModeType /end COMPU_METHOD
/begin COMPU_VTAB_RANGE RTE_CM_ENUM_ManufModeType "" 3 0 0 "ProductionMode" 1 1 "ManufacturingMode" 2 2 "EngineeringMode" /end COMPU_VTAB_RANGE
