/begin MEASUREMENT Polarity.AssistAssyPolarity.Cnt_s08 "MICROSAR RTE" SBYTE NO_COMPU_METHOD 0 0 -128 127 ECU_ADDRESS 0 SYMBOL_LINK "Rte_Polarity_AssistAssyPolarity_Cnt_s08" 0 DISPLAY_IDENTIFIER Polarity.SenderPorts.AssistAssyPolarity.Cnt_s08 /end MEASUREMENT
/begin MEASUREMENT Polarity.DiagAssistAssyPolarity.Cnt_s08 "MICROSAR RTE" SBYTE NO_COMPU_METHOD 0 0 -128 127 ECU_ADDRESS 0 SYMBOL_LINK "Rte_Polarity_AssistAssyPolarity_Cnt_s08" 0 DISPLAY_IDENTIFIER Polarity.ReceiverPorts.DiagAssistAssyPolarity.Cnt_s08 /end MEASUREMENT
/begin MEASUREMENT Polarity.DiagHwPosPolarity.Cnt_s08 "MICROSAR RTE" SBYTE NO_COMPU_METHOD 0 0 -128 127 ECU_ADDRESS 0 SYMBOL_LINK "Rte_Polarity_HwPosPolarity_Cnt_s08" 0 DISPLAY_IDENTIFIER Polarity.ReceiverPorts.DiagHwPosPolarity.Cnt_s08 /end MEASUREMENT
/begin MEASUREMENT Polarity.DiagHwTrqPolarity.Cnt_s08 "MICROSAR RTE" SBYTE NO_COMPU_METHOD 0 0 -128 127 ECU_ADDRESS 0 SYMBOL_LINK "Rte_Polarity_HwTrqPolarity_Cnt_s08" 0 DISPLAY_IDENTIFIER Polarity.ReceiverPorts.DiagHwTrqPolarity.Cnt_s08 /end MEASUREMENT
/begin MEASUREMENT Polarity.DiagMtrElecMechPolarity.Cnt_s08 "MICROSAR RTE" SBYTE NO_COMPU_METHOD 0 0 -128 127 ECU_ADDRESS 0 SYMBOL_LINK "Rte_Polarity_MtrElecMechPolarity_Cnt_s08" 0 DISPLAY_IDENTIFIER Polarity.ReceiverPorts.DiagMtrElecMechPolarity.Cnt_s08 /end MEASUREMENT
/begin MEASUREMENT Polarity.DiagMtrPosPolarity.Cnt_s08 "MICROSAR RTE" SBYTE NO_COMPU_METHOD 0 0 -128 127 ECU_ADDRESS 0 SYMBOL_LINK "Rte_Polarity_MtrPosPolarity_Cnt_s08" 0 DISPLAY_IDENTIFIER Polarity.ReceiverPorts.DiagMtrPosPolarity.Cnt_s08 /end MEASUREMENT
/begin MEASUREMENT Polarity.DiagMtrVelPolarity.Cnt_s08 "MICROSAR RTE" SBYTE NO_COMPU_METHOD 0 0 -128 127 ECU_ADDRESS 0 SYMBOL_LINK "Rte_Polarity_MtrVelPolarity_Cnt_s08" 0 DISPLAY_IDENTIFIER Polarity.ReceiverPorts.DiagMtrVelPolarity.Cnt_s08 /end MEASUREMENT
/begin MEASUREMENT Polarity.HwPosPolarity.Cnt_s08 "MICROSAR RTE" SBYTE NO_COMPU_METHOD 0 0 -128 127 ECU_ADDRESS 0 SYMBOL_LINK "Rte_Polarity_HwPosPolarity_Cnt_s08" 0 DISPLAY_IDENTIFIER Polarity.SenderPorts.HwPosPolarity.Cnt_s08 /end MEASUREMENT
/begin MEASUREMENT Polarity.HwTrqPolarity.Cnt_s08 "MICROSAR RTE" SBYTE NO_COMPU_METHOD 0 0 -128 127 ECU_ADDRESS 0 SYMBOL_LINK "Rte_Polarity_HwTrqPolarity_Cnt_s08" 0 DISPLAY_IDENTIFIER Polarity.SenderPorts.HwTrqPolarity.Cnt_s08 /end MEASUREMENT
/begin MEASUREMENT Polarity.MtrElecMechPolarity.Cnt_s08 "MICROSAR RTE" SBYTE NO_COMPU_METHOD 0 0 -128 127 ECU_ADDRESS 0 SYMBOL_LINK "Rte_Polarity_MtrElecMechPolarity_Cnt_s08" 0 DISPLAY_IDENTIFIER Polarity.SenderPorts.MtrElecMechPolarity.Cnt_s08 /end MEASUREMENT
/begin MEASUREMENT Polarity.MtrPosPolarity.Cnt_s08 "MICROSAR RTE" SBYTE NO_COMPU_METHOD 0 0 -128 127 ECU_ADDRESS 0 SYMBOL_LINK "Rte_Polarity_MtrPosPolarity_Cnt_s08" 0 DISPLAY_IDENTIFIER Polarity.SenderPorts.MtrPosPolarity.Cnt_s08 /end MEASUREMENT
/begin MEASUREMENT Polarity.MtrVelPolarity.Cnt_s08 "MICROSAR RTE" SBYTE NO_COMPU_METHOD 0 0 -128 127 ECU_ADDRESS 0 SYMBOL_LINK "Rte_Polarity_MtrVelPolarity_Cnt_s08" 0 DISPLAY_IDENTIFIER Polarity.SenderPorts.MtrVelPolarity.Cnt_s08 /end MEASUREMENT
/begin MEASUREMENT Polarity.Polarity_Cnt_Str.Polarity_Cnt_b08 "MICROSAR RTE" UBYTE NO_COMPU_METHOD 0 0 0 255 ECU_ADDRESS 0 SYMBOL_LINK "Rte_Polarity_Polarity_Cnt_Str.Polarity_Cnt_b08" 0 DISPLAY_IDENTIFIER Polarity.PerInstanceMemories.Polarity_Cnt_Str.Polarity_Cnt_b08 READ_WRITE /end MEASUREMENT
/begin MEASUREMENT Polarity.Polarity_Cnt_Str.R_Polarity_Cnt_b08 "MICROSAR RTE" UBYTE NO_COMPU_METHOD 0 0 0 255 ECU_ADDRESS 0 SYMBOL_LINK "Rte_Polarity_Polarity_Cnt_Str.R_Polarity_Cnt_b08" 0 DISPLAY_IDENTIFIER Polarity.PerInstanceMemories.Polarity_Cnt_Str.R_Polarity_Cnt_b08 READ_WRITE /end MEASUREMENT
/begin MEASUREMENT Polarity.SysC_MtrElecMechPolarity.Cnt_s32 "MICROSAR RTE" SLONG NO_COMPU_METHOD 0 0 -2147483648 2147483647 ECU_ADDRESS 0 SYMBOL_LINK "Rte_Polarity_SysC_MtrElecMechPolarity_Cnt_s32" 0 DISPLAY_IDENTIFIER Polarity.SenderPorts.SysC_MtrElecMechPolarity.Cnt_s32 /end MEASUREMENT
/begin MEASUREMENT QuadDet.InstMtrDir.Cnt_s08 "MICROSAR RTE" SBYTE NO_COMPU_METHOD 0 0 -128 127 ECU_ADDRESS 0 SYMBOL_LINK "Rte_QuadDet_InstMtrDir_Cnt_s08" 0 DISPLAY_IDENTIFIER QuadDet.SenderPorts.InstMtrDir.Cnt_s08 /end MEASUREMENT
/begin MEASUREMENT QuadDet.MRFCumMtrPos.Deg_f32 "MICROSAR RTE" FLOAT32_IEEE NO_COMPU_METHOD 0 0 1.175494351e-38 3.402823466e+38 ECU_ADDRESS 0 SYMBOL_LINK "Rte_MtrPos_CumMtrPosMRF_Deg_f32" 0 DISPLAY_IDENTIFIER QuadDet.ReceiverPorts.MRFCumMtrPos.Deg_f32 /end MEASUREMENT
/begin MEASUREMENT QuadDet.MRFMtrTrqCmdScl.MtrNm_f32 "MICROSAR RTE" FLOAT32_IEEE NO_COMPU_METHOD 0 0 1.175494351e-38 3.402823466e+38 ECU_ADDRESS 0 SYMBOL_LINK "Rte_TrqCmdScl_MRFMtrTrqCmdScl_MtrNm_f32" 0 DISPLAY_IDENTIFIER QuadDet.ReceiverPorts.MRFMtrTrqCmdScl.MtrNm_f32 /end MEASUREMENT
/begin MEASUREMENT QuadDet.MtrQuad.Cnt_u08 "MICROSAR RTE" UBYTE NO_COMPU_METHOD 0 0 0 255 ECU_ADDRESS 0 SYMBOL_LINK "Rte_QuadDet_MtrQuad_Cnt_u08" 0 DISPLAY_IDENTIFIER QuadDet.SenderPorts.MtrQuad.Cnt_u08 /end MEASUREMENT
/begin MEASUREMENT Return.AssistMechTempEst.DegC_f32 "MICROSAR RTE" FLOAT32_IEEE NO_COMPU_METHOD 0 0 1.175494351e-38 3.402823466e+38 ECU_ADDRESS 0 SYMBOL_LINK "Rte_Ap_MtrTempEst_AssistMechTempEst_DegC_f32" 0 DISPLAY_IDENTIFIER Return.ReceiverPorts.AssistMechTempEst.DegC_f32 /end MEASUREMENT
/begin MEASUREMENT Return.DefeatReturnSvc.Cnt_lgc "MICROSAR RTE" UBYTE RTE_CM_BOOLEAN 0 0 0 255 ECU_ADDRESS 0 SYMBOL_LINK "Rte_CDDInterface_ReturnSrlComSvcDft_Cnt_lgc" 0 DISPLAY_IDENTIFIER Return.ReceiverPorts.DefeatReturnSvc.Cnt_lgc /end MEASUREMENT
/begin MEASUREMENT Return.DiagStsHwPosDis.Cnt_lgc "MICROSAR RTE" UBYTE RTE_CM_BOOLEAN 0 0 0 255 ECU_ADDRESS 0 SYMBOL_LINK "Rte_DiagMgr_DiagStsHWASbSystmFltPres_Cnt_lgc" 0 DISPLAY_IDENTIFIER Return.ReceiverPorts.DiagStsHwPosDis.Cnt_lgc /end MEASUREMENT
/begin MEASUREMENT Return.HandwheelAuthority.Uls_f32 "MICROSAR RTE" FLOAT32_IEEE NO_COMPU_METHOD 0 0 1.175494351e-38 3.402823466e+38 ECU_ADDRESS 0 SYMBOL_LINK "Rte_Ap_AbsHwPosScom_HwPosAuthority_Uls_f32" 0 DISPLAY_IDENTIFIER Return.ReceiverPorts.HandwheelAuthority.Uls_f32 /end MEASUREMENT
/begin MEASUREMENT Return.HandwheelPosition.HwDeg_f32 "MICROSAR RTE" FLOAT32_IEEE NO_COMPU_METHOD 0 0 1.175494351e-38 3.402823466e+38 ECU_ADDRESS 0 SYMBOL_LINK "Rte_Ap_AbsHwPosScom_HwPos_HwDeg_f32" 0 DISPLAY_IDENTIFIER Return.ReceiverPorts.HandwheelPosition.HwDeg_f32 /end MEASUREMENT
/begin MEASUREMENT Return.HandwheelVel.HwRadpS_f32 "MICROSAR RTE" FLOAT32_IEEE NO_COMPU_METHOD 0 0 1.175494351e-38 3.402823466e+38 ECU_ADDRESS 0 SYMBOL_LINK "Rte_MtrVel_HandwheelVel_HwRadpS_f32" 0 DISPLAY_IDENTIFIER Return.ReceiverPorts.HandwheelVel.HwRadpS_f32 /end MEASUREMENT
/begin MEASUREMENT Return.HwTorque.HwNm_f32 "MICROSAR RTE" FLOAT32_IEEE NO_COMPU_METHOD 0 0 1.175494351e-38 3.402823466e+38 ECU_ADDRESS 0 SYMBOL_LINK "Rte_HwTrq_AnaHwTorque_HwNm_f32" 0 DISPLAY_IDENTIFIER Return.ReceiverPorts.HwTorque.HwNm_f32 /end MEASUREMENT
/begin MEASUREMENT Return.PAReturnSclFct.Uls_f32 "MICROSAR RTE" FLOAT32_IEEE NO_COMPU_METHOD 0 0 1.175494351e-38 3.402823466e+38 ECU_ADDRESS 0 SYMBOL_LINK "Rte_Ap_ArbLmt_PAReturnSclFct_Uls_f32" 0 DISPLAY_IDENTIFIER Return.ReceiverPorts.PAReturnSclFct.Uls_f32 /end MEASUREMENT
/begin MEASUREMENT Return.ReturnCmd.MtrNm_f32 "MICROSAR RTE" FLOAT32_IEEE NO_COMPU_METHOD 0 0 1.175494351e-38 3.402823466e+38 ECU_ADDRESS 0 SYMBOL_LINK "Rte_Return_ReturnCmd_MtrNm_f32" 0 DISPLAY_IDENTIFIER Return.SenderPorts.ReturnCmd.MtrNm_f32 /end MEASUREMENT
/begin MEASUREMENT Return.ReturnDDFactor.Uls_f32 "MICROSAR RTE" FLOAT32_IEEE NO_COMPU_METHOD 0 0 1.175494351e-38 3.402823466e+38 ECU_ADDRESS 0 SYMBOL_LINK "Rte_Return_ReturnDDFactor_Uls_f32" 0 DISPLAY_IDENTIFIER Return.ReceiverPorts.ReturnDDFactor.Uls_f32 /end MEASUREMENT
/begin MEASUREMENT Return.ReturnOffset.HwDeg_f32 "MICROSAR RTE" FLOAT32_IEEE NO_COMPU_METHOD 0 0 1.175494351e-38 3.402823466e+38 ECU_ADDRESS 0 SYMBOL_LINK "Rte_Return_ReturnOffset_HwDeg_f32" 0 DISPLAY_IDENTIFIER Return.ReceiverPorts.ReturnOffset.HwDeg_f32 /end MEASUREMENT
/begin MEASUREMENT Return.VehicleSpeed.Kph_f32 "MICROSAR RTE" FLOAT32_IEEE NO_COMPU_METHOD 0 0 1.175494351e-38 3.402823466e+38 ECU_ADDRESS 0 SYMBOL_LINK "Rte_Ap_SignlCondn_VehicleSpeed_Kph_f32" 0 DISPLAY_IDENTIFIER Return.ReceiverPorts.VehicleSpeed.Kph_f32 /end MEASUREMENT
/begin MEASUREMENT RteErrata.SystemState.Mode "MICROSAR RTE" UBYTE RTE_CM_ENUM_StaMd_Mode 0 0 0 255 ECU_ADDRESS 0 SYMBOL_LINK "Rte_ModeMachine_StaMd_SystemState_Mode" 0 DISPLAY_IDENTIFIER RteErrata.ModeRequirePorts.SystemState.Mode /end MEASUREMENT
/begin MEASUREMENT RteErrata8.SystemState.Mode "MICROSAR RTE" UBYTE RTE_CM_ENUM_StaMd_Mode 0 0 0 255 ECU_ADDRESS 0 SYMBOL_LINK "Rte_ModeMachine_Ap_StaMd8_SystemState8_Mode" 0 DISPLAY_IDENTIFIER RteErrata8.ModeRequirePorts.SystemState.Mode /end MEASUREMENT
/begin MEASUREMENT RteErrata9.SystemState.Mode "MICROSAR RTE" UBYTE RTE_CM_ENUM_StaMd_Mode 0 0 0 255 ECU_ADDRESS 0 SYMBOL_LINK "Rte_ModeMachine_Ap_StaMd9_SystemState9_Mode" 0 DISPLAY_IDENTIFIER RteErrata9.ModeRequirePorts.SystemState.Mode /end MEASUREMENT
/begin MEASUREMENT Sa_BkCpPc.Batt.Volt_f32 "This signal is intended to communicate any type voltage signal measured by the ecu.  This signal has a lower limit of 0 which reequires users of the signal to provide divide by 0 protection if it is used as a denominator in a calculation.  See Vecu port p" FLOAT32_IEEE NO_COMPU_METHOD 0 0 1.175494351e-38 3.402823466e+38 ECU_ADDRESS 0 SYMBOL_LINK "Rte_IoHwAbstractionUsr_Batt_Volt_f32" 0 DISPLAY_IDENTIFIER Sa_BkCpPc.ReceiverPorts.Batt.Volt_f32 /end MEASUREMENT
/begin MEASUREMENT Sa_BkCpPc.BattSwitched.Volt_f32 "This signal is intended to communicate any type voltage signal measured by the ecu.  This signal has a lower limit of 0 which reequires users of the signal to provide divide by 0 protection if it is used as a denominator in a calculation.  See Vecu port p" FLOAT32_IEEE NO_COMPU_METHOD 0 0 1.175494351e-38 3.402823466e+38 ECU_ADDRESS 0 SYMBOL_LINK "Rte_IoHwAbstractionUsr_BattSwitched_Volt_f32" 0 DISPLAY_IDENTIFIER Sa_BkCpPc.ReceiverPorts.BattSwitched.Volt_f32 /end MEASUREMENT
/begin MEASUREMENT Sa_BkCpPc.MotorVelocityMRFUnfiltered.MtrRadpS_f32 "MICROSAR RTE" FLOAT32_IEEE NO_COMPU_METHOD 0 0 1.175494351e-38 3.402823466e+38 ECU_ADDRESS 0 SYMBOL_LINK "Rte_MtrVel_MRFMotorVelUnfiltered_MtrRadpS_f32" 0 DISPLAY_IDENTIFIER Sa_BkCpPc.ReceiverPorts.MotorVelocityMRFUnfiltered.MtrRadpS_f32 /end MEASUREMENT
/begin MEASUREMENT Sa_BkCpPc.OVERRIDESIGDIAGADC.Volt_f32 "This signal is intended to communicate any type voltage signal measured by the ecu.  This signal has a lower limit of 0 which reequires users of the signal to provide divide by 0 protection if it is used as a denominator in a calculation.  See Vecu port p" FLOAT32_IEEE NO_COMPU_METHOD 0 0 1.175494351e-38 3.402823466e+38 ECU_ADDRESS 0 SYMBOL_LINK "Rte_Sa_BkCpPc_OVERRIDESIGDIAGADC_Volt_f32" 0 DISPLAY_IDENTIFIER Sa_BkCpPc.ReceiverPorts.OVERRIDESIGDIAGADC.Volt_f32 /end MEASUREMENT
/begin MEASUREMENT Sa_BkCpPc.PMOSDIAGADC.Volt_f32 "This signal is intended to communicate any type voltage signal measured by the ecu.  This signal has a lower limit of 0 which reequires users of the signal to provide divide by 0 protection if it is used as a denominator in a calculation.  See Vecu port p" FLOAT32_IEEE NO_COMPU_METHOD 0 0 1.175494351e-38 3.402823466e+38 ECU_ADDRESS 0 SYMBOL_LINK "Rte_Sa_BkCpPc_PMOSDIAGADC_Volt_f32" 0 DISPLAY_IDENTIFIER Sa_BkCpPc.ReceiverPorts.PMOSDIAGADC.Volt_f32 /end MEASUREMENT
/begin MEASUREMENT Sa_BkCpPc.PwrDiscATestComplete.Cnt_lgc "MICROSAR RTE" UBYTE RTE_CM_BOOLEAN 0 0 0 255 ECU_ADDRESS 0 SYMBOL_LINK "Rte_Sa_BkCpPc_PwrDiscATestComplete_Cnt_lgc" 0 DISPLAY_IDENTIFIER Sa_BkCpPc.SenderPorts.PwrDiscATestComplete.Cnt_lgc /end MEASUREMENT
/begin MEASUREMENT Sa_BkCpPc.PwrDiscATestStart.Cnt_lgc "MICROSAR RTE" UBYTE RTE_CM_BOOLEAN 0 0 0 255 ECU_ADDRESS 0 SYMBOL_LINK "Rte_Ap_HwPwUp_PwrDiscATestStart_Cnt_lgc" 0 DISPLAY_IDENTIFIER Sa_BkCpPc.ReceiverPorts.PwrDiscATestStart.Cnt_lgc /end MEASUREMENT
/begin MEASUREMENT Sa_BkCpPc.PwrDiscBTestComplete.Cnt_lgc "MICROSAR RTE" UBYTE RTE_CM_BOOLEAN 0 0 0 255 ECU_ADDRESS 0 SYMBOL_LINK "Rte_Sa_BkCpPc_PwrDiscBTestComplete_Cnt_lgc" 0 DISPLAY_IDENTIFIER Sa_BkCpPc.SenderPorts.PwrDiscBTestComplete.Cnt_lgc /end MEASUREMENT
/begin MEASUREMENT Sa_BkCpPc.PwrDiscBTestStart.Cnt_lgc "MICROSAR RTE" UBYTE RTE_CM_BOOLEAN 0 0 0 255 ECU_ADDRESS 0 SYMBOL_LINK "Rte_Ap_HwPwUp_PwrDiscBTestStart_Cnt_lgc" 0 DISPLAY_IDENTIFIER Sa_BkCpPc.ReceiverPorts.PwrDiscBTestStart.Cnt_lgc /end MEASUREMENT
/begin MEASUREMENT Sa_BkCpPc.PwrDiscClosed.Cnt_lgc "MICROSAR RTE" UBYTE RTE_CM_BOOLEAN 0 0 0 255 ECU_ADDRESS 0 SYMBOL_LINK "Rte_Sa_BkCpPc_PwrDiscClosed_Cnt_lgc" 0 DISPLAY_IDENTIFIER Sa_BkCpPc.SenderPorts.PwrDiscClosed.Cnt_lgc /end MEASUREMENT
/begin MEASUREMENT Sa_BkCpPc.SystemState.Mode "MICROSAR RTE" UBYTE RTE_CM_ENUM_StaMd_Mode 0 0 0 255 ECU_ADDRESS 0 SYMBOL_LINK "Rte_ModeMachine_Ap_StaMd9_SystemState9_Mode" 0 DISPLAY_IDENTIFIER Sa_BkCpPc.ModeRequirePorts.SystemState.Mode /end MEASUREMENT
/begin MEASUREMENT Sa_HwTrq2.AnaDiffHwTrq.Volt_f32 "This signal is intended to communicate any type voltage signal measured by the ecu.  This signal has a lower limit of 0 which reequires users of the signal to provide divide by 0 protection if it is used as a denominator in a calculation.  See Vecu port p" FLOAT32_IEEE NO_COMPU_METHOD 0 0 1.175494351e-38 3.402823466e+38 ECU_ADDRESS 0 SYMBOL_LINK "Rte_HwTrq_AnaDiffHwTrq_Volt_f32" 0 DISPLAY_IDENTIFIER Sa_HwTrq2.ReceiverPorts.AnaDiffHwTrq.Volt_f32 /end MEASUREMENT
/begin MEASUREMENT Sa_HwTrq2.AnaHwTorque.HwNm_f32 "MICROSAR RTE" FLOAT32_IEEE NO_COMPU_METHOD 0 0 1.175494351e-38 3.402823466e+38 ECU_ADDRESS 0 SYMBOL_LINK "Rte_HwTrq_AnaHwTorque_HwNm_f32" 0 DISPLAY_IDENTIFIER Sa_HwTrq2.ReceiverPorts.AnaHwTorque.HwNm_f32 /end MEASUREMENT
/begin MEASUREMENT Sa_HwTrq2.HwTrqScaleVal.VoltsPerDeg_f32 "MICROSAR RTE" FLOAT32_IEEE NO_COMPU_METHOD 0 0 1.175494351e-38 3.402823466e+38 ECU_ADDRESS 0 SYMBOL_LINK "Rte_HwTrq_HwTrqScaleVal_VoltsPerDeg_f32" 0 DISPLAY_IDENTIFIER Sa_HwTrq2.ReceiverPorts.HwTrqScaleVal.VoltsPerDeg_f32 /end MEASUREMENT
/begin MEASUREMENT Sa_HwTrq2.SysCT1ADC.Volt_f32 "This signal is intended to communicate any type voltage signal measured by the ecu.  This signal has a lower limit of 0 which reequires users of the signal to provide divide by 0 protection if it is used as a denominator in a calculation.  See Vecu port p" FLOAT32_IEEE NO_COMPU_METHOD 0 0 1.175494351e-38 3.402823466e+38 ECU_ADDRESS 0 SYMBOL_LINK "Rte_IoHwAbstractionUsr_SysCT1ADC_Volt_f32" 0 DISPLAY_IDENTIFIER Sa_HwTrq2.ReceiverPorts.SysCT1ADC.Volt_f32 /end MEASUREMENT
/begin MEASUREMENT Sa_HwTrq2.SysCT2ADC.Volt_f32 "This signal is intended to communicate any type voltage signal measured by the ecu.  This signal has a lower limit of 0 which reequires users of the signal to provide divide by 0 protection if it is used as a denominator in a calculation.  See Vecu port p" FLOAT32_IEEE NO_COMPU_METHOD 0 0 1.175494351e-38 3.402823466e+38 ECU_ADDRESS 0 SYMBOL_LINK "Rte_IoHwAbstractionUsr_SysCT2ADC_Volt_f32" 0 DISPLAY_IDENTIFIER Sa_HwTrq2.ReceiverPorts.SysCT2ADC.Volt_f32 /end MEASUREMENT
/begin MEASUREMENT Sa_HwTrq2.T1TrimVal.Volt_f32 "This signal is intended to communicate any type voltage signal measured by the ecu.  This signal has a lower limit of 0 which reequires users of the signal to provide divide by 0 protection if it is used as a denominator in a calculation.  See Vecu port p" FLOAT32_IEEE NO_COMPU_METHOD 0 0 1.175494351e-38 3.402823466e+38 ECU_ADDRESS 0 SYMBOL_LINK "Rte_HwTrq_T1TrimVal_Volt_f32" 0 DISPLAY_IDENTIFIER Sa_HwTrq2.ReceiverPorts.T1TrimVal.Volt_f32 /end MEASUREMENT
/begin MEASUREMENT Sa_HwTrq2.T2TrimVal.Volt_f32 "This signal is intended to communicate any type voltage signal measured by the ecu.  This signal has a lower limit of 0 which reequires users of the signal to provide divide by 0 protection if it is used as a denominator in a calculation.  See Vecu port p" FLOAT32_IEEE NO_COMPU_METHOD 0 0 1.175494351e-38 3.402823466e+38 ECU_ADDRESS 0 SYMBOL_LINK "Rte_HwTrq_T2TrimVal_Volt_f32" 0 DISPLAY_IDENTIFIER Sa_HwTrq2.ReceiverPorts.T2TrimVal.Volt_f32 /end MEASUREMENT
/begin MEASUREMENT Sa_MtrPos2.CorrectedMtrPos.Rev_f32 "MICROSAR RTE" FLOAT32_IEEE NO_COMPU_METHOD 0 0 1.175494351e-38 3.402823466e+38 ECU_ADDRESS 0 SYMBOL_LINK "Rte_Sa_MtrPos2_CorrectedMtrPos_Rev_f32" 0 DISPLAY_IDENTIFIER Sa_MtrPos2.SenderPorts.CorrectedMtrPos.Rev_f32 /end MEASUREMENT
/begin MEASUREMENT Sa_MtrPos2.CosTheta1.Volt_f32 "This signal is intended to communicate any type voltage signal measured by the ecu.  This signal has a lower limit of 0 which reequires users of the signal to provide divide by 0 protection if it is used as a denominator in a calculation.  See Vecu port p" FLOAT32_IEEE NO_COMPU_METHOD 0 0 1.175494351e-38 3.402823466e+38 ECU_ADDRESS 0 SYMBOL_LINK "Rte_Sa_MtrPos2_CosTheta1_Volt_f32" 0 DISPLAY_IDENTIFIER Sa_MtrPos2.SenderPorts.CosTheta1.Volt_f32 /end MEASUREMENT
/begin MEASUREMENT Sa_MtrPos2.MechMtrPos.Rev_f32 "MICROSAR RTE" FLOAT32_IEEE NO_COMPU_METHOD 0 0 1.175494351e-38 3.402823466e+38 ECU_ADDRESS 0 SYMBOL_LINK "Rte_Sa_MtrPos2_MechMtrPos_Rev_f32" 0 DISPLAY_IDENTIFIER Sa_MtrPos2.SenderPorts.MechMtrPos.Rev_f32 /end MEASUREMENT
/begin MEASUREMENT Sa_MtrPos2.MotorVelMRF.MtrRadpS_f32 "MICROSAR RTE" FLOAT32_IEEE NO_COMPU_METHOD 0 0 1.175494351e-38 3.402823466e+38 ECU_ADDRESS 0 SYMBOL_LINK "Rte_MtrVel_MRFMotorVel_MtrRadpS_f32" 0 DISPLAY_IDENTIFIER Sa_MtrPos2.ReceiverPorts.MotorVelMRF.MtrRadpS_f32 /end MEASUREMENT
/begin MEASUREMENT Sa_MtrPos2.SinTheta1.Volt_f32 "This signal is intended to communicate any type voltage signal measured by the ecu.  This signal has a lower limit of 0 which reequires users of the signal to provide divide by 0 protection if it is used as a denominator in a calculation.  See Vecu port p" FLOAT32_IEEE NO_COMPU_METHOD 0 0 1.175494351e-38 3.402823466e+38 ECU_ADDRESS 0 SYMBOL_LINK "Rte_Sa_MtrPos2_SinTheta1_Volt_f32" 0 DISPLAY_IDENTIFIER Sa_MtrPos2.SenderPorts.SinTheta1.Volt_f32 /end MEASUREMENT
/begin MEASUREMENT Sa_MtrPos2.SysCCorrectedMtrPos.Rev_f32 "MICROSAR RTE" FLOAT32_IEEE NO_COMPU_METHOD 0 0 1.175494351e-38 3.402823466e+38 ECU_ADDRESS 0 SYMBOL_LINK "Rte_Sa_MtrPos2_SysCCorrectedMtrPos_Rev_f32" 0 DISPLAY_IDENTIFIER Sa_MtrPos2.SenderPorts.SysCCorrectedMtrPos.Rev_f32 /end MEASUREMENT
/begin MEASUREMENT Sa_MtrPos2.SysCMechMtrPos.Rev_f32 "MICROSAR RTE" FLOAT32_IEEE NO_COMPU_METHOD 0 0 1.175494351e-38 3.402823466e+38 ECU_ADDRESS 0 SYMBOL_LINK "Rte_Sa_MtrPos2_SysCMechMtrPos_Rev_f32" 0 DISPLAY_IDENTIFIER Sa_MtrPos2.SenderPorts.SysCMechMtrPos.Rev_f32 /end MEASUREMENT
/begin MEASUREMENT Sa_MtrPos3.CorrectedMtrPos.Rev_f32 "MICROSAR RTE" FLOAT32_IEEE NO_COMPU_METHOD 0 0 1.175494351e-38 3.402823466e+38 ECU_ADDRESS 0 SYMBOL_LINK "Rte_Sa_MtrPos2_CorrectedMtrPos_Rev_f32" 0 DISPLAY_IDENTIFIER Sa_MtrPos3.ReceiverPorts.CorrectedMtrPos.Rev_f32 /end MEASUREMENT
/begin MEASUREMENT Sa_MtrPos3.InvCos2Scaled.Volt_f32 "This signal is intended to communicate any type voltage signal measured by the ecu.  This signal has a lower limit of 0 which reequires users of the signal to provide divide by 0 protection if it is used as a denominator in a calculation.  See Vecu port p" FLOAT32_IEEE NO_COMPU_METHOD 0 0 1.175494351e-38 3.402823466e+38 ECU_ADDRESS 0 SYMBOL_LINK "Rte_IoHwAbstractionUsr_InvCos2Scaled_Volt_f32" 0 DISPLAY_IDENTIFIER Sa_MtrPos3.ReceiverPorts.InvCos2Scaled.Volt_f32 /end MEASUREMENT
/begin MEASUREMENT Sa_MtrPos3.InvSin2Scaled.Volt_f32 "This signal is intended to communicate any type voltage signal measured by the ecu.  This signal has a lower limit of 0 which reequires users of the signal to provide divide by 0 protection if it is used as a denominator in a calculation.  See Vecu port p" FLOAT32_IEEE NO_COMPU_METHOD 0 0 1.175494351e-38 3.402823466e+38 ECU_ADDRESS 0 SYMBOL_LINK "Rte_IoHwAbstractionUsr_InvSin2Scaled_Volt_f32" 0 DISPLAY_IDENTIFIER Sa_MtrPos3.ReceiverPorts.InvSin2Scaled.Volt_f32 /end MEASUREMENT
/begin MEASUREMENT Sa_MtrVel2.AsstAssemPol.Cnt_s08 "MICROSAR RTE" SBYTE NO_COMPU_METHOD 0 0 -128 127 ECU_ADDRESS 0 SYMBOL_LINK "Rte_Polarity_AssistAssyPolarity_Cnt_s08" 0 DISPLAY_IDENTIFIER Sa_MtrVel2.ReceiverPorts.AsstAssemPol.Cnt_s08 /end MEASUREMENT
/begin MEASUREMENT Sa_MtrVel2.CumMtrPosMRF.Deg_f32 "MICROSAR RTE" FLOAT32_IEEE NO_COMPU_METHOD 0 0 1.175494351e-38 3.402823466e+38 ECU_ADDRESS 0 SYMBOL_LINK "Rte_MtrPos_CumMtrPosMRF_Deg_f32" 0 DISPLAY_IDENTIFIER Sa_MtrVel2.ReceiverPorts.CumMtrPosMRF.Deg_f32 /end MEASUREMENT
/begin MEASUREMENT Sa_MtrVel2.HandWheelVel.HwRadpS_f32 "MICROSAR RTE" FLOAT32_IEEE NO_COMPU_METHOD 0 0 1.175494351e-38 3.402823466e+38 ECU_ADDRESS 0 SYMBOL_LINK "Rte_MtrVel_HandwheelVel_HwRadpS_f32" 0 DISPLAY_IDENTIFIER Sa_MtrVel2.ReceiverPorts.HandWheelVel.HwRadpS_f32 /end MEASUREMENT
/begin MEASUREMENT Sa_MtrVel2.MRFMotorVel.MtrRadpS_f32 "MICROSAR RTE" FLOAT32_IEEE NO_COMPU_METHOD 0 0 1.175494351e-38 3.402823466e+38 ECU_ADDRESS 0 SYMBOL_LINK "Rte_MtrVel_MRFMotorVel_MtrRadpS_f32" 0 DISPLAY_IDENTIFIER Sa_MtrVel2.ReceiverPorts.MRFMotorVel.MtrRadpS_f32 /end MEASUREMENT
/begin MEASUREMENT Sa_MtrVel2.SysCDiagHandWheelVel.HwRadpS_f32 "MICROSAR RTE" FLOAT32_IEEE NO_COMPU_METHOD 0 0 1.175494351e-38 3.402823466e+38 ECU_ADDRESS 0 SYMBOL_LINK "Rte_Sa_MtrVel2_SysCDiagHandWheelVel_HwRadpS_f32" 0 DISPLAY_IDENTIFIER Sa_MtrVel2.SenderPorts.SysCDiagHandWheelVel.HwRadpS_f32 /end MEASUREMENT
/begin MEASUREMENT Sa_MtrVel2.SysCDiagMtrVelMRF.MtrRadpS_f32 "MICROSAR RTE" FLOAT32_IEEE NO_COMPU_METHOD 0 0 1.175494351e-38 3.402823466e+38 ECU_ADDRESS 0 SYMBOL_LINK "Rte_Sa_MtrVel2_SysCDiagMtrVelMRF_MtrRadpS_f32" 0 DISPLAY_IDENTIFIER Sa_MtrVel2.SenderPorts.SysCDiagMtrVelMRF.MtrRadpS_f32 /end MEASUREMENT
/begin MEASUREMENT Sa_OvrVoltMon.PwrDiscBTestStart.Cnt_lgc "MICROSAR RTE" UBYTE RTE_CM_BOOLEAN 0 0 0 255 ECU_ADDRESS 0 SYMBOL_LINK "Rte_Ap_HwPwUp_PwrDiscBTestStart_Cnt_lgc" 0 DISPLAY_IDENTIFIER Sa_OvrVoltMon.ReceiverPorts.PwrDiscBTestStart.Cnt_lgc /end MEASUREMENT
/begin MEASUREMENT Sa_OvrVoltMon.SystemState.Mode "MICROSAR RTE" UBYTE RTE_CM_ENUM_StaMd_Mode 0 0 0 255 ECU_ADDRESS 0 SYMBOL_LINK "Rte_ModeMachine_StaMd_SystemState_Mode" 0 DISPLAY_IDENTIFIER Sa_OvrVoltMon.ModeRequirePorts.SystemState.Mode /end MEASUREMENT
/begin MEASUREMENT SrlComInput.AirTempOutside.DegC_f32 "MICROSAR RTE" FLOAT32_IEEE NO_COMPU_METHOD 0 0 1.175494351e-38 3.402823466e+38 ECU_ADDRESS 0 SYMBOL_LINK "Rte_SrlComInput_AirTempOutside_DegC_f32" 0 DISPLAY_IDENTIFIER SrlComInput.SenderPorts.AirTempOutside.DegC_f32 /end MEASUREMENT
/begin MEASUREMENT SrlComInput.AmbTempAvg.DegC_f32 "MICROSAR RTE" FLOAT32_IEEE NO_COMPU_METHOD 0 0 1.175494351e-38 3.402823466e+38 ECU_ADDRESS 0 SYMBOL_LINK "Rte_SrlComInput_AmbTempAvg_DegC_f32" 0 DISPLAY_IDENTIFIER SrlComInput.SenderPorts.AmbTempAvg.DegC_f32 /end MEASUREMENT
/begin MEASUREMENT SrlComInput.AnaHwTorque.HwNm_f32 "MICROSAR RTE" FLOAT32_IEEE NO_COMPU_METHOD 0 0 1.175494351e-38 3.402823466e+38 ECU_ADDRESS 0 SYMBOL_LINK "Rte_HwTrq_AnaHwTorque_HwNm_f32" 0 DISPLAY_IDENTIFIER SrlComInput.ReceiverPorts.AnaHwTorque.HwNm_f32 /end MEASUREMENT
/begin MEASUREMENT SrlComInput.BattVolt.Volt_f32 "This port prototype is inteded to communicate voltage signals that represent the ecu supplied voltage.  This signal has a lower limit, which is non-zero, to allow users of the signal to use it as a denominator in an expression without requiring a divide b" FLOAT32_IEEE NO_COMPU_METHOD 0 0 1.175494351e-38 3.402823466e+38 ECU_ADDRESS 0 SYMBOL_LINK "Rte_SrlComInput_BattVolt_Volt_f32" 0 DISPLAY_IDENTIFIER SrlComInput.SenderPorts.BattVolt.Volt_f32 /end MEASUREMENT
/begin MEASUREMENT SrlComInput.CMDIgnStat.Cnt_u08 "MICROSAR RTE" UBYTE NO_COMPU_METHOD 0 0 0 255 ECU_ADDRESS 0 SYMBOL_LINK "Rte_SrlComInput_CMDIgnStat_Cnt_u08" 0 DISPLAY_IDENTIFIER SrlComInput.SenderPorts.CMDIgnStat.Cnt_u08 /end MEASUREMENT
/begin MEASUREMENT SrlComInput.CanMsgReceived.Cnt_lgc "MICROSAR RTE" UBYTE RTE_CM_BOOLEAN 0 0 0 255 ECU_ADDRESS 0 SYMBOL_LINK "Rte_SrlComInput_CanMsgReceived_Cnt_lgc" 0 DISPLAY_IDENTIFIER SrlComInput.SenderPorts.CanMsgReceived.Cnt_lgc /end MEASUREMENT
/begin MEASUREMENT SrlComInput.CfgStatRQ.Cnt_u08 "MICROSAR RTE" UBYTE NO_COMPU_METHOD 0 0 0 255 ECU_ADDRESS 0 SYMBOL_LINK "Rte_SrlComInput_CfgStatRQ_Cnt_u08" 0 DISPLAY_IDENTIFIER SrlComInput.SenderPorts.CfgStatRQ.Cnt_u08 /end MEASUREMENT
/begin MEASUREMENT SrlComInput.DSTEOLDisable.Cnt_lgc "MICROSAR RTE" UBYTE RTE_CM_BOOLEAN 0 0 0 255 ECU_ADDRESS 0 SYMBOL_LINK "Rte_SrlComInput_DSTEOLDisable_Cnt_lgc" 0 DISPLAY_IDENTIFIER SrlComInput.SenderPorts.DSTEOLDisable.Cnt_lgc /end MEASUREMENT
/begin MEASUREMENT SrlComInput.DSTEnableRqst.Cnt_lgc "MICROSAR RTE" UBYTE RTE_CM_BOOLEAN 0 0 0 255 ECU_ADDRESS 0 SYMBOL_LINK "Rte_SrlComInput_DSTEnableRqst_Cnt_lgc" 0 DISPLAY_IDENTIFIER SrlComInput.SenderPorts.DSTEnableRqst.Cnt_lgc /end MEASUREMENT
/begin MEASUREMENT SrlComInput.DSTErrCntrRecvLevel.Cnt_u08 "MICROSAR RTE" UBYTE NO_COMPU_METHOD 0 0 0 255 ECU_ADDRESS 0 SYMBOL_LINK "Rte_SrlComInput_DSTErrCntrRecvLevel_Cnt_u08" 0 DISPLAY_IDENTIFIER SrlComInput.SenderPorts.DSTErrCntrRecvLevel.Cnt_u08 /end MEASUREMENT
/begin MEASUREMENT SrlComInput.DSTExtSystemFltActive.Cnt_lgc "MICROSAR RTE" UBYTE RTE_CM_BOOLEAN 0 0 0 255 ECU_ADDRESS 0 SYMBOL_LINK "Rte_SrlComInput_DSTExtSystemFltActive_Cnt_lgc" 0 DISPLAY_IDENTIFIER SrlComInput.SenderPorts.DSTExtSystemFltActive.Cnt_lgc /end MEASUREMENT
/begin MEASUREMENT SrlComInput.DSTFuncPresent.Cnt_lgc "MICROSAR RTE" UBYTE RTE_CM_BOOLEAN 0 0 0 255 ECU_ADDRESS 0 SYMBOL_LINK "Rte_SrlComInput_DSTFuncPresent_Cnt_lgc" 0 DISPLAY_IDENTIFIER SrlComInput.SenderPorts.DSTFuncPresent.Cnt_lgc /end MEASUREMENT
/begin MEASUREMENT SrlComInput.DSTRevGearValid.Cnt_lgc "MICROSAR RTE" UBYTE RTE_CM_BOOLEAN 0 0 0 255 ECU_ADDRESS 0 SYMBOL_LINK "Rte_SrlComInput_DSTRevGearValid_Cnt_lgc" 0 DISPLAY_IDENTIFIER SrlComInput.SenderPorts.DSTRevGearValid.Cnt_lgc /end MEASUREMENT
/begin MEASUREMENT SrlComInput.DSTSlewStart.Cnt_lgc "MICROSAR RTE" UBYTE RTE_CM_BOOLEAN 0 0 0 255 ECU_ADDRESS 0 SYMBOL_LINK "Rte_Ap_StbCTO_DSTSlewStart_Cnt_lgc" 0 DISPLAY_IDENTIFIER SrlComInput.ReceiverPorts.DSTSlewStart.Cnt_lgc /end MEASUREMENT
/begin MEASUREMENT SrlComInput.DSTState.Cnt_u08 "MICROSAR RTE" UBYTE NO_COMPU_METHOD 0 0 0 255 ECU_ADDRESS 0 SYMBOL_LINK "Rte_Ap_StbCTO_DSTState_Cnt_u08" 0 DISPLAY_IDENTIFIER SrlComInput.ReceiverPorts.DSTState.Cnt_u08 /end MEASUREMENT
/begin MEASUREMENT SrlComInput.DSTTOCState.Uls_enum "MICROSAR RTE" UBYTE RTE_CM_ENUM_TOC_STATE 0 0 0 255 ECU_ADDRESS 0 SYMBOL_LINK "Rte_SrlComInput_DSTTOCState_Uls_enum" 0 DISPLAY_IDENTIFIER SrlComInput.SenderPorts.DSTTOCState.Uls_enum /end MEASUREMENT
/begin MEASUREMENT SrlComInput.DSTTrqOvCmdRqst.HwNm_f32 "MICROSAR RTE" FLOAT32_IEEE NO_COMPU_METHOD 0 0 1.175494351e-38 3.402823466e+38 ECU_ADDRESS 0 SYMBOL_LINK "Rte_SrlComInput_DSTTrqOvCmdRqst_HwNm_f32" 0 DISPLAY_IDENTIFIER SrlComInput.SenderPorts.DSTTrqOvCmdRqst.HwNm_f32 /end MEASUREMENT
/begin MEASUREMENT SrlComInput.DSTTrqOvRqstValid.Cnt_lgc "MICROSAR RTE" UBYTE RTE_CM_BOOLEAN 0 0 0 255 ECU_ADDRESS 0 SYMBOL_LINK "Rte_SrlComInput_DSTTrqOvRqstValid_Cnt_lgc" 0 DISPLAY_IDENTIFIER SrlComInput.SenderPorts.DSTTrqOvRqstValid.Cnt_lgc /end MEASUREMENT
/begin MEASUREMENT SrlComInput.DefaultVehSpd.Cnt_lgc "MICROSAR RTE" UBYTE RTE_CM_BOOLEAN 0 0 0 255 ECU_ADDRESS 0 SYMBOL_LINK "Rte_DiagMgr_DiagStsDefVehSpd_Cnt_lgc" 0 DISPLAY_IDENTIFIER SrlComInput.ReceiverPorts.DefaultVehSpd.Cnt_lgc /end MEASUREMENT
/begin MEASUREMENT SrlComInput.DesiredTunPers.Cnt_u16 "MICROSAR RTE" UWORD NO_COMPU_METHOD 0 0 0 65535 ECU_ADDRESS 0 SYMBOL_LINK "Rte_SrlComInput_DesiredTunPers_Cnt_u16" 0 DISPLAY_IDENTIFIER SrlComInput.SenderPorts.DesiredTunPers.Cnt_u16 /end MEASUREMENT
/begin MEASUREMENT SrlComInput.DesiredTunPersTypH.Cnt_u08 "MICROSAR RTE" UBYTE NO_COMPU_METHOD 0 0 0 255 ECU_ADDRESS 0 SYMBOL_LINK "Rte_SrlComInput_DesiredTunPersTypH_Cnt_u08" 0 DISPLAY_IDENTIFIER SrlComInput.SenderPorts.DesiredTunPersTypH.Cnt_u08 /end MEASUREMENT
/begin MEASUREMENT SrlComInput.DesiredTunSet.Cnt_u16 "MICROSAR RTE" UWORD NO_COMPU_METHOD 0 0 0 65535 ECU_ADDRESS 0 SYMBOL_LINK "Rte_SrlComInput_DesiredTunSet_Cnt_u16" 0 DISPLAY_IDENTIFIER SrlComInput.SenderPorts.DesiredTunSet.Cnt_u16 /end MEASUREMENT
/begin MEASUREMENT SrlComInput.EPS_Mode_Req.Cnt_u08 "MICROSAR RTE" UBYTE NO_COMPU_METHOD 0 0 0 255 ECU_ADDRESS 0 SYMBOL_LINK "Rte_SrlComInput_EPS_Mode_Req_Cnt_u08" 0 DISPLAY_IDENTIFIER SrlComInput.SenderPorts.EPS_Mode_Req.Cnt_u08 /end MEASUREMENT
/begin MEASUREMENT SrlComInput.EngOilTemp.DegC_f32 "MICROSAR RTE" FLOAT32_IEEE NO_COMPU_METHOD 0 0 1.175494351e-38 3.402823466e+38 ECU_ADDRESS 0 SYMBOL_LINK "Rte_SrlComInput_EngOilTemp_DegC_f32" 0 DISPLAY_IDENTIFIER SrlComInput.SenderPorts.EngOilTemp.DegC_f32 /end MEASUREMENT
/begin MEASUREMENT SrlComInput.EngRPM.Cnt_u16 "MICROSAR RTE" UWORD NO_COMPU_METHOD 0 0 0 65535 ECU_ADDRESS 0 SYMBOL_LINK "Rte_SrlComInput_EngRPM_Cnt_u16" 0 DISPLAY_IDENTIFIER SrlComInput.SenderPorts.EngRPM.Cnt_u16 /end MEASUREMENT
/begin MEASUREMENT SrlComInput.EssEngStop.Cnt_lgc "MICROSAR RTE" UBYTE RTE_CM_BOOLEAN 0 0 0 255 ECU_ADDRESS 0 SYMBOL_LINK "Rte_SrlComInput_EssEngStop_Cnt_lgc" 0 DISPLAY_IDENTIFIER SrlComInput.SenderPorts.EssEngStop.Cnt_lgc /end MEASUREMENT
/begin MEASUREMENT SrlComInput.EstFric.HwNm_f32 "MICROSAR RTE" FLOAT32_IEEE NO_COMPU_METHOD 0 0 1.175494351e-38 3.402823466e+38 ECU_ADDRESS 0 SYMBOL_LINK "Rte_Ap_AvgFricLrn_EstFric_HwNm_f32" 0 DISPLAY_IDENTIFIER SrlComInput.ReceiverPorts.EstFric.HwNm_f32 /end MEASUREMENT
/begin MEASUREMENT SrlComInput.HaLFEnableRqst.Cnt_lgc "MICROSAR RTE" UBYTE RTE_CM_BOOLEAN 0 0 0 255 ECU_ADDRESS 0 SYMBOL_LINK "Rte_SrlComInput_HaLFEnableRqst_Cnt_lgc" 0 DISPLAY_IDENTIFIER SrlComInput.SenderPorts.HaLFEnableRqst.Cnt_lgc /end MEASUREMENT
/begin MEASUREMENT SrlComInput.HaLFErrInterfaceActive.Cnt_lgc "MICROSAR RTE" UBYTE RTE_CM_BOOLEAN 0 0 0 255 ECU_ADDRESS 0 SYMBOL_LINK "Rte_SrlComInput_HaLFErrInterfaceActive_Cnt_lgc" 0 DISPLAY_IDENTIFIER SrlComInput.SenderPorts.HaLFErrInterfaceActive.Cnt_lgc /end MEASUREMENT
/begin MEASUREMENT SrlComInput.HaLFExtSystemFltActive.Cnt_lgc "MICROSAR RTE" UBYTE RTE_CM_BOOLEAN 0 0 0 255 ECU_ADDRESS 0 SYMBOL_LINK "Rte_SrlComInput_HaLFExtSystemFltActive_Cnt_lgc" 0 DISPLAY_IDENTIFIER SrlComInput.SenderPorts.HaLFExtSystemFltActive.Cnt_lgc /end MEASUREMENT
/begin MEASUREMENT SrlComInput.HaLFFuncPresent.Cnt_lgc "MICROSAR RTE" UBYTE RTE_CM_BOOLEAN 0 0 0 255 ECU_ADDRESS 0 SYMBOL_LINK "Rte_SrlComInput_HaLFFuncPresent_Cnt_lgc" 0 DISPLAY_IDENTIFIER SrlComInput.SenderPorts.HaLFFuncPresent.Cnt_lgc /end MEASUREMENT
/begin MEASUREMENT SrlComInput.HaLFIntSystemFltActive.Cnt_lgc "MICROSAR RTE" UBYTE RTE_CM_BOOLEAN 0 0 0 255 ECU_ADDRESS 0 SYMBOL_LINK "Rte_SrlComInput_HaLFIntSystemFltActive_Cnt_lgc" 0 DISPLAY_IDENTIFIER SrlComInput.SenderPorts.HaLFIntSystemFltActive.Cnt_lgc /end MEASUREMENT
/begin MEASUREMENT SrlComInput.HaLFSWATrqFail.Cnt_lgc "MICROSAR RTE" UBYTE RTE_CM_BOOLEAN 0 0 0 255 ECU_ADDRESS 0 SYMBOL_LINK "Rte_SrlComInput_HaLFSWATrqFail_Cnt_lgc" 0 DISPLAY_IDENTIFIER SrlComInput.SenderPorts.HaLFSWATrqFail.Cnt_lgc /end MEASUREMENT
/begin MEASUREMENT SrlComInput.HaLFState.Cnt_u08 "MICROSAR RTE" UBYTE NO_COMPU_METHOD 0 0 0 255 ECU_ADDRESS 0 SYMBOL_LINK "Rte_Ap_HaLFTO_HaLFState_Cnt_u08" 0 DISPLAY_IDENTIFIER SrlComInput.ReceiverPorts.HaLFState.Cnt_u08 /end MEASUREMENT
/begin MEASUREMENT SrlComInput.HaLFSuspend.Cnt_lgc "MICROSAR RTE" UBYTE RTE_CM_BOOLEAN 0 0 0 255 ECU_ADDRESS 0 SYMBOL_LINK "Rte_Ap_HaLFTO_HaLFSuspend_Cnt_lgc" 0 DISPLAY_IDENTIFIER SrlComInput.ReceiverPorts.HaLFSuspend.Cnt_lgc /end MEASUREMENT
/begin MEASUREMENT SrlComInput.HaLFTrqOvCmdRqst.MtrNm_f32 "MICROSAR RTE" FLOAT32_IEEE NO_COMPU_METHOD 0 0 1.175494351e-38 3.402823466e+38 ECU_ADDRESS 0 SYMBOL_LINK "Rte_SrlComInput_HaLFTrqOvCmdRqst_MtrNm_f32" 0 DISPLAY_IDENTIFIER SrlComInput.SenderPorts.HaLFTrqOvCmdRqst.MtrNm_f32 /end MEASUREMENT
/begin MEASUREMENT SrlComInput.HalfTrqOvRvrsGearEngage.Cnt_lgc "MICROSAR RTE" UBYTE RTE_CM_BOOLEAN 0 0 0 255 ECU_ADDRESS 0 SYMBOL_LINK "Rte_SrlComInput_HalfTrqOvRvrsGearEngage_Cnt_lgc" 0 DISPLAY_IDENTIFIER SrlComInput.SenderPorts.HalfTrqOvRvrsGearEngage.Cnt_lgc /end MEASUREMENT
/begin MEASUREMENT SrlComInput.HandsOnDetect.Cnt_lgc "MICROSAR RTE" UBYTE RTE_CM_BOOLEAN 0 0 0 255 ECU_ADDRESS 0 SYMBOL_LINK "Rte_Ap_PAwTO_HandsOnDetect_Cnt_lgc" 0 DISPLAY_IDENTIFIER SrlComInput.ReceiverPorts.HandsOnDetect.Cnt_lgc /end MEASUREMENT
/begin MEASUREMENT SrlComInput.IWSSCalcVspd.Kph_f32 "MICROSAR RTE" FLOAT32_IEEE NO_COMPU_METHOD 0 0 1.175494351e-38 3.402823466e+38 ECU_ADDRESS 0 SYMBOL_LINK "Rte_SrlComInput_IWSSCalcVspd_Kph_f32" 0 DISPLAY_IDENTIFIER SrlComInput.SenderPorts.IWSSCalcVspd.Kph_f32 /end MEASUREMENT
/begin MEASUREMENT SrlComInput.MEC.Cnt_enum "MICROSAR RTE" UBYTE RTE_CM_ENUM_ManufModeType 0 0 0 2 ECU_ADDRESS 0 SYMBOL_LINK "Rte_CDDInterface_MEC_Cnt_enum" 0 DISPLAY_IDENTIFIER SrlComInput.ReceiverPorts.MEC.Cnt_enum /end MEASUREMENT
/begin MEASUREMENT SrlComInput.NET_CFG_STAT_PT.Cnt_u16 "MICROSAR RTE" UWORD NO_COMPU_METHOD 0 0 0 65535 ECU_ADDRESS 0 SYMBOL_LINK "Rte_SrlComInput_NET_CFG_STAT_PT_Cnt_u16" 0 DISPLAY_IDENTIFIER SrlComInput.SenderPorts.NET_CFG_STAT_PT.Cnt_u16 /end MEASUREMENT
/begin MEASUREMENT SrlComInput.PABoostCurveSwitch.Cnt_lgc "MICROSAR RTE" UBYTE RTE_CM_BOOLEAN 0 0 0 255 ECU_ADDRESS 0 SYMBOL_LINK "Rte_Ap_PAwTO_PABoostCurveSwitch_Cnt_lgc" 0 DISPLAY_IDENTIFIER SrlComInput.ReceiverPorts.PABoostCurveSwitch.Cnt_lgc /end MEASUREMENT
/begin MEASUREMENT SrlComInput.PAEnableRqst.Cnt_lgc "MICROSAR RTE" UBYTE RTE_CM_BOOLEAN 0 0 0 255 ECU_ADDRESS 0 SYMBOL_LINK "Rte_SrlComInput_PAEnableRqst_Cnt_lgc" 0 DISPLAY_IDENTIFIER SrlComInput.SenderPorts.PAEnableRqst.Cnt_lgc /end MEASUREMENT
/begin MEASUREMENT SrlComInput.PAErrInterfaceActive.Cnt_lgc "MICROSAR RTE" UBYTE RTE_CM_BOOLEAN 0 0 0 255 ECU_ADDRESS 0 SYMBOL_LINK "Rte_SrlComInput_PAErrInterfaceActive_Cnt_lgc" 0 DISPLAY_IDENTIFIER SrlComInput.SenderPorts.PAErrInterfaceActive.Cnt_lgc /end MEASUREMENT
/begin MEASUREMENT SrlComInput.PAExtSystemFltActive.Cnt_lgc "MICROSAR RTE" UBYTE RTE_CM_BOOLEAN 0 0 0 255 ECU_ADDRESS 0 SYMBOL_LINK "Rte_SrlComInput_PAExtSystemFltActive_Cnt_lgc" 0 DISPLAY_IDENTIFIER SrlComInput.SenderPorts.PAExtSystemFltActive.Cnt_lgc /end MEASUREMENT
/begin MEASUREMENT SrlComInput.PAIntSystemFltActive.Cnt_lgc "MICROSAR RTE" UBYTE RTE_CM_BOOLEAN 0 0 0 255 ECU_ADDRESS 0 SYMBOL_LINK "Rte_SrlComInput_PAIntSystemFltActive_Cnt_lgc" 0 DISPLAY_IDENTIFIER SrlComInput.SenderPorts.PAIntSystemFltActive.Cnt_lgc /end MEASUREMENT
/begin MEASUREMENT SrlComInput.PAManoeuvrePhase.Cnt_u08 "MICROSAR RTE" UBYTE NO_COMPU_METHOD 0 0 0 255 ECU_ADDRESS 0 SYMBOL_LINK "Rte_SrlComInput_PAManoeuvrePhase_Cnt_u08" 0 DISPLAY_IDENTIFIER SrlComInput.SenderPorts.PAManoeuvrePhase.Cnt_u08 /end MEASUREMENT
/begin MEASUREMENT SrlComInput.PATrqOvCmdRqst.HwNm_f32 "MICROSAR RTE" FLOAT32_IEEE NO_COMPU_METHOD 0 0 1.175494351e-38 3.402823466e+38 ECU_ADDRESS 0 SYMBOL_LINK "Rte_SrlComInput_PATrqOvCmdRqst_HwNm_f32" 0 DISPLAY_IDENTIFIER SrlComInput.SenderPorts.PATrqOvCmdRqst.HwNm_f32 /end MEASUREMENT
/begin MEASUREMENT SrlComInput.PAWheelCriteriaMet.Cnt_lgc "MICROSAR RTE" UBYTE RTE_CM_BOOLEAN 0 0 0 255 ECU_ADDRESS 0 SYMBOL_LINK "Rte_SrlComInput_PAWheelCriteriaMet_Cnt_lgc" 0 DISPLAY_IDENTIFIER SrlComInput.SenderPorts.PAWheelCriteriaMet.Cnt_lgc /end MEASUREMENT
/begin MEASUREMENT SrlComInput.PAWhlDirRLStat.Cnt_u08 "MICROSAR RTE" UBYTE NO_COMPU_METHOD 0 0 0 255 ECU_ADDRESS 0 SYMBOL_LINK "Rte_SrlComInput_PAWhlDirRLStat_Cnt_u08" 0 DISPLAY_IDENTIFIER SrlComInput.SenderPorts.PAWhlDirRLStat.Cnt_u08 /end MEASUREMENT
/begin MEASUREMENT SrlComInput.PAWhlDirRRStat.Cnt_u08 "MICROSAR RTE" UBYTE NO_COMPU_METHOD 0 0 0 255 ECU_ADDRESS 0 SYMBOL_LINK "Rte_SrlComInput_PAWhlDirRRStat_Cnt_u08" 0 DISPLAY_IDENTIFIER SrlComInput.SenderPorts.PAWhlDirRRStat.Cnt_u08 /end MEASUREMENT
/begin MEASUREMENT SrlComInput.PAWhlPlsCntRLValid.Cnt_lgc "MICROSAR RTE" UBYTE RTE_CM_BOOLEAN 0 0 0 255 ECU_ADDRESS 0 SYMBOL_LINK "Rte_SrlComInput_PAWhlPlsCntRLValid_Cnt_lgc" 0 DISPLAY_IDENTIFIER SrlComInput.SenderPorts.PAWhlPlsCntRLValid.Cnt_lgc /end MEASUREMENT
/begin MEASUREMENT SrlComInput.PAWhlPlsCntRRValid.Cnt_lgc "MICROSAR RTE" UBYTE RTE_CM_BOOLEAN 0 0 0 255 ECU_ADDRESS 0 SYMBOL_LINK "Rte_SrlComInput_PAWhlPlsCntRRValid_Cnt_lgc" 0 DISPLAY_IDENTIFIER SrlComInput.SenderPorts.PAWhlPlsCntRRValid.Cnt_lgc /end MEASUREMENT
/begin MEASUREMENT SrlComInput.PrevHaLFEnableRqst.Cnt_lgc "MICROSAR RTE" UBYTE RTE_CM_BOOLEAN 0 0 0 255 ECU_ADDRESS 0 SYMBOL_LINK "Rte_SrlComInput_PrevHaLFEnableRqst_Cnt_lgc" 0 DISPLAY_IDENTIFIER SrlComInput.SenderPorts.PrevHaLFEnableRqst.Cnt_lgc /end MEASUREMENT
/begin MEASUREMENT SrlComInput.PrevHaLFTrqOvCmdRqst.MtrNm_f32 "MICROSAR RTE" FLOAT32_IEEE NO_COMPU_METHOD 0 0 1.175494351e-38 3.402823466e+38 ECU_ADDRESS 0 SYMBOL_LINK "Rte_SrlComInput_PrevHaLFTrqOvCmdRqst_MtrNm_f32" 0 DISPLAY_IDENTIFIER SrlComInput.SenderPorts.PrevHaLFTrqOvCmdRqst.MtrNm_f32 /end MEASUREMENT
/begin MEASUREMENT SrlComInput.PrkAssistState.Cnt_u08 "MICROSAR RTE" UBYTE NO_COMPU_METHOD 0 0 0 255 ECU_ADDRESS 0 SYMBOL_LINK "Rte_Ap_PAwTO_PrkAssistState_Cnt_u08" 0 DISPLAY_IDENTIFIER SrlComInput.ReceiverPorts.PrkAssistState.Cnt_u08 /end MEASUREMENT
/begin MEASUREMENT SrlComInput.PrkAssistSuspend.Cnt_lgc "MICROSAR RTE" UBYTE RTE_CM_BOOLEAN 0 0 0 255 ECU_ADDRESS 0 SYMBOL_LINK "Rte_Ap_PAwTO_PrkAssistSuspend_Cnt_lgc" 0 DISPLAY_IDENTIFIER SrlComInput.ReceiverPorts.PrkAssistSuspend.Cnt_lgc /end MEASUREMENT
/begin MEASUREMENT SrlComInput.PrkAsstFuncPresent.Cnt_lgc "MICROSAR RTE" UBYTE RTE_CM_BOOLEAN 0 0 0 255 ECU_ADDRESS 0 SYMBOL_LINK "Rte_SrlComInput_PrkAsstFuncPresent_Cnt_lgc" 0 DISPLAY_IDENTIFIER SrlComInput.SenderPorts.PrkAsstFuncPresent.Cnt_lgc /end MEASUREMENT
/begin MEASUREMENT SrlComInput.RxMsgsSrlComSvcDft.Cnt_lgc "MICROSAR RTE" UBYTE RTE_CM_BOOLEAN 0 0 0 255 ECU_ADDRESS 0 SYMBOL_LINK "Rte_CDDInterface_RxMsgsSrlComSvcDft_Cnt_lgc" 0 DISPLAY_IDENTIFIER SrlComInput.ReceiverPorts.RxMsgsSrlComSvcDft.Cnt_lgc /end MEASUREMENT
/begin MEASUREMENT SrlComInput.SpStPrsnt.Cnt_lgc "MICROSAR RTE" UBYTE RTE_CM_BOOLEAN 0 0 0 255 ECU_ADDRESS 0 SYMBOL_LINK "Rte_SrlComInput_SpStPrsnt_Cnt_lgc" 0 DISPLAY_IDENTIFIER SrlComInput.SenderPorts.SpStPrsnt.Cnt_lgc /end MEASUREMENT
/begin MEASUREMENT SrlComInput.SrlComLWhlSpdVld.Cnt_lgc "MICROSAR RTE" UBYTE RTE_CM_BOOLEAN 0 0 0 255 ECU_ADDRESS 0 SYMBOL_LINK "Rte_SrlComInput_SrlComLWhlSpdVld_Cnt_lgc" 0 DISPLAY_IDENTIFIER SrlComInput.SenderPorts.SrlComLWhlSpdVld.Cnt_lgc /end MEASUREMENT
/begin MEASUREMENT SrlComInput.SrlComRWhlSpdVld.Cnt_lgc "MICROSAR RTE" UBYTE RTE_CM_BOOLEAN 0 0 0 255 ECU_ADDRESS 0 SYMBOL_LINK "Rte_SrlComInput_SrlComRWhlSpdVld_Cnt_lgc" 0 DISPLAY_IDENTIFIER SrlComInput.SenderPorts.SrlComRWhlSpdVld.Cnt_lgc /end MEASUREMENT
/begin MEASUREMENT SrlComInput.SrlComVehSpd.Kph_f32 "MICROSAR RTE" FLOAT32_IEEE NO_COMPU_METHOD 0 0 1.175494351e-38 3.402823466e+38 ECU_ADDRESS 0 SYMBOL_LINK "Rte_SrlComInput_SrlComVehSpd_Kph_f32" 0 DISPLAY_IDENTIFIER SrlComInput.SenderPorts.SrlComVehSpd.Kph_f32 /end MEASUREMENT
/begin MEASUREMENT SrlComInput.SrlComVehSpdValid.Cnt_lgc "MICROSAR RTE" UBYTE RTE_CM_BOOLEAN 0 0 0 255 ECU_ADDRESS 0 SYMBOL_LINK "Rte_SrlComInput_SrlComVehSpdValid_Cnt_lgc" 0 DISPLAY_IDENTIFIER SrlComInput.SenderPorts.SrlComVehSpdValid.Cnt_lgc /end MEASUREMENT
/begin MEASUREMENT SrlComInput.StrClmTrq.HwNm_f32 "MICROSAR RTE" FLOAT32_IEEE NO_COMPU_METHOD 0 0 1.175494351e-38 3.402823466e+38 ECU_ADDRESS 0 SYMBOL_LINK "Rte_HwTrq_AnaHwTorque_HwNm_f32" 0 DISPLAY_IDENTIFIER SrlComInput.ReceiverPorts.StrClmTrq.HwNm_f32 /end MEASUREMENT
/begin MEASUREMENT SrlComInput.StrgWhlAngl.HwDeg_f32 "MICROSAR RTE" FLOAT32_IEEE NO_COMPU_METHOD 0 0 1.175494351e-38 3.402823466e+38 ECU_ADDRESS 0 SYMBOL_LINK "Rte_SrlComInput_StrgWhlAngl_HwDeg_f32" 0 DISPLAY_IDENTIFIER SrlComInput.SenderPorts.StrgWhlAngl.HwDeg_f32 /end MEASUREMENT
/begin MEASUREMENT SrlComInput.StrgWhlAnglValid.Cnt_lgc "MICROSAR RTE" UBYTE RTE_CM_BOOLEAN 0 0 0 255 ECU_ADDRESS 0 SYMBOL_LINK "Rte_SrlComInput_StrgWhlAnglValid_Cnt_lgc" 0 DISPLAY_IDENTIFIER SrlComInput.SenderPorts.StrgWhlAnglValid.Cnt_lgc /end MEASUREMENT
/begin MEASUREMENT SrlComInput.SystemState.Mode "MICROSAR RTE" UBYTE RTE_CM_ENUM_StaMd_Mode 0 0 0 255 ECU_ADDRESS 0 SYMBOL_LINK "Rte_ModeMachine_Ap_StaMd9_SystemState9_Mode" 0 DISPLAY_IDENTIFIER SrlComInput.ModeRequirePorts.SystemState.Mode /end MEASUREMENT
/begin MEASUREMENT SrlComInput.TrqOvReverseGearEngage.Cnt_lgc "MICROSAR RTE" UBYTE RTE_CM_BOOLEAN 0 0 0 255 ECU_ADDRESS 0 SYMBOL_LINK "Rte_SrlComInput_TrqOvReverseGearEngage_Cnt_lgc" 0 DISPLAY_IDENTIFIER SrlComInput.SenderPorts.TrqOvReverseGearEngage.Cnt_lgc /end MEASUREMENT
/begin MEASUREMENT SrlComInput.VCBodyStyle.Cnt_u08 "MICROSAR RTE" UBYTE NO_COMPU_METHOD 0 0 0 255 ECU_ADDRESS 0 SYMBOL_LINK "Rte_SrlComInput_VCBodyStyle_Cnt_u08" 0 DISPLAY_IDENTIFIER SrlComInput.SenderPorts.VCBodyStyle.Cnt_u08 /end MEASUREMENT
/begin MEASUREMENT SrlComInput.VCCountry.Cnt_u08 "MICROSAR RTE" UBYTE NO_COMPU_METHOD 0 0 0 255 ECU_ADDRESS 0 SYMBOL_LINK "Rte_SrlComInput_VCCountry_Cnt_u08" 0 DISPLAY_IDENTIFIER SrlComInput.SenderPorts.VCCountry.Cnt_u08 /end MEASUREMENT
/begin MEASUREMENT SrlComInput.VCModelYear.Cnt_u08 "MICROSAR RTE" UBYTE NO_COMPU_METHOD 0 0 0 255 ECU_ADDRESS 0 SYMBOL_LINK "Rte_SrlComInput_VCModelYear_Cnt_u08" 0 DISPLAY_IDENTIFIER SrlComInput.SenderPorts.VCModelYear.Cnt_u08 /end MEASUREMENT
/begin MEASUREMENT SrlComInput.VCVehLine.Cnt_u08 "MICROSAR RTE" UBYTE NO_COMPU_METHOD 0 0 0 255 ECU_ADDRESS 0 SYMBOL_LINK "Rte_SrlComInput_VCVehLine_Cnt_u08" 0 DISPLAY_IDENTIFIER SrlComInput.SenderPorts.VCVehLine.Cnt_u08 /end MEASUREMENT
/begin MEASUREMENT SrlComOutput.ATermActive.Cnt_lgc "MICROSAR RTE" UBYTE RTE_CM_BOOLEAN 0 0 0 255 ECU_ADDRESS 0 SYMBOL_LINK "Rte_VehPwrMd_ATermActive_Cnt_lgc" 0 DISPLAY_IDENTIFIER SrlComOutput.ReceiverPorts.ATermActive.Cnt_lgc /end MEASUREMENT
/begin MEASUREMENT SrlComOutput.ActiveFunctionBits.Cnt_u08 "MICROSAR RTE" UBYTE NO_COMPU_METHOD 0 0 0 255 ECU_ADDRESS 0 SYMBOL_LINK "Rte_Ap_ArbLmt_ActiveFunctionBits_Cnt_u08" 0 DISPLAY_IDENTIFIER SrlComOutput.ReceiverPorts.ActiveFunctionBits.Cnt_u08 /end MEASUREMENT
/begin MEASUREMENT SrlComOutput.ActiveTunSet.Cnt_u16 "MICROSAR RTE" UWORD NO_COMPU_METHOD 0 0 0 65535 ECU_ADDRESS 0 SYMBOL_LINK "Rte_Ap_TuningSelAuth_ActiveTunSet_Cnt_u16" 0 DISPLAY_IDENTIFIER SrlComOutput.ReceiverPorts.ActiveTunSet.Cnt_u16 /end MEASUREMENT
/begin MEASUREMENT SrlComOutput.CFG_STAT_RQ.Cnt_u08 "MICROSAR RTE" UBYTE NO_COMPU_METHOD 0 0 0 255 ECU_ADDRESS 0 SYMBOL_LINK "Rte_SrlComInput_CfgStatRQ_Cnt_u08" 0 DISPLAY_IDENTIFIER SrlComOutput.ReceiverPorts.CFG_STAT_RQ.Cnt_u08 /end MEASUREMENT
/begin MEASUREMENT SrlComOutput.CRFMtrTrqCmd.MtrNm_f32 "MICROSAR RTE" FLOAT32_IEEE NO_COMPU_METHOD 0 0 1.175494351e-38 3.402823466e+38 ECU_ADDRESS 0 SYMBOL_LINK "Rte_CtrldDisShtdn_CntDisMtrTrqCmdCRF_MtrNm_f32" 0 DISPLAY_IDENTIFIER SrlComOutput.ReceiverPorts.CRFMtrTrqCmd.MtrNm_f32 /end MEASUREMENT
/begin MEASUREMENT SrlComOutput.CTermActive.Cnt_lgc "MICROSAR RTE" UBYTE RTE_CM_BOOLEAN 0 0 0 255 ECU_ADDRESS 0 SYMBOL_LINK "Rte_VehPwrMd_CTermActive_Cnt_lgc" 0 DISPLAY_IDENTIFIER SrlComOutput.ReceiverPorts.CTermActive.Cnt_lgc /end MEASUREMENT
/begin MEASUREMENT SrlComOutput.CanMsgReceived.Cnt_lgc "MICROSAR RTE" UBYTE RTE_CM_BOOLEAN 0 0 0 255 ECU_ADDRESS 0 SYMBOL_LINK "Rte_SrlComInput_CanMsgReceived_Cnt_lgc" 0 DISPLAY_IDENTIFIER SrlComOutput.ReceiverPorts.CanMsgReceived.Cnt_lgc /end MEASUREMENT
/begin MEASUREMENT SrlComOutput.DSTEOLDisable.Cnt_lgc "MICROSAR RTE" UBYTE RTE_CM_BOOLEAN 0 0 0 255 ECU_ADDRESS 0 SYMBOL_LINK "Rte_SrlComInput_DSTEOLDisable_Cnt_lgc" 0 DISPLAY_IDENTIFIER SrlComOutput.ReceiverPorts.DSTEOLDisable.Cnt_lgc /end MEASUREMENT
/begin MEASUREMENT SrlComOutput.DSTExtSystemFltActive.Cnt_lgc "MICROSAR RTE" UBYTE RTE_CM_BOOLEAN 0 0 0 255 ECU_ADDRESS 0 SYMBOL_LINK "Rte_SrlComInput_DSTExtSystemFltActive_Cnt_lgc" 0 DISPLAY_IDENTIFIER SrlComOutput.ReceiverPorts.DSTExtSystemFltActive.Cnt_lgc /end MEASUREMENT
/begin MEASUREMENT SrlComOutput.DSTState.Cnt_u08 "MICROSAR RTE" UBYTE NO_COMPU_METHOD 0 0 0 255 ECU_ADDRESS 0 SYMBOL_LINK "Rte_Ap_StbCTO_DSTState_Cnt_u08" 0 DISPLAY_IDENTIFIER SrlComOutput.ReceiverPorts.DSTState.Cnt_u08 /end MEASUREMENT
/begin MEASUREMENT SrlComOutput.DesiredTunPers.Cnt_u16 "MICROSAR RTE" UWORD NO_COMPU_METHOD 0 0 0 65535 ECU_ADDRESS 0 SYMBOL_LINK "Rte_SrlComInput_DesiredTunPers_Cnt_u16" 0 DISPLAY_IDENTIFIER SrlComOutput.ReceiverPorts.DesiredTunPers.Cnt_u16 /end MEASUREMENT
/begin MEASUREMENT SrlComOutput.DesiredTunPersTypH.Cnt_u08 "MICROSAR RTE" UBYTE NO_COMPU_METHOD 0 0 0 255 ECU_ADDRESS 0 SYMBOL_LINK "Rte_SrlComInput_DesiredTunPersTypH_Cnt_u08" 0 DISPLAY_IDENTIFIER SrlComOutput.ReceiverPorts.DesiredTunPersTypH.Cnt_u08 /end MEASUREMENT
/begin MEASUREMENT SrlComOutput.DiagStsNonRecRmpToZeroFltPres.Cnt_lgc "MICROSAR RTE" UBYTE RTE_CM_BOOLEAN 0 0 0 255 ECU_ADDRESS 0 SYMBOL_LINK "Rte_DiagMgr_DiagStsNonRecRmpToZeroFltPres_Cnt_lgc" 0 DISPLAY_IDENTIFIER SrlComOutput.ReceiverPorts.DiagStsNonRecRmpToZeroFltPres.Cnt_lgc /end MEASUREMENT
/begin MEASUREMENT SrlComOutput.DiagStsRecRmpToZeroFltPres.Cnt_lgc "MICROSAR RTE" UBYTE RTE_CM_BOOLEAN 0 0 0 255 ECU_ADDRESS 0 SYMBOL_LINK "Rte_DiagMgr_DiagStsRecRmpToZeroFltPres_Cnt_lgc" 0 DISPLAY_IDENTIFIER SrlComOutput.ReceiverPorts.DiagStsRecRmpToZeroFltPres.Cnt_lgc /end MEASUREMENT
/begin MEASUREMENT SrlComOutput.EPS_MODE_REQ.Cnt_u08 "MICROSAR RTE" UBYTE NO_COMPU_METHOD 0 0 0 255 ECU_ADDRESS 0 SYMBOL_LINK "Rte_SrlComInput_EPS_Mode_Req_Cnt_u08" 0 DISPLAY_IDENTIFIER SrlComOutput.ReceiverPorts.EPS_MODE_REQ.Cnt_u08 /end MEASUREMENT
/begin MEASUREMENT SrlComOutput.EngRPM.Cnt_u16 "MICROSAR RTE" UWORD NO_COMPU_METHOD 0 0 0 65535 ECU_ADDRESS 0 SYMBOL_LINK "Rte_SrlComInput_EngRPM_Cnt_u16" 0 DISPLAY_IDENTIFIER SrlComOutput.ReceiverPorts.EngRPM.Cnt_u16 /end MEASUREMENT
/begin MEASUREMENT SrlComOutput.HaLFState.Cnt_u08 "MICROSAR RTE" UBYTE NO_COMPU_METHOD 0 0 0 255 ECU_ADDRESS 0 SYMBOL_LINK "Rte_Ap_HaLFTO_HaLFState_Cnt_u08" 0 DISPLAY_IDENTIFIER SrlComOutput.ReceiverPorts.HaLFState.Cnt_u08 /end MEASUREMENT
/begin MEASUREMENT SrlComOutput.HaLFSuspend.Cnt_lgc "MICROSAR RTE" UBYTE RTE_CM_BOOLEAN 0 0 0 255 ECU_ADDRESS 0 SYMBOL_LINK "Rte_Ap_HaLFTO_HaLFSuspend_Cnt_lgc" 0 DISPLAY_IDENTIFIER SrlComOutput.ReceiverPorts.HaLFSuspend.Cnt_lgc /end MEASUREMENT
/begin MEASUREMENT SrlComOutput.HandsOnDetect.Cnt_lgc "MICROSAR RTE" UBYTE RTE_CM_BOOLEAN 0 0 0 255 ECU_ADDRESS 0 SYMBOL_LINK "Rte_Ap_PAwTO_HandsOnDetect_Cnt_lgc" 0 DISPLAY_IDENTIFIER SrlComOutput.ReceiverPorts.HandsOnDetect.Cnt_lgc /end MEASUREMENT
/begin MEASUREMENT SrlComOutput.HwTrq.HwNm_f32 "MICROSAR RTE" FLOAT32_IEEE NO_COMPU_METHOD 0 0 1.175494351e-38 3.402823466e+38 ECU_ADDRESS 0 SYMBOL_LINK "Rte_HwTrq_AnaHwTorque_HwNm_f32" 0 DISPLAY_IDENTIFIER SrlComOutput.ReceiverPorts.HwTrq.HwNm_f32 /end MEASUREMENT
/begin MEASUREMENT SrlComOutput.PrkAssistState.Cnt_u08 "MICROSAR RTE" UBYTE NO_COMPU_METHOD 0 0 0 255 ECU_ADDRESS 0 SYMBOL_LINK "Rte_Ap_PAwTO_PrkAssistState_Cnt_u08" 0 DISPLAY_IDENTIFIER SrlComOutput.ReceiverPorts.PrkAssistState.Cnt_u08 /end MEASUREMENT
/begin MEASUREMENT SrlComOutput.PrkAssistSuspend.Cnt_lgc "MICROSAR RTE" UBYTE RTE_CM_BOOLEAN 0 0 0 255 ECU_ADDRESS 0 SYMBOL_LINK "Rte_Ap_PAwTO_PrkAssistSuspend_Cnt_lgc" 0 DISPLAY_IDENTIFIER SrlComOutput.ReceiverPorts.PrkAssistSuspend.Cnt_lgc /end MEASUREMENT
/begin MEASUREMENT SrlComOutput.RampDwnStatusComplete.Cnt_lgc "MICROSAR RTE" UBYTE RTE_CM_BOOLEAN 0 0 0 255 ECU_ADDRESS 0 SYMBOL_LINK "Rte_StOpCtrl_RampDwnStatusComplete_Cnt_lgc" 0 DISPLAY_IDENTIFIER SrlComOutput.ReceiverPorts.RampDwnStatusComplete.Cnt_lgc /end MEASUREMENT
/begin MEASUREMENT SrlComOutput.SpStPrsnt.Cnt_lgc "MICROSAR RTE" UBYTE RTE_CM_BOOLEAN 0 0 0 255 ECU_ADDRESS 0 SYMBOL_LINK "Rte_SrlComInput_SpStPrsnt_Cnt_lgc" 0 DISPLAY_IDENTIFIER SrlComOutput.ReceiverPorts.SpStPrsnt.Cnt_lgc /end MEASUREMENT
/begin MEASUREMENT SrlComOutput.SrlComHwTrqValid.Cnt_lgc "MICROSAR RTE" UBYTE RTE_CM_BOOLEAN 0 0 0 255 ECU_ADDRESS 0 SYMBOL_LINK "Rte_HwTrq_SrlComHwTrqValid_Cnt_lgc" 0 DISPLAY_IDENTIFIER SrlComOutput.ReceiverPorts.SrlComHwTrqValid.Cnt_lgc /end MEASUREMENT
/begin MEASUREMENT SrlComOutput.SrlComVehSpdValid.Cnt_lgc "MICROSAR RTE" UBYTE RTE_CM_BOOLEAN 0 0 0 255 ECU_ADDRESS 0 SYMBOL_LINK "Rte_SrlComInput_SrlComVehSpdValid_Cnt_lgc" 0 DISPLAY_IDENTIFIER SrlComOutput.ReceiverPorts.SrlComVehSpdValid.Cnt_lgc /end MEASUREMENT
/begin MEASUREMENT SrlComOutput.SumLmtTrqCmd.MtrNm_f32 "MICROSAR RTE" FLOAT32_IEEE NO_COMPU_METHOD 0 0 1.175494351e-38 3.402823466e+38 ECU_ADDRESS 0 SYMBOL_LINK "Rte_Ap_AstLmt_SumLimTrqCmd_MtrNm_f32" 0 DISPLAY_IDENTIFIER SrlComOutput.ReceiverPorts.SumLmtTrqCmd.MtrNm_f32 /end MEASUREMENT
/begin MEASUREMENT SrlComOutput.SupplyCurrent.Amp_f32 "MICROSAR RTE" FLOAT32_IEEE NO_COMPU_METHOD 0 0 1.175494351e-38 3.402823466e+38 ECU_ADDRESS 0 SYMBOL_LINK "Rte_Ap_ElePwr_SupplyCurrent_Amp_f32" 0 DISPLAY_IDENTIFIER SrlComOutput.ReceiverPorts.SupplyCurrent.Amp_f32 /end MEASUREMENT
/begin MEASUREMENT SrlComOutput.SystemState.Mode "MICROSAR RTE" UBYTE RTE_CM_ENUM_StaMd_Mode 0 0 0 255 ECU_ADDRESS 0 SYMBOL_LINK "Rte_ModeMachine_Ap_StaMd9_SystemState9_Mode" 0 DISPLAY_IDENTIFIER SrlComOutput.ModeRequirePorts.SystemState.Mode /end MEASUREMENT
/begin MEASUREMENT SrlComOutput.VehicleSpeed.Kph_f32 "MICROSAR RTE" FLOAT32_IEEE NO_COMPU_METHOD 0 0 1.175494351e-38 3.402823466e+38 ECU_ADDRESS 0 SYMBOL_LINK "Rte_Ap_SignlCondn_VehicleSpeed_Kph_f32" 0 DISPLAY_IDENTIFIER SrlComOutput.ReceiverPorts.VehicleSpeed.Kph_f32 /end MEASUREMENT
/begin MEASUREMENT StOpCtrl.DiagRampRate.XpmS_f32 "MICROSAR RTE" FLOAT32_IEEE NO_COMPU_METHOD 0 0 1.175494351e-38 3.402823466e+38 ECU_ADDRESS 0 SYMBOL_LINK "Rte_DiagMgr_DiagRampRate_XpmS_f32" 0 DISPLAY_IDENTIFIER StOpCtrl.ReceiverPorts.DiagRampRate.XpmS_f32 /end MEASUREMENT
/begin MEASUREMENT StOpCtrl.DiagRampValue.Uls_f32 "MICROSAR RTE" FLOAT32_IEEE NO_COMPU_METHOD 0 0 1.175494351e-38 3.402823466e+38 ECU_ADDRESS 0 SYMBOL_LINK "Rte_DiagMgr_DiagRampValue_Uls_f32" 0 DISPLAY_IDENTIFIER StOpCtrl.ReceiverPorts.DiagRampValue.Uls_f32 /end MEASUREMENT
/begin MEASUREMENT StOpCtrl.DiagStsDiagRmpActive.Cnt_lgc "MICROSAR RTE" UBYTE RTE_CM_BOOLEAN 0 0 0 255 ECU_ADDRESS 0 SYMBOL_LINK "Rte_DiagMgr_DiagRmpToZeroActive_Cnt_lgc" 0 DISPLAY_IDENTIFIER StOpCtrl.ReceiverPorts.DiagStsDiagRmpActive.Cnt_lgc /end MEASUREMENT
/begin MEASUREMENT StOpCtrl.OperRampRate.XpmS_f32 "MICROSAR RTE" FLOAT32_IEEE NO_COMPU_METHOD 0 0 1.175494351e-38 3.402823466e+38 ECU_ADDRESS 0 SYMBOL_LINK "Rte_VehPwrMd_OperRampRate_XpmS_f32" 0 DISPLAY_IDENTIFIER StOpCtrl.ReceiverPorts.OperRampRate.XpmS_f32 /end MEASUREMENT
/begin MEASUREMENT StOpCtrl.OperRampValue.Uls_f32 "MICROSAR RTE" FLOAT32_IEEE NO_COMPU_METHOD 0 0 1.175494351e-38 3.402823466e+38 ECU_ADDRESS 0 SYMBOL_LINK "Rte_VehPwrMd_OperRampValue_Uls_f32" 0 DISPLAY_IDENTIFIER StOpCtrl.ReceiverPorts.OperRampValue.Uls_f32 /end MEASUREMENT
/begin MEASUREMENT StOpCtrl.OutputRampMult.Uls_f32 "MICROSAR RTE" FLOAT32_IEEE NO_COMPU_METHOD 0 0 1.175494351e-38 3.402823466e+38 ECU_ADDRESS 0 SYMBOL_LINK "Rte_StOpCtrl_OutputRampMult_Uls_f32" 0 DISPLAY_IDENTIFIER StOpCtrl.SenderPorts.OutputRampMult.Uls_f32 /end MEASUREMENT
/begin MEASUREMENT StOpCtrl.RampDwnStatusComplete.Cnt_lgc "MICROSAR RTE" UBYTE RTE_CM_BOOLEAN 0 0 0 255 ECU_ADDRESS 0 SYMBOL_LINK "Rte_StOpCtrl_RampDwnStatusComplete_Cnt_lgc" 0 DISPLAY_IDENTIFIER StOpCtrl.SenderPorts.RampDwnStatusComplete.Cnt_lgc /end MEASUREMENT
/begin MEASUREMENT StOpCtrl.RampSrlComSvcDft.Cnt_lgc "MICROSAR RTE" UBYTE RTE_CM_BOOLEAN 0 0 0 255 ECU_ADDRESS 0 SYMBOL_LINK "Rte_CDDInterface_TrqRmpSrlComSvcDft_Cnt_lgc" 0 DISPLAY_IDENTIFIER StOpCtrl.ReceiverPorts.RampSrlComSvcDft.Cnt_lgc /end MEASUREMENT
/begin MEASUREMENT StaMd.ATerm.Cnt_lgc "MICROSAR RTE" UBYTE RTE_CM_BOOLEAN 0 0 0 255 ECU_ADDRESS 0 SYMBOL_LINK "Rte_VehPwrMd_ATermActive_Cnt_lgc" 0 DISPLAY_IDENTIFIER StaMd.ReceiverPorts.ATerm.Cnt_lgc /end MEASUREMENT
/begin MEASUREMENT StaMd.CTerm.Cnt_lgc "MICROSAR RTE" UBYTE RTE_CM_BOOLEAN 0 0 0 255 ECU_ADDRESS 0 SYMBOL_LINK "Rte_VehPwrMd_CTermActive_Cnt_lgc" 0 DISPLAY_IDENTIFIER StaMd.ReceiverPorts.CTerm.Cnt_lgc /end MEASUREMENT
/begin MEASUREMENT StaMd.ControlledDampStatusComplete.Cnt_lgc "MICROSAR RTE" UBYTE RTE_CM_BOOLEAN 0 0 0 255 ECU_ADDRESS 0 SYMBOL_LINK "Rte_CtrldDisShtdn_CtrldDmpStsCmp_Cnt_lgc" 0 DISPLAY_IDENTIFIER StaMd.ReceiverPorts.ControlledDampStatusComplete.Cnt_lgc /end MEASUREMENT
/begin MEASUREMENT StaMd.CurrentSystemState.Mode "MICROSAR RTE" UBYTE RTE_CM_ENUM_StaMd_Mode 0 0 0 255 ECU_ADDRESS 0 SYMBOL_LINK "Rte_ModeMachine_StaMd_SystemState_Mode" 0 DISPLAY_IDENTIFIER StaMd.ModeRequirePorts.CurrentSystemState.Mode /end MEASUREMENT
/begin MEASUREMENT StaMd.FTerm.Cnt_lgc "MICROSAR RTE" UBYTE RTE_CM_BOOLEAN 0 0 0 255 ECU_ADDRESS 0 SYMBOL_LINK "Rte_DiagMgr_DiagRmpToZeroActive_Cnt_lgc" 0 DISPLAY_IDENTIFIER StaMd.ReceiverPorts.FTerm.Cnt_lgc /end MEASUREMENT
/begin MEASUREMENT StaMd.RampStatusComplete.Cnt_lgc "MICROSAR RTE" UBYTE RTE_CM_BOOLEAN 0 0 0 255 ECU_ADDRESS 0 SYMBOL_LINK "Rte_StOpCtrl_RampDwnStatusComplete_Cnt_lgc" 0 DISPLAY_IDENTIFIER StaMd.ReceiverPorts.RampStatusComplete.Cnt_lgc /end MEASUREMENT
/begin MEASUREMENT StaMd.SystemState.Mode "MICROSAR RTE" UBYTE RTE_CM_ENUM_StaMd_Mode 0 0 0 255 ECU_ADDRESS 0 SYMBOL_LINK "Rte_ModeMachine_StaMd_SystemState_Mode" 0 DISPLAY_IDENTIFIER StaMd.ModeProvidePorts.SystemState.Mode /end MEASUREMENT
/begin MEASUREMENT StaMd.TMFTestComplete.Cnt_lgc "MICROSAR RTE" UBYTE RTE_CM_BOOLEAN 0 0 0 255 ECU_ADDRESS 0 SYMBOL_LINK "Rte_TmprlMon_TMFTestComplete_Cnt_lgc" 0 DISPLAY_IDENTIFIER StaMd.ReceiverPorts.TMFTestComplete.Cnt_lgc /end MEASUREMENT
/begin MEASUREMENT StabilityComp.AssistCmd.MtrNm_f32 "MICROSAR RTE" FLOAT32_IEEE NO_COMPU_METHOD 0 0 1.175494351e-38 3.402823466e+38 ECU_ADDRESS 0 SYMBOL_LINK "Rte_StabilityComp_AssistCmd_MtrNm_f32" 0 DISPLAY_IDENTIFIER StabilityComp.SenderPorts.AssistCmd.MtrNm_f32 /end MEASUREMENT
/begin MEASUREMENT StabilityComp.AssistDDFactor.Uls_f32 "MICROSAR RTE" FLOAT32_IEEE NO_COMPU_METHOD 0 0 1.175494351e-38 3.402823466e+38 ECU_ADDRESS 0 SYMBOL_LINK "Rte_StabilityComp_AssistDDFactor_Uls_f32" 0 DISPLAY_IDENTIFIER StabilityComp.ReceiverPorts.AssistDDFactor.Uls_f32 /end MEASUREMENT
/begin MEASUREMENT StabilityComp.AsstFWActive.Uls_f32 "MICROSAR RTE" FLOAT32_IEEE NO_COMPU_METHOD 0 0 1.175494351e-38 3.402823466e+38 ECU_ADDRESS 0 SYMBOL_LINK "Rte_Ap_AssistFirewall_AsstFirewallActive_Uls_f32" 0 DISPLAY_IDENTIFIER StabilityComp.ReceiverPorts.AsstFWActive.Uls_f32 /end MEASUREMENT
/begin MEASUREMENT StabilityComp.CombinedAssist.MtrNm_f32 "MICROSAR RTE" FLOAT32_IEEE NO_COMPU_METHOD 0 0 1.175494351e-38 3.402823466e+38 ECU_ADDRESS 0 SYMBOL_LINK "Rte_Ap_AssistFirewall_CombinedAssist_MtrNm_f32" 0 DISPLAY_IDENTIFIER StabilityComp.ReceiverPorts.CombinedAssist.MtrNm_f32 /end MEASUREMENT
/begin MEASUREMENT StabilityComp.HwTorque.HwNm_f32 "MICROSAR RTE" FLOAT32_IEEE NO_COMPU_METHOD 0 0 1.175494351e-38 3.402823466e+38 ECU_ADDRESS 0 SYMBOL_LINK "Rte_HwTrq_AnaHwTorque_HwNm_f32" 0 DISPLAY_IDENTIFIER StabilityComp.ReceiverPorts.HwTorque.HwNm_f32 /end MEASUREMENT
/begin MEASUREMENT StabilityComp.SysAssistCmd_MtrNm.MtrNm_f32 "MICROSAR RTE" FLOAT32_IEEE NO_COMPU_METHOD 0 0 1.175494351e-38 3.402823466e+38 ECU_ADDRESS 0 SYMBOL_LINK "Rte_Ap_StabilityComp2_SysAssistCmd_MtrNm_f32" 0 DISPLAY_IDENTIFIER StabilityComp.ReceiverPorts.SysAssistCmd_MtrNm.MtrNm_f32 /end MEASUREMENT
/begin MEASUREMENT StabilityComp.VehicleSpeed.Kph_f32 "MICROSAR RTE" FLOAT32_IEEE NO_COMPU_METHOD 0 0 1.175494351e-38 3.402823466e+38 ECU_ADDRESS 0 SYMBOL_LINK "Rte_Ap_SignlCondn_VehicleSpeed_Kph_f32" 0 DISPLAY_IDENTIFIER StabilityComp.ReceiverPorts.VehicleSpeed.Kph_f32 /end MEASUREMENT
/begin MEASUREMENT TmprlMon.SystemState.Mode "MICROSAR RTE" UBYTE RTE_CM_ENUM_StaMd_Mode 0 0 0 255 ECU_ADDRESS 0 SYMBOL_LINK "Rte_ModeMachine_StaMd_SystemState_Mode" 0 DISPLAY_IDENTIFIER TmprlMon.ModeRequirePorts.SystemState.Mode /end MEASUREMENT
/begin MEASUREMENT TmprlMon.TMFTestComplete.Cnt_lgc "MICROSAR RTE" UBYTE RTE_CM_BOOLEAN 0 0 0 255 ECU_ADDRESS 0 SYMBOL_LINK "Rte_TmprlMon_TMFTestComplete_Cnt_lgc" 0 DISPLAY_IDENTIFIER TmprlMon.SenderPorts.TMFTestComplete.Cnt_lgc /end MEASUREMENT
/begin MEASUREMENT TmprlMon.TMFTestStart.Cnt_lgc "MICROSAR RTE" UBYTE RTE_CM_BOOLEAN 0 0 0 255 ECU_ADDRESS 0 SYMBOL_LINK "Rte_Ap_HwPwUp_TMFTestStart_Cnt_lgc" 0 DISPLAY_IDENTIFIER TmprlMon.ReceiverPorts.TMFTestStart.Cnt_lgc /end MEASUREMENT
/begin MEASUREMENT TrqCmdScl.MRFMtrTrqCmd.MtrNm_f32 "MICROSAR RTE" FLOAT32_IEEE NO_COMPU_METHOD 0 0 1.175494351e-38 3.402823466e+38 ECU_ADDRESS 0 SYMBOL_LINK "Rte_Ap_PwrLmtFuncCr_MRFMtrTrqCmd_MtrNm_f32" 0 DISPLAY_IDENTIFIER TrqCmdScl.ReceiverPorts.MRFMtrTrqCmd.MtrNm_f32 /end MEASUREMENT
/begin MEASUREMENT TrqCmdScl.MRFMtrTrqCmdScl.MtrNm_f32 "MICROSAR RTE" FLOAT32_IEEE NO_COMPU_METHOD 0 0 1.175494351e-38 3.402823466e+38 ECU_ADDRESS 0 SYMBOL_LINK "Rte_TrqCmdScl_MRFMtrTrqCmdScl_MtrNm_f32" 0 DISPLAY_IDENTIFIER TrqCmdScl.SenderPorts.MRFMtrTrqCmdScl.MtrNm_f32 /end MEASUREMENT
/begin MEASUREMENT TrqCmdScl.TorqueCmdSF_Uls_f32 "MICROSAR RTE" FLOAT32_IEEE NO_COMPU_METHOD 0 0 1.175494351e-38 3.402823466e+38 ECU_ADDRESS 0 SYMBOL_LINK "Rte_TrqCmdScl_TorqueCmdSF_Uls_f32" 0 DISPLAY_IDENTIFIER TrqCmdScl.PerInstanceMemories.TorqueCmdSF_Uls_f32 READ_WRITE /end MEASUREMENT
/begin MEASUREMENT VehPwrMd.ATermActive.Cnt_lgc "MICROSAR RTE" UBYTE RTE_CM_BOOLEAN 0 0 0 255 ECU_ADDRESS 0 SYMBOL_LINK "Rte_VehPwrMd_ATermActive_Cnt_lgc" 0 DISPLAY_IDENTIFIER VehPwrMd.SenderPorts.ATermActive.Cnt_lgc /end MEASUREMENT
/begin MEASUREMENT VehPwrMd.CTermActive.Cnt_lgc "MICROSAR RTE" UBYTE RTE_CM_BOOLEAN 0 0 0 255 ECU_ADDRESS 0 SYMBOL_LINK "Rte_VehPwrMd_CTermActive_Cnt_lgc" 0 DISPLAY_IDENTIFIER VehPwrMd.SenderPorts.CTermActive.Cnt_lgc /end MEASUREMENT
/begin MEASUREMENT VehPwrMd.DefaultVehSpd.Cnt_lgc "MICROSAR RTE" UBYTE RTE_CM_BOOLEAN 0 0 0 255 ECU_ADDRESS 0 SYMBOL_LINK "Rte_DiagMgr_DiagStsDefVehSpd_Cnt_lgc" 0 DISPLAY_IDENTIFIER VehPwrMd.ReceiverPorts.DefaultVehSpd.Cnt_lgc /end MEASUREMENT
/begin MEASUREMENT VehPwrMd.EngONSrlComSvcDft.Cnt_lgc "MICROSAR RTE" UBYTE RTE_CM_BOOLEAN 0 0 0 255 ECU_ADDRESS 0 SYMBOL_LINK "Rte_CDDInterface_EngONSrlComSvcDft_Cnt_lgc" 0 DISPLAY_IDENTIFIER VehPwrMd.ReceiverPorts.EngONSrlComSvcDft.Cnt_lgc /end MEASUREMENT
/begin MEASUREMENT VehPwrMd.EngRPM.Cnt_u16 "MICROSAR RTE" UWORD NO_COMPU_METHOD 0 0 0 65535 ECU_ADDRESS 0 SYMBOL_LINK "Rte_SrlComInput_EngRPM_Cnt_u16" 0 DISPLAY_IDENTIFIER VehPwrMd.ReceiverPorts.EngRPM.Cnt_u16 /end MEASUREMENT
/begin MEASUREMENT VehPwrMd.EssEngStop.Cnt_lgc "MICROSAR RTE" UBYTE RTE_CM_BOOLEAN 0 0 0 255 ECU_ADDRESS 0 SYMBOL_LINK "Rte_SrlComInput_EssEngStop_Cnt_lgc" 0 DISPLAY_IDENTIFIER VehPwrMd.ReceiverPorts.EssEngStop.Cnt_lgc /end MEASUREMENT
/begin MEASUREMENT VehPwrMd.OperRampRate.XpmS_f32 "MICROSAR RTE" FLOAT32_IEEE NO_COMPU_METHOD 0 0 1.175494351e-38 3.402823466e+38 ECU_ADDRESS 0 SYMBOL_LINK "Rte_VehPwrMd_OperRampRate_XpmS_f32" 0 DISPLAY_IDENTIFIER VehPwrMd.SenderPorts.OperRampRate.XpmS_f32 /end MEASUREMENT
/begin MEASUREMENT VehPwrMd.OperRampValue.Uls_f32 "MICROSAR RTE" FLOAT32_IEEE NO_COMPU_METHOD 0 0 1.175494351e-38 3.402823466e+38 ECU_ADDRESS 0 SYMBOL_LINK "Rte_VehPwrMd_OperRampValue_Uls_f32" 0 DISPLAY_IDENTIFIER VehPwrMd.SenderPorts.OperRampValue.Uls_f32 /end MEASUREMENT
/begin MEASUREMENT VehPwrMd.SpStPrsnt.Cnt_lgc "MICROSAR RTE" UBYTE RTE_CM_BOOLEAN 0 0 0 255 ECU_ADDRESS 0 SYMBOL_LINK "Rte_SrlComInput_SpStPrsnt_Cnt_lgc" 0 DISPLAY_IDENTIFIER VehPwrMd.ReceiverPorts.SpStPrsnt.Cnt_lgc /end MEASUREMENT
/begin MEASUREMENT VehPwrMd.VehSpd.Kph_f32 "MICROSAR RTE" FLOAT32_IEEE NO_COMPU_METHOD 0 0 1.175494351e-38 3.402823466e+38 ECU_ADDRESS 0 SYMBOL_LINK "Rte_SrlComInput_SrlComVehSpd_Kph_f32" 0 DISPLAY_IDENTIFIER VehPwrMd.ReceiverPorts.VehSpd.Kph_f32 /end MEASUREMENT
/begin MEASUREMENT VehPwrMd.VehSpdValid.Cnt_lgc "MICROSAR RTE" UBYTE RTE_CM_BOOLEAN 0 0 0 255 ECU_ADDRESS 0 SYMBOL_LINK "Rte_SrlComInput_SrlComVehSpdValid_Cnt_lgc" 0 DISPLAY_IDENTIFIER VehPwrMd.ReceiverPorts.VehSpdValid.Cnt_lgc /end MEASUREMENT
/begin MEASUREMENT VehSpdLmt.AstVehSpdLimit.MtrNm_f32 "MICROSAR RTE" FLOAT32_IEEE NO_COMPU_METHOD 0 0 1.175494351e-38 3.402823466e+38 ECU_ADDRESS 0 SYMBOL_LINK "Rte_VehSpdLmt_AstVehSpdLimit_MtrNm_f32" 0 DISPLAY_IDENTIFIER VehSpdLmt.SenderPorts.AstVehSpdLimit.MtrNm_f32 /end MEASUREMENT
/begin MEASUREMENT VehSpdLmt.CCWPosition.HwDeg_f32 "MICROSAR RTE" FLOAT32_IEEE NO_COMPU_METHOD 0 0 1.175494351e-38 3.402823466e+38 ECU_ADDRESS 0 SYMBOL_LINK "Rte_Ap_LrnEOT_CCWPosition_HwDeg_f32" 0 DISPLAY_IDENTIFIER VehSpdLmt.ReceiverPorts.CCWPosition.HwDeg_f32 /end MEASUREMENT
/begin MEASUREMENT VehSpdLmt.CWPosition.HwDeg_f32 "MICROSAR RTE" FLOAT32_IEEE NO_COMPU_METHOD 0 0 1.175494351e-38 3.402823466e+38 ECU_ADDRESS 0 SYMBOL_LINK "Rte_Ap_LrnEOT_CWPosition_HwDeg_f32" 0 DISPLAY_IDENTIFIER VehSpdLmt.ReceiverPorts.CWPosition.HwDeg_f32 /end MEASUREMENT
/begin MEASUREMENT VehSpdLmt.HwPos.HwDeg_f32 "MICROSAR RTE" FLOAT32_IEEE NO_COMPU_METHOD 0 0 1.175494351e-38 3.402823466e+38 ECU_ADDRESS 0 SYMBOL_LINK "Rte_Ap_AbsHwPosScom_HwPos_HwDeg_f32" 0 DISPLAY_IDENTIFIER VehSpdLmt.ReceiverPorts.HwPos.HwDeg_f32 /end MEASUREMENT
/begin MEASUREMENT VehSpdLmt.HwPosAuth.Uls_f32 "MICROSAR RTE" FLOAT32_IEEE NO_COMPU_METHOD 0 0 1.175494351e-38 3.402823466e+38 ECU_ADDRESS 0 SYMBOL_LINK "Rte_Ap_AbsHwPosScom_HwPosAuthority_Uls_f32" 0 DISPLAY_IDENTIFIER VehSpdLmt.ReceiverPorts.HwPosAuth.Uls_f32 /end MEASUREMENT
/begin MEASUREMENT VehSpdLmt.VehSpd.Kph_f32 "MICROSAR RTE" FLOAT32_IEEE NO_COMPU_METHOD 0 0 1.175494351e-38 3.402823466e+38 ECU_ADDRESS 0 SYMBOL_LINK "Rte_Ap_SignlCondn_VehicleSpeed_Kph_f32" 0 DISPLAY_IDENTIFIER VehSpdLmt.ReceiverPorts.VehSpd.Kph_f32 /end MEASUREMENT
/begin MEASUREMENT Xcp.ActiveTunOvrPtrAddr.Cnt_u32 "MICROSAR RTE" ULONG NO_COMPU_METHOD 0 0 0 4294967295 ECU_ADDRESS 0 SYMBOL_LINK "Rte_Xcp_ActiveTunOvrPtrAddr_Cnt_u32" 0 DISPLAY_IDENTIFIER Xcp.SenderPorts.ActiveTunOvrPtrAddr.Cnt_u32 /end MEASUREMENT
/begin MEASUREMENT Xcp.ActiveTunPers.Cnt_u16 "MICROSAR RTE" UWORD NO_COMPU_METHOD 0 0 0 65535 ECU_ADDRESS 0 SYMBOL_LINK "Rte_Xcp_ActiveTunPers_Cnt_u16" 0 DISPLAY_IDENTIFIER Xcp.ReceiverPorts.ActiveTunPers.Cnt_u16 /end MEASUREMENT
/begin MEASUREMENT Xcp.ActiveTunSet.Cnt_u16 "MICROSAR RTE" UWORD NO_COMPU_METHOD 0 0 0 65535 ECU_ADDRESS 0 SYMBOL_LINK "Rte_Xcp_ActiveTunSet_Cnt_u16" 0 DISPLAY_IDENTIFIER Xcp.ReceiverPorts.ActiveTunSet.Cnt_u16 /end MEASUREMENT
/begin MEASUREMENT Xcp.DesiredTunPers.Cnt_u16 "MICROSAR RTE" UWORD NO_COMPU_METHOD 0 0 0 65535 ECU_ADDRESS 0 SYMBOL_LINK "Rte_Xcp_DesiredTunPers_Cnt_u16" 0 DISPLAY_IDENTIFIER Xcp.ReceiverPorts.DesiredTunPers.Cnt_u16 /end MEASUREMENT
/begin MEASUREMENT Xcp.DesiredTunSet.Cnt_u16 "MICROSAR RTE" UWORD NO_COMPU_METHOD 0 0 0 65535 ECU_ADDRESS 0 SYMBOL_LINK "Rte_Xcp_DesiredTunSet_Cnt_u16" 0 DISPLAY_IDENTIFIER Xcp.ReceiverPorts.DesiredTunSet.Cnt_u16 /end MEASUREMENT
/begin MEASUREMENT Xcp.TuningSessionActPtr.Cnt_u8 "MICROSAR RTE" UBYTE RTE_CM_ENUM_TuningSessionAddrPtrEnum 0 0 0 255 ECU_ADDRESS 0 SYMBOL_LINK "Rte_Xcp_TuningSessionActPtr_Cnt_u8" 0 DISPLAY_IDENTIFIER Xcp.SenderPorts.TuningSessionActPtr.Cnt_u8 /end MEASUREMENT
/begin GROUP Polarity.AssistAssyPolarity.Cnt_s08 "MICROSAR RTE" /begin SUB_GROUP /end SUB_GROUP /begin FUNCTION_LIST /end FUNCTION_LIST /begin REF_CHARACTERISTIC /end REF_CHARACTERISTIC /begin REF_MEASUREMENT Polarity.AssistAssyPolarity.Cnt_s08 /end REF_MEASUREMENT /end GROUP
/begin GROUP Polarity.DiagAssistAssyPolarity.Cnt_s08 "MICROSAR RTE" /begin SUB_GROUP /end SUB_GROUP /begin FUNCTION_LIST /end FUNCTION_LIST /begin REF_CHARACTERISTIC /end REF_CHARACTERISTIC /begin REF_MEASUREMENT Polarity.DiagAssistAssyPolarity.Cnt_s08 /end REF_MEASUREMENT /end GROUP
/begin GROUP Polarity.DiagHwPosPolarity.Cnt_s08 "MICROSAR RTE" /begin SUB_GROUP /end SUB_GROUP /begin FUNCTION_LIST /end FUNCTION_LIST /begin REF_CHARACTERISTIC /end REF_CHARACTERISTIC /begin REF_MEASUREMENT Polarity.DiagHwPosPolarity.Cnt_s08 /end REF_MEASUREMENT /end GROUP
/begin GROUP Polarity.DiagHwTrqPolarity.Cnt_s08 "MICROSAR RTE" /begin SUB_GROUP /end SUB_GROUP /begin FUNCTION_LIST /end FUNCTION_LIST /begin REF_CHARACTERISTIC /end REF_CHARACTERISTIC /begin REF_MEASUREMENT Polarity.DiagHwTrqPolarity.Cnt_s08 /end REF_MEASUREMENT /end GROUP
/begin GROUP Polarity.DiagMtrElecMechPolarity.Cnt_s08 "MICROSAR RTE" /begin SUB_GROUP /end SUB_GROUP /begin FUNCTION_LIST /end FUNCTION_LIST /begin REF_CHARACTERISTIC /end REF_CHARACTERISTIC /begin REF_MEASUREMENT Polarity.DiagMtrElecMechPolarity.Cnt_s08 /end REF_MEASUREMENT /end GROUP
/begin GROUP Polarity.DiagMtrPosPolarity.Cnt_s08 "MICROSAR RTE" /begin SUB_GROUP /end SUB_GROUP /begin FUNCTION_LIST /end FUNCTION_LIST /begin REF_CHARACTERISTIC /end REF_CHARACTERISTIC /begin REF_MEASUREMENT Polarity.DiagMtrPosPolarity.Cnt_s08 /end REF_MEASUREMENT /end GROUP
/begin GROUP Polarity.DiagMtrVelPolarity.Cnt_s08 "MICROSAR RTE" /begin SUB_GROUP /end SUB_GROUP /begin FUNCTION_LIST /end FUNCTION_LIST /begin REF_CHARACTERISTIC /end REF_CHARACTERISTIC /begin REF_MEASUREMENT Polarity.DiagMtrVelPolarity.Cnt_s08 /end REF_MEASUREMENT /end GROUP
/begin GROUP Polarity.HwPosPolarity.Cnt_s08 "MICROSAR RTE" /begin SUB_GROUP /end SUB_GROUP /begin FUNCTION_LIST /end FUNCTION_LIST /begin REF_CHARACTERISTIC /end REF_CHARACTERISTIC /begin REF_MEASUREMENT Polarity.HwPosPolarity.Cnt_s08 /end REF_MEASUREMENT /end GROUP
/begin GROUP Polarity.HwTrqPolarity.Cnt_s08 "MICROSAR RTE" /begin SUB_GROUP /end SUB_GROUP /begin FUNCTION_LIST /end FUNCTION_LIST /begin REF_CHARACTERISTIC /end REF_CHARACTERISTIC /begin REF_MEASUREMENT Polarity.HwTrqPolarity.Cnt_s08 /end REF_MEASUREMENT /end GROUP
/begin GROUP Polarity.MtrElecMechPolarity.Cnt_s08 "MICROSAR RTE" /begin SUB_GROUP /end SUB_GROUP /begin FUNCTION_LIST /end FUNCTION_LIST /begin REF_CHARACTERISTIC /end REF_CHARACTERISTIC /begin REF_MEASUREMENT Polarity.MtrElecMechPolarity.Cnt_s08 /end REF_MEASUREMENT /end GROUP
/begin GROUP Polarity.MtrPosPolarity.Cnt_s08 "MICROSAR RTE" /begin SUB_GROUP /end SUB_GROUP /begin FUNCTION_LIST /end FUNCTION_LIST /begin REF_CHARACTERISTIC /end REF_CHARACTERISTIC /begin REF_MEASUREMENT Polarity.MtrPosPolarity.Cnt_s08 /end REF_MEASUREMENT /end GROUP
/begin GROUP Polarity.MtrVelPolarity.Cnt_s08 "MICROSAR RTE" /begin SUB_GROUP /end SUB_GROUP /begin FUNCTION_LIST /end FUNCTION_LIST /begin REF_CHARACTERISTIC /end REF_CHARACTERISTIC /begin REF_MEASUREMENT Polarity.MtrVelPolarity.Cnt_s08 /end REF_MEASUREMENT /end GROUP
/begin GROUP Polarity.PerInstanceMemories "MICROSAR RTE" /begin SUB_GROUP Polarity.Polarity_Cnt_Str /end SUB_GROUP /begin FUNCTION_LIST /end FUNCTION_LIST /begin REF_CHARACTERISTIC /end REF_CHARACTERISTIC /begin REF_MEASUREMENT /end REF_MEASUREMENT /end GROUP
/begin GROUP Polarity.Polarity_Cnt_Str "MICROSAR RTE" /begin SUB_GROUP /end SUB_GROUP /begin FUNCTION_LIST /end FUNCTION_LIST /begin REF_CHARACTERISTIC /end REF_CHARACTERISTIC
 /begin REF_MEASUREMENT Polarity.Polarity_Cnt_Str.Polarity_Cnt_b08 Polarity.Polarity_Cnt_Str.R_Polarity_Cnt_b08 /end REF_MEASUREMENT
/end GROUP
/begin GROUP Polarity.ReceiverPorts "MICROSAR RTE"
 /begin SUB_GROUP Polarity.DiagAssistAssyPolarity.Cnt_s08 Polarity.DiagHwPosPolarity.Cnt_s08 Polarity.DiagHwTrqPolarity.Cnt_s08 Polarity.DiagMtrElecMechPolarity.Cnt_s08 Polarity.DiagMtrPosPolarity.Cnt_s08 Polarity.DiagMtrVelPolarity.Cnt_s08 /end SUB_GROUP
 /begin FUNCTION_LIST /end FUNCTION_LIST
 /begin REF_CHARACTERISTIC /end REF_CHARACTERISTIC
 /begin REF_MEASUREMENT /end REF_MEASUREMENT
/end GROUP
/begin GROUP Polarity.SenderPorts "MICROSAR RTE"
 /begin SUB_GROUP Polarity.AssistAssyPolarity.Cnt_s08 Polarity.HwPosPolarity.Cnt_s08 Polarity.HwTrqPolarity.Cnt_s08 Polarity.MtrElecMechPolarity.Cnt_s08 Polarity.MtrPosPolarity.Cnt_s08 Polarity.MtrVelPolarity.Cnt_s08 Polarity.SysC_MtrElecMechPolarity.Cnt_s32 /end SUB_GROUP
 /begin FUNCTION_LIST /end FUNCTION_LIST
 /begin REF_CHARACTERISTIC /end REF_CHARACTERISTIC
 /begin REF_MEASUREMENT /end REF_MEASUREMENT
/end GROUP
/begin GROUP Polarity.SysC_MtrElecMechPolarity.Cnt_s32 "MICROSAR RTE" /begin SUB_GROUP /end SUB_GROUP /begin FUNCTION_LIST /end FUNCTION_LIST /begin REF_CHARACTERISTIC /end REF_CHARACTERISTIC /begin REF_MEASUREMENT Polarity.SysC_MtrElecMechPolarity.Cnt_s32 /end REF_MEASUREMENT /end GROUP
/begin GROUP QuadDet "MICROSAR RTE" /begin SUB_GROUP QuadDet.ReceiverPorts QuadDet.SenderPorts /end SUB_GROUP /begin FUNCTION_LIST /end FUNCTION_LIST /begin REF_CHARACTERISTIC /end REF_CHARACTERISTIC /begin REF_MEASUREMENT /end REF_MEASUREMENT /end GROUP
/begin GROUP QuadDet.InstMtrDir.Cnt_s08 "MICROSAR RTE" /begin SUB_GROUP /end SUB_GROUP /begin FUNCTION_LIST /end FUNCTION_LIST /begin REF_CHARACTERISTIC /end REF_CHARACTERISTIC /begin REF_MEASUREMENT QuadDet.InstMtrDir.Cnt_s08 /end REF_MEASUREMENT /end GROUP
/begin GROUP QuadDet.MRFCumMtrPos.Deg_f32 "MICROSAR RTE" /begin SUB_GROUP /end SUB_GROUP /begin FUNCTION_LIST /end FUNCTION_LIST /begin REF_CHARACTERISTIC /end REF_CHARACTERISTIC /begin REF_MEASUREMENT QuadDet.MRFCumMtrPos.Deg_f32 /end REF_MEASUREMENT /end GROUP
/begin GROUP QuadDet.MRFMtrTrqCmdScl.MtrNm_f32 "MICROSAR RTE" /begin SUB_GROUP /end SUB_GROUP /begin FUNCTION_LIST /end FUNCTION_LIST /begin REF_CHARACTERISTIC /end REF_CHARACTERISTIC /begin REF_MEASUREMENT QuadDet.MRFMtrTrqCmdScl.MtrNm_f32 /end REF_MEASUREMENT /end GROUP
/begin GROUP QuadDet.MtrQuad.Cnt_u08 "MICROSAR RTE" /begin SUB_GROUP /end SUB_GROUP /begin FUNCTION_LIST /end FUNCTION_LIST /begin REF_CHARACTERISTIC /end REF_CHARACTERISTIC /begin REF_MEASUREMENT QuadDet.MtrQuad.Cnt_u08 /end REF_MEASUREMENT /end GROUP
/begin GROUP QuadDet.ReceiverPorts "MICROSAR RTE"
 /begin SUB_GROUP QuadDet.MRFCumMtrPos.Deg_f32 QuadDet.MRFMtrTrqCmdScl.MtrNm_f32 /end SUB_GROUP
 /begin FUNCTION_LIST /end FUNCTION_LIST
 /begin REF_CHARACTERISTIC /end REF_CHARACTERISTIC
 /begin REF_MEASUREMENT /end REF_MEASUREMENT
/end GROUP
/begin GROUP QuadDet.SenderPorts "MICROSAR RTE" /begin SUB_GROUP QuadDet.InstMtrDir.Cnt_s08 QuadDet.MtrQuad.Cnt_u08 /end SUB_GROUP /begin FUNCTION_LIST /end FUNCTION_LIST /begin REF_CHARACTERISTIC /end REF_CHARACTERISTIC /begin REF_MEASUREMENT /end REF_MEASUREMENT /end GROUP
/begin GROUP RTE "MICROSAR RTE" /begin SUB_GROUP SWCs /end SUB_GROUP /begin FUNCTION_LIST /end FUNCTION_LIST /begin REF_CHARACTERISTIC /end REF_CHARACTERISTIC /begin REF_MEASUREMENT /end REF_MEASUREMENT /end GROUP
/begin GROUP Return "MICROSAR RTE" /begin SUB_GROUP Return.ReceiverPorts Return.SenderPorts /end SUB_GROUP /begin FUNCTION_LIST /end FUNCTION_LIST /begin REF_CHARACTERISTIC /end REF_CHARACTERISTIC /begin REF_MEASUREMENT /end REF_MEASUREMENT /end GROUP
/begin GROUP Return.AssistMechTempEst.DegC_f32 "MICROSAR RTE" /begin SUB_GROUP /end SUB_GROUP /begin FUNCTION_LIST /end FUNCTION_LIST /begin REF_CHARACTERISTIC /end REF_CHARACTERISTIC /begin REF_MEASUREMENT Return.AssistMechTempEst.DegC_f32 /end REF_MEASUREMENT /end GROUP
/begin GROUP Return.DefeatReturnSvc.Cnt_lgc "MICROSAR RTE" /begin SUB_GROUP /end SUB_GROUP /begin FUNCTION_LIST /end FUNCTION_LIST /begin REF_CHARACTERISTIC /end REF_CHARACTERISTIC /begin REF_MEASUREMENT Return.DefeatReturnSvc.Cnt_lgc /end REF_MEASUREMENT /end GROUP
/begin GROUP Return.DiagStsHwPosDis.Cnt_lgc "MICROSAR RTE" /begin SUB_GROUP /end SUB_GROUP /begin FUNCTION_LIST /end FUNCTION_LIST /begin REF_CHARACTERISTIC /end REF_CHARACTERISTIC /begin REF_MEASUREMENT Return.DiagStsHwPosDis.Cnt_lgc /end REF_MEASUREMENT /end GROUP
/begin GROUP Return.HandwheelAuthority.Uls_f32 "MICROSAR RTE" /begin SUB_GROUP /end SUB_GROUP /begin FUNCTION_LIST /end FUNCTION_LIST /begin REF_CHARACTERISTIC /end REF_CHARACTERISTIC /begin REF_MEASUREMENT Return.HandwheelAuthority.Uls_f32 /end REF_MEASUREMENT /end GROUP
/begin GROUP Return.HandwheelPosition.HwDeg_f32 "MICROSAR RTE" /begin SUB_GROUP /end SUB_GROUP /begin FUNCTION_LIST /end FUNCTION_LIST /begin REF_CHARACTERISTIC /end REF_CHARACTERISTIC /begin REF_MEASUREMENT Return.HandwheelPosition.HwDeg_f32 /end REF_MEASUREMENT /end GROUP
/begin GROUP Return.HandwheelVel.HwRadpS_f32 "MICROSAR RTE" /begin SUB_GROUP /end SUB_GROUP /begin FUNCTION_LIST /end FUNCTION_LIST /begin REF_CHARACTERISTIC /end REF_CHARACTERISTIC /begin REF_MEASUREMENT Return.HandwheelVel.HwRadpS_f32 /end REF_MEASUREMENT /end GROUP
/begin GROUP Return.HwTorque.HwNm_f32 "MICROSAR RTE" /begin SUB_GROUP /end SUB_GROUP /begin FUNCTION_LIST /end FUNCTION_LIST /begin REF_CHARACTERISTIC /end REF_CHARACTERISTIC /begin REF_MEASUREMENT Return.HwTorque.HwNm_f32 /end REF_MEASUREMENT /end GROUP
/begin GROUP Return.PAReturnSclFct.Uls_f32 "MICROSAR RTE" /begin SUB_GROUP /end SUB_GROUP /begin FUNCTION_LIST /end FUNCTION_LIST /begin REF_CHARACTERISTIC /end REF_CHARACTERISTIC /begin REF_MEASUREMENT Return.PAReturnSclFct.Uls_f32 /end REF_MEASUREMENT /end GROUP
/begin GROUP Return.ReceiverPorts "MICROSAR RTE"
 /begin SUB_GROUP Return.AssistMechTempEst.DegC_f32 Return.DefeatReturnSvc.Cnt_lgc Return.DiagStsHwPosDis.Cnt_lgc Return.HandwheelAuthority.Uls_f32 Return.HandwheelPosition.HwDeg_f32 Return.HandwheelVel.HwRadpS_f32 Return.HwTorque.HwNm_f32 Return.PAReturnSclFct.Uls_f32 Return.ReturnDDFactor.Uls_f32 Return.ReturnOffset.HwDeg_f32 Return.VehicleSpeed.Kph_f32 /end SUB_GROUP
 /begin FUNCTION_LIST /end FUNCTION_LIST
 /begin REF_CHARACTERISTIC /end REF_CHARACTERISTIC
 /begin REF_MEASUREMENT /end REF_MEASUREMENT
/end GROUP
/begin GROUP Return.ReturnCmd.MtrNm_f32 "MICROSAR RTE" /begin SUB_GROUP /end SUB_GROUP /begin FUNCTION_LIST /end FUNCTION_LIST /begin REF_CHARACTERISTIC /end REF_CHARACTERISTIC /begin REF_MEASUREMENT Return.ReturnCmd.MtrNm_f32 /end REF_MEASUREMENT /end GROUP
/begin GROUP Return.ReturnDDFactor.Uls_f32 "MICROSAR RTE" /begin SUB_GROUP /end SUB_GROUP /begin FUNCTION_LIST /end FUNCTION_LIST /begin REF_CHARACTERISTIC /end REF_CHARACTERISTIC /begin REF_MEASUREMENT Return.ReturnDDFactor.Uls_f32 /end REF_MEASUREMENT /end GROUP
/begin GROUP Return.ReturnOffset.HwDeg_f32 "MICROSAR RTE" /begin SUB_GROUP /end SUB_GROUP /begin FUNCTION_LIST /end FUNCTION_LIST /begin REF_CHARACTERISTIC /end REF_CHARACTERISTIC /begin REF_MEASUREMENT Return.ReturnOffset.HwDeg_f32 /end REF_MEASUREMENT /end GROUP
/begin GROUP Return.SenderPorts "MICROSAR RTE" /begin SUB_GROUP Return.ReturnCmd.MtrNm_f32 /end SUB_GROUP /begin FUNCTION_LIST /end FUNCTION_LIST /begin REF_CHARACTERISTIC /end REF_CHARACTERISTIC /begin REF_MEASUREMENT /end REF_MEASUREMENT /end GROUP
/begin GROUP Return.VehicleSpeed.Kph_f32 "MICROSAR RTE" /begin SUB_GROUP /end SUB_GROUP /begin FUNCTION_LIST /end FUNCTION_LIST /begin REF_CHARACTERISTIC /end REF_CHARACTERISTIC /begin REF_MEASUREMENT Return.VehicleSpeed.Kph_f32 /end REF_MEASUREMENT /end GROUP
/begin GROUP RteErrata "MICROSAR RTE" /begin SUB_GROUP RteErrata.ModeRequirePorts /end SUB_GROUP /begin FUNCTION_LIST /end FUNCTION_LIST /begin REF_CHARACTERISTIC /end REF_CHARACTERISTIC /begin REF_MEASUREMENT /end REF_MEASUREMENT /end GROUP
/begin GROUP RteErrata.ModeRequirePorts "MICROSAR RTE" /begin SUB_GROUP RteErrata.SystemState.Mode /end SUB_GROUP /begin FUNCTION_LIST /end FUNCTION_LIST /begin REF_CHARACTERISTIC /end REF_CHARACTERISTIC /begin REF_MEASUREMENT /end REF_MEASUREMENT /end GROUP
/begin GROUP RteErrata.SystemState.Mode "MICROSAR RTE" /begin SUB_GROUP /end SUB_GROUP /begin FUNCTION_LIST /end FUNCTION_LIST /begin REF_CHARACTERISTIC /end REF_CHARACTERISTIC /begin REF_MEASUREMENT RteErrata.SystemState.Mode /end REF_MEASUREMENT /end GROUP
/begin GROUP RteErrata8 "MICROSAR RTE" /begin SUB_GROUP RteErrata8.ModeRequirePorts /end SUB_GROUP /begin FUNCTION_LIST /end FUNCTION_LIST /begin REF_CHARACTERISTIC /end REF_CHARACTERISTIC /begin REF_MEASUREMENT /end REF_MEASUREMENT /end GROUP
/begin GROUP RteErrata8.ModeRequirePorts "MICROSAR RTE" /begin SUB_GROUP RteErrata8.SystemState.Mode /end SUB_GROUP /begin FUNCTION_LIST /end FUNCTION_LIST /begin REF_CHARACTERISTIC /end REF_CHARACTERISTIC /begin REF_MEASUREMENT /end REF_MEASUREMENT /end GROUP
/begin GROUP RteErrata8.SystemState.Mode "MICROSAR RTE" /begin SUB_GROUP /end SUB_GROUP /begin FUNCTION_LIST /end FUNCTION_LIST /begin REF_CHARACTERISTIC /end REF_CHARACTERISTIC /begin REF_MEASUREMENT RteErrata8.SystemState.Mode /end REF_MEASUREMENT /end GROUP
/begin GROUP RteErrata9 "MICROSAR RTE" /begin SUB_GROUP RteErrata9.ModeRequirePorts /end SUB_GROUP /begin FUNCTION_LIST /end FUNCTION_LIST /begin REF_CHARACTERISTIC /end REF_CHARACTERISTIC /begin REF_MEASUREMENT /end REF_MEASUREMENT /end GROUP
/begin GROUP RteErrata9.ModeRequirePorts "MICROSAR RTE" /begin SUB_GROUP RteErrata9.SystemState.Mode /end SUB_GROUP /begin FUNCTION_LIST /end FUNCTION_LIST /begin REF_CHARACTERISTIC /end REF_CHARACTERISTIC /begin REF_MEASUREMENT /end REF_MEASUREMENT /end GROUP
/begin GROUP RteErrata9.SystemState.Mode "MICROSAR RTE" /begin SUB_GROUP /end SUB_GROUP /begin FUNCTION_LIST /end FUNCTION_LIST /begin REF_CHARACTERISTIC /end REF_CHARACTERISTIC /begin REF_MEASUREMENT RteErrata9.SystemState.Mode /end REF_MEASUREMENT /end GROUP
/begin GROUP SWCs "MICROSAR RTE"
 /begin SUB_GROUP Ap_AbsHwPosScom Ap_ActivePull Ap_ArbLmt Ap_AssistFirewall Ap_AstLmt Ap_AvgFricLrn Ap_BVDiag Ap_DampingFirewall Ap_DiagMgr8 Ap_DiagMgr9 Ap_ElePwr Ap_Gsod Ap_HaLFTO Ap_HwPwUp Ap_LmtCod Ap_LrnEOT Ap_MtrTempEst Ap_PAwTO Ap_PICurrCntrl Ap_PwrLmtFuncCr Ap_ReturnFirewall Ap_SignlCondn Ap_StaMd8 Ap_StaMd9 Ap_StabilityComp2 Ap_StbCTO Ap_ThrmlDutyCycle Ap_TqRsDg Ap_TrqCanc Ap_TuningSelAuth Ap_WIRInputQual Ap_WhlImbRej Ap_ePWM2 Assist BatteryVoltage CDDInterface CmMtrCurr CtrlTemp CtrldDisShtdn CurrCmd CurrParamComp Damping DemIf DiagMgr DigPhsReasDiag EOTActuatorMng FrqDepDmpnInrtCmp HiLoadStall HighFreqAssist HwTrq HystComp IoHwAbstractionUsr MtrDrvDiag MtrPos MtrVel PeakCurrEst Polarity QuadDet Return RteErrata RteErrata8 RteErrata9 Sa_BkCpPc Sa_HwTrq2 Sa_MtrPos2 Sa_MtrPos3 Sa_MtrVel2 Sa_OvrVoltMon SrlComInput SrlComOutput StOpCtrl StaMd StabilityComp TmprlMon TrqCmdScl VehPwrMd VehSpdLmt Xcp /end SUB_GROUP
 /begin FUNCTION_LIST /end FUNCTION_LIST
 /begin REF_CHARACTERISTIC /end REF_CHARACTERISTIC
 /begin REF_MEASUREMENT /end REF_MEASUREMENT
/end GROUP
/begin GROUP Sa_BkCpPc "MICROSAR RTE"
 /begin SUB_GROUP Sa_BkCpPc.ModeRequirePorts Sa_BkCpPc.ReceiverPorts Sa_BkCpPc.SenderPorts /end SUB_GROUP
 /begin FUNCTION_LIST /end FUNCTION_LIST
 /begin REF_CHARACTERISTIC /end REF_CHARACTERISTIC
 /begin REF_MEASUREMENT /end REF_MEASUREMENT
/end GROUP
/begin GROUP Sa_BkCpPc.Batt.Volt_f32 "MICROSAR RTE" /begin SUB_GROUP /end SUB_GROUP /begin FUNCTION_LIST /end FUNCTION_LIST /begin REF_CHARACTERISTIC /end REF_CHARACTERISTIC /begin REF_MEASUREMENT Sa_BkCpPc.Batt.Volt_f32 /end REF_MEASUREMENT /end GROUP
/begin GROUP Sa_BkCpPc.BattSwitched.Volt_f32 "MICROSAR RTE" /begin SUB_GROUP /end SUB_GROUP /begin FUNCTION_LIST /end FUNCTION_LIST /begin REF_CHARACTERISTIC /end REF_CHARACTERISTIC /begin REF_MEASUREMENT Sa_BkCpPc.BattSwitched.Volt_f32 /end REF_MEASUREMENT /end GROUP
/begin GROUP Sa_BkCpPc.ModeRequirePorts "MICROSAR RTE" /begin SUB_GROUP Sa_BkCpPc.SystemState.Mode /end SUB_GROUP /begin FUNCTION_LIST /end FUNCTION_LIST /begin REF_CHARACTERISTIC /end REF_CHARACTERISTIC /begin REF_MEASUREMENT /end REF_MEASUREMENT /end GROUP
/begin GROUP Sa_BkCpPc.MotorVelocityMRFUnfiltered.MtrRadpS_f32 "MICROSAR RTE" /begin SUB_GROUP /end SUB_GROUP /begin FUNCTION_LIST /end FUNCTION_LIST /begin REF_CHARACTERISTIC /end REF_CHARACTERISTIC /begin REF_MEASUREMENT Sa_BkCpPc.MotorVelocityMRFUnfiltered.MtrRadpS_f32 /end REF_MEASUREMENT /end GROUP
/begin GROUP Sa_BkCpPc.OVERRIDESIGDIAGADC.Volt_f32 "MICROSAR RTE" /begin SUB_GROUP /end SUB_GROUP /begin FUNCTION_LIST /end FUNCTION_LIST /begin REF_CHARACTERISTIC /end REF_CHARACTERISTIC /begin REF_MEASUREMENT Sa_BkCpPc.OVERRIDESIGDIAGADC.Volt_f32 /end REF_MEASUREMENT /end GROUP
/begin GROUP Sa_BkCpPc.PMOSDIAGADC.Volt_f32 "MICROSAR RTE" /begin SUB_GROUP /end SUB_GROUP /begin FUNCTION_LIST /end FUNCTION_LIST /begin REF_CHARACTERISTIC /end REF_CHARACTERISTIC /begin REF_MEASUREMENT Sa_BkCpPc.PMOSDIAGADC.Volt_f32 /end REF_MEASUREMENT /end GROUP
/begin GROUP Sa_BkCpPc.PwrDiscATestComplete.Cnt_lgc "MICROSAR RTE" /begin SUB_GROUP /end SUB_GROUP /begin FUNCTION_LIST /end FUNCTION_LIST /begin REF_CHARACTERISTIC /end REF_CHARACTERISTIC /begin REF_MEASUREMENT Sa_BkCpPc.PwrDiscATestComplete.Cnt_lgc /end REF_MEASUREMENT /end GROUP
/begin GROUP Sa_BkCpPc.PwrDiscATestStart.Cnt_lgc "MICROSAR RTE" /begin SUB_GROUP /end SUB_GROUP /begin FUNCTION_LIST /end FUNCTION_LIST /begin REF_CHARACTERISTIC /end REF_CHARACTERISTIC /begin REF_MEASUREMENT Sa_BkCpPc.PwrDiscATestStart.Cnt_lgc /end REF_MEASUREMENT /end GROUP
/begin GROUP Sa_BkCpPc.PwrDiscBTestComplete.Cnt_lgc "MICROSAR RTE" /begin SUB_GROUP /end SUB_GROUP /begin FUNCTION_LIST /end FUNCTION_LIST /begin REF_CHARACTERISTIC /end REF_CHARACTERISTIC /begin REF_MEASUREMENT Sa_BkCpPc.PwrDiscBTestComplete.Cnt_lgc /end REF_MEASUREMENT /end GROUP
/begin GROUP Sa_BkCpPc.PwrDiscBTestStart.Cnt_lgc "MICROSAR RTE" /begin SUB_GROUP /end SUB_GROUP /begin FUNCTION_LIST /end FUNCTION_LIST /begin REF_CHARACTERISTIC /end REF_CHARACTERISTIC /begin REF_MEASUREMENT Sa_BkCpPc.PwrDiscBTestStart.Cnt_lgc /end REF_MEASUREMENT /end GROUP
/begin GROUP Sa_BkCpPc.PwrDiscClosed.Cnt_lgc "MICROSAR RTE" /begin SUB_GROUP /end SUB_GROUP /begin FUNCTION_LIST /end FUNCTION_LIST /begin REF_CHARACTERISTIC /end REF_CHARACTERISTIC /begin REF_MEASUREMENT Sa_BkCpPc.PwrDiscClosed.Cnt_lgc /end REF_MEASUREMENT /end GROUP
/begin GROUP Sa_BkCpPc.ReceiverPorts "MICROSAR RTE"
 /begin SUB_GROUP Sa_BkCpPc.Batt.Volt_f32 Sa_BkCpPc.BattSwitched.Volt_f32 Sa_BkCpPc.MotorVelocityMRFUnfiltered.MtrRadpS_f32 Sa_BkCpPc.OVERRIDESIGDIAGADC.Volt_f32 Sa_BkCpPc.PMOSDIAGADC.Volt_f32 Sa_BkCpPc.PwrDiscATestStart.Cnt_lgc Sa_BkCpPc.PwrDiscBTestStart.Cnt_lgc /end SUB_GROUP
 /begin FUNCTION_LIST /end FUNCTION_LIST
 /begin REF_CHARACTERISTIC /end REF_CHARACTERISTIC
 /begin REF_MEASUREMENT /end REF_MEASUREMENT
/end GROUP
/begin GROUP Sa_BkCpPc.SenderPorts "MICROSAR RTE"
 /begin SUB_GROUP Sa_BkCpPc.PwrDiscATestComplete.Cnt_lgc Sa_BkCpPc.PwrDiscBTestComplete.Cnt_lgc Sa_BkCpPc.PwrDiscClosed.Cnt_lgc /end SUB_GROUP
 /begin FUNCTION_LIST /end FUNCTION_LIST
 /begin REF_CHARACTERISTIC /end REF_CHARACTERISTIC
 /begin REF_MEASUREMENT /end REF_MEASUREMENT
/end GROUP
/begin GROUP Sa_BkCpPc.SystemState.Mode "MICROSAR RTE" /begin SUB_GROUP /end SUB_GROUP /begin FUNCTION_LIST /end FUNCTION_LIST /begin REF_CHARACTERISTIC /end REF_CHARACTERISTIC /begin REF_MEASUREMENT Sa_BkCpPc.SystemState.Mode /end REF_MEASUREMENT /end GROUP
/begin GROUP Sa_HwTrq2 "MICROSAR RTE" /begin SUB_GROUP Sa_HwTrq2.ReceiverPorts /end SUB_GROUP /begin FUNCTION_LIST /end FUNCTION_LIST /begin REF_CHARACTERISTIC /end REF_CHARACTERISTIC /begin REF_MEASUREMENT /end REF_MEASUREMENT /end GROUP
/begin GROUP Sa_HwTrq2.AnaDiffHwTrq.Volt_f32 "MICROSAR RTE" /begin SUB_GROUP /end SUB_GROUP /begin FUNCTION_LIST /end FUNCTION_LIST /begin REF_CHARACTERISTIC /end REF_CHARACTERISTIC /begin REF_MEASUREMENT Sa_HwTrq2.AnaDiffHwTrq.Volt_f32 /end REF_MEASUREMENT /end GROUP
/begin GROUP Sa_HwTrq2.AnaHwTorque.HwNm_f32 "MICROSAR RTE" /begin SUB_GROUP /end SUB_GROUP /begin FUNCTION_LIST /end FUNCTION_LIST /begin REF_CHARACTERISTIC /end REF_CHARACTERISTIC /begin REF_MEASUREMENT Sa_HwTrq2.AnaHwTorque.HwNm_f32 /end REF_MEASUREMENT /end GROUP
/begin GROUP Sa_HwTrq2.HwTrqScaleVal.VoltsPerDeg_f32 "MICROSAR RTE" /begin SUB_GROUP /end SUB_GROUP /begin FUNCTION_LIST /end FUNCTION_LIST /begin REF_CHARACTERISTIC /end REF_CHARACTERISTIC /begin REF_MEASUREMENT Sa_HwTrq2.HwTrqScaleVal.VoltsPerDeg_f32 /end REF_MEASUREMENT /end GROUP
/begin GROUP Sa_HwTrq2.ReceiverPorts "MICROSAR RTE"
 /begin SUB_GROUP Sa_HwTrq2.AnaDiffHwTrq.Volt_f32 Sa_HwTrq2.AnaHwTorque.HwNm_f32 Sa_HwTrq2.HwTrqScaleVal.VoltsPerDeg_f32 Sa_HwTrq2.SysCT1ADC.Volt_f32 Sa_HwTrq2.SysCT2ADC.Volt_f32 Sa_HwTrq2.T1TrimVal.Volt_f32 Sa_HwTrq2.T2TrimVal.Volt_f32 /end SUB_GROUP
 /begin FUNCTION_LIST /end FUNCTION_LIST
 /begin REF_CHARACTERISTIC /end REF_CHARACTERISTIC
 /begin REF_MEASUREMENT /end REF_MEASUREMENT
/end GROUP
/begin GROUP Sa_HwTrq2.SysCT1ADC.Volt_f32 "MICROSAR RTE" /begin SUB_GROUP /end SUB_GROUP /begin FUNCTION_LIST /end FUNCTION_LIST /begin REF_CHARACTERISTIC /end REF_CHARACTERISTIC /begin REF_MEASUREMENT Sa_HwTrq2.SysCT1ADC.Volt_f32 /end REF_MEASUREMENT /end GROUP
/begin GROUP Sa_HwTrq2.SysCT2ADC.Volt_f32 "MICROSAR RTE" /begin SUB_GROUP /end SUB_GROUP /begin FUNCTION_LIST /end FUNCTION_LIST /begin REF_CHARACTERISTIC /end REF_CHARACTERISTIC /begin REF_MEASUREMENT Sa_HwTrq2.SysCT2ADC.Volt_f32 /end REF_MEASUREMENT /end GROUP
/begin GROUP Sa_HwTrq2.T1TrimVal.Volt_f32 "MICROSAR RTE" /begin SUB_GROUP /end SUB_GROUP /begin FUNCTION_LIST /end FUNCTION_LIST /begin REF_CHARACTERISTIC /end REF_CHARACTERISTIC /begin REF_MEASUREMENT Sa_HwTrq2.T1TrimVal.Volt_f32 /end REF_MEASUREMENT /end GROUP
/begin GROUP Sa_HwTrq2.T2TrimVal.Volt_f32 "MICROSAR RTE" /begin SUB_GROUP /end SUB_GROUP /begin FUNCTION_LIST /end FUNCTION_LIST /begin REF_CHARACTERISTIC /end REF_CHARACTERISTIC /begin REF_MEASUREMENT Sa_HwTrq2.T2TrimVal.Volt_f32 /end REF_MEASUREMENT /end GROUP
/begin GROUP Sa_MtrPos2 "MICROSAR RTE" /begin SUB_GROUP Sa_MtrPos2.ReceiverPorts Sa_MtrPos2.SenderPorts /end SUB_GROUP /begin FUNCTION_LIST /end FUNCTION_LIST /begin REF_CHARACTERISTIC /end REF_CHARACTERISTIC /begin REF_MEASUREMENT /end REF_MEASUREMENT /end GROUP
/begin GROUP Sa_MtrPos2.CorrectedMtrPos.Rev_f32 "MICROSAR RTE" /begin SUB_GROUP /end SUB_GROUP /begin FUNCTION_LIST /end FUNCTION_LIST /begin REF_CHARACTERISTIC /end REF_CHARACTERISTIC /begin REF_MEASUREMENT Sa_MtrPos2.CorrectedMtrPos.Rev_f32 /end REF_MEASUREMENT /end GROUP
/begin GROUP Sa_MtrPos2.CosTheta1.Volt_f32 "MICROSAR RTE" /begin SUB_GROUP /end SUB_GROUP /begin FUNCTION_LIST /end FUNCTION_LIST /begin REF_CHARACTERISTIC /end REF_CHARACTERISTIC /begin REF_MEASUREMENT Sa_MtrPos2.CosTheta1.Volt_f32 /end REF_MEASUREMENT /end GROUP
/begin GROUP Sa_MtrPos2.MechMtrPos.Rev_f32 "MICROSAR RTE" /begin SUB_GROUP /end SUB_GROUP /begin FUNCTION_LIST /end FUNCTION_LIST /begin REF_CHARACTERISTIC /end REF_CHARACTERISTIC /begin REF_MEASUREMENT Sa_MtrPos2.MechMtrPos.Rev_f32 /end REF_MEASUREMENT /end GROUP
/begin GROUP Sa_MtrPos2.MotorVelMRF.MtrRadpS_f32 "MICROSAR RTE" /begin SUB_GROUP /end SUB_GROUP /begin FUNCTION_LIST /end FUNCTION_LIST /begin REF_CHARACTERISTIC /end REF_CHARACTERISTIC /begin REF_MEASUREMENT Sa_MtrPos2.MotorVelMRF.MtrRadpS_f32 /end REF_MEASUREMENT /end GROUP
/begin GROUP Sa_MtrPos2.ReceiverPorts "MICROSAR RTE" /begin SUB_GROUP Sa_MtrPos2.MotorVelMRF.MtrRadpS_f32 /end SUB_GROUP /begin FUNCTION_LIST /end FUNCTION_LIST /begin REF_CHARACTERISTIC /end REF_CHARACTERISTIC /begin REF_MEASUREMENT /end REF_MEASUREMENT /end GROUP
/begin GROUP Sa_MtrPos2.SenderPorts "MICROSAR RTE"
 /begin SUB_GROUP Sa_MtrPos2.CorrectedMtrPos.Rev_f32 Sa_MtrPos2.CosTheta1.Volt_f32 Sa_MtrPos2.MechMtrPos.Rev_f32 Sa_MtrPos2.SinTheta1.Volt_f32 Sa_MtrPos2.SysCCorrectedMtrPos.Rev_f32 Sa_MtrPos2.SysCMechMtrPos.Rev_f32 /end SUB_GROUP
 /begin FUNCTION_LIST /end FUNCTION_LIST
 /begin REF_CHARACTERISTIC /end REF_CHARACTERISTIC
 /begin REF_MEASUREMENT /end REF_MEASUREMENT
/end GROUP
/begin GROUP Sa_MtrPos2.SinTheta1.Volt_f32 "MICROSAR RTE" /begin SUB_GROUP /end SUB_GROUP /begin FUNCTION_LIST /end FUNCTION_LIST /begin REF_CHARACTERISTIC /end REF_CHARACTERISTIC /begin REF_MEASUREMENT Sa_MtrPos2.SinTheta1.Volt_f32 /end REF_MEASUREMENT /end GROUP
/begin GROUP Sa_MtrPos2.SysCCorrectedMtrPos.Rev_f32 "MICROSAR RTE" /begin SUB_GROUP /end SUB_GROUP /begin FUNCTION_LIST /end FUNCTION_LIST /begin REF_CHARACTERISTIC /end REF_CHARACTERISTIC /begin REF_MEASUREMENT Sa_MtrPos2.SysCCorrectedMtrPos.Rev_f32 /end REF_MEASUREMENT /end GROUP
/begin GROUP Sa_MtrPos2.SysCMechMtrPos.Rev_f32 "MICROSAR RTE" /begin SUB_GROUP /end SUB_GROUP /begin FUNCTION_LIST /end FUNCTION_LIST /begin REF_CHARACTERISTIC /end REF_CHARACTERISTIC /begin REF_MEASUREMENT Sa_MtrPos2.SysCMechMtrPos.Rev_f32 /end REF_MEASUREMENT /end GROUP
/begin GROUP Sa_MtrPos3 "MICROSAR RTE" /begin SUB_GROUP Sa_MtrPos3.ReceiverPorts /end SUB_GROUP /begin FUNCTION_LIST /end FUNCTION_LIST /begin REF_CHARACTERISTIC /end REF_CHARACTERISTIC /begin REF_MEASUREMENT /end REF_MEASUREMENT /end GROUP
/begin GROUP Sa_MtrPos3.CorrectedMtrPos.Rev_f32 "MICROSAR RTE" /begin SUB_GROUP /end SUB_GROUP /begin FUNCTION_LIST /end FUNCTION_LIST /begin REF_CHARACTERISTIC /end REF_CHARACTERISTIC /begin REF_MEASUREMENT Sa_MtrPos3.CorrectedMtrPos.Rev_f32 /end REF_MEASUREMENT /end GROUP
/begin GROUP Sa_MtrPos3.InvCos2Scaled.Volt_f32 "MICROSAR RTE" /begin SUB_GROUP /end SUB_GROUP /begin FUNCTION_LIST /end FUNCTION_LIST /begin REF_CHARACTERISTIC /end REF_CHARACTERISTIC /begin REF_MEASUREMENT Sa_MtrPos3.InvCos2Scaled.Volt_f32 /end REF_MEASUREMENT /end GROUP
/begin GROUP Sa_MtrPos3.InvSin2Scaled.Volt_f32 "MICROSAR RTE" /begin SUB_GROUP /end SUB_GROUP /begin FUNCTION_LIST /end FUNCTION_LIST /begin REF_CHARACTERISTIC /end REF_CHARACTERISTIC /begin REF_MEASUREMENT Sa_MtrPos3.InvSin2Scaled.Volt_f32 /end REF_MEASUREMENT /end GROUP
/begin GROUP Sa_MtrPos3.ReceiverPorts "MICROSAR RTE"
 /begin SUB_GROUP Sa_MtrPos3.CorrectedMtrPos.Rev_f32 Sa_MtrPos3.InvCos2Scaled.Volt_f32 Sa_MtrPos3.InvSin2Scaled.Volt_f32 /end SUB_GROUP
 /begin FUNCTION_LIST /end FUNCTION_LIST
 /begin REF_CHARACTERISTIC /end REF_CHARACTERISTIC
 /begin REF_MEASUREMENT /end REF_MEASUREMENT
/end GROUP
/begin GROUP Sa_MtrVel2 "MICROSAR RTE" /begin SUB_GROUP Sa_MtrVel2.ReceiverPorts Sa_MtrVel2.SenderPorts /end SUB_GROUP /begin FUNCTION_LIST /end FUNCTION_LIST /begin REF_CHARACTERISTIC /end REF_CHARACTERISTIC /begin REF_MEASUREMENT /end REF_MEASUREMENT /end GROUP
/begin GROUP Sa_MtrVel2.AsstAssemPol.Cnt_s08 "MICROSAR RTE" /begin SUB_GROUP /end SUB_GROUP /begin FUNCTION_LIST /end FUNCTION_LIST /begin REF_CHARACTERISTIC /end REF_CHARACTERISTIC /begin REF_MEASUREMENT Sa_MtrVel2.AsstAssemPol.Cnt_s08 /end REF_MEASUREMENT /end GROUP
/begin GROUP Sa_MtrVel2.CumMtrPosMRF.Deg_f32 "MICROSAR RTE" /begin SUB_GROUP /end SUB_GROUP /begin FUNCTION_LIST /end FUNCTION_LIST /begin REF_CHARACTERISTIC /end REF_CHARACTERISTIC /begin REF_MEASUREMENT Sa_MtrVel2.CumMtrPosMRF.Deg_f32 /end REF_MEASUREMENT /end GROUP
/begin GROUP Sa_MtrVel2.HandWheelVel.HwRadpS_f32 "MICROSAR RTE" /begin SUB_GROUP /end SUB_GROUP /begin FUNCTION_LIST /end FUNCTION_LIST /begin REF_CHARACTERISTIC /end REF_CHARACTERISTIC /begin REF_MEASUREMENT Sa_MtrVel2.HandWheelVel.HwRadpS_f32 /end REF_MEASUREMENT /end GROUP
/begin GROUP Sa_MtrVel2.MRFMotorVel.MtrRadpS_f32 "MICROSAR RTE" /begin SUB_GROUP /end SUB_GROUP /begin FUNCTION_LIST /end FUNCTION_LIST /begin REF_CHARACTERISTIC /end REF_CHARACTERISTIC /begin REF_MEASUREMENT Sa_MtrVel2.MRFMotorVel.MtrRadpS_f32 /end REF_MEASUREMENT /end GROUP
/begin GROUP Sa_MtrVel2.ReceiverPorts "MICROSAR RTE"
 /begin SUB_GROUP Sa_MtrVel2.AsstAssemPol.Cnt_s08 Sa_MtrVel2.CumMtrPosMRF.Deg_f32 Sa_MtrVel2.HandWheelVel.HwRadpS_f32 Sa_MtrVel2.MRFMotorVel.MtrRadpS_f32 /end SUB_GROUP
 /begin FUNCTION_LIST /end FUNCTION_LIST
 /begin REF_CHARACTERISTIC /end REF_CHARACTERISTIC
 /begin REF_MEASUREMENT /end REF_MEASUREMENT
/end GROUP
/begin GROUP Sa_MtrVel2.SenderPorts "MICROSAR RTE"
 /begin SUB_GROUP Sa_MtrVel2.SysCDiagHandWheelVel.HwRadpS_f32 Sa_MtrVel2.SysCDiagMtrVelMRF.MtrRadpS_f32 /end SUB_GROUP
 /begin FUNCTION_LIST /end FUNCTION_LIST
 /begin REF_CHARACTERISTIC /end REF_CHARACTERISTIC
 /begin REF_MEASUREMENT /end REF_MEASUREMENT
/end GROUP
/begin GROUP Sa_MtrVel2.SysCDiagHandWheelVel.HwRadpS_f32 "MICROSAR RTE" /begin SUB_GROUP /end SUB_GROUP /begin FUNCTION_LIST /end FUNCTION_LIST /begin REF_CHARACTERISTIC /end REF_CHARACTERISTIC /begin REF_MEASUREMENT Sa_MtrVel2.SysCDiagHandWheelVel.HwRadpS_f32 /end REF_MEASUREMENT /end GROUP
/begin GROUP Sa_MtrVel2.SysCDiagMtrVelMRF.MtrRadpS_f32 "MICROSAR RTE" /begin SUB_GROUP /end SUB_GROUP /begin FUNCTION_LIST /end FUNCTION_LIST /begin REF_CHARACTERISTIC /end REF_CHARACTERISTIC /begin REF_MEASUREMENT Sa_MtrVel2.SysCDiagMtrVelMRF.MtrRadpS_f32 /end REF_MEASUREMENT /end GROUP
/begin GROUP Sa_OvrVoltMon "MICROSAR RTE" /begin SUB_GROUP Sa_OvrVoltMon.ModeRequirePorts Sa_OvrVoltMon.ReceiverPorts /end SUB_GROUP /begin FUNCTION_LIST /end FUNCTION_LIST /begin REF_CHARACTERISTIC /end REF_CHARACTERISTIC /begin REF_MEASUREMENT /end REF_MEASUREMENT /end GROUP
/begin GROUP Sa_OvrVoltMon.ModeRequirePorts "MICROSAR RTE" /begin SUB_GROUP Sa_OvrVoltMon.SystemState.Mode /end SUB_GROUP /begin FUNCTION_LIST /end FUNCTION_LIST /begin REF_CHARACTERISTIC /end REF_CHARACTERISTIC /begin REF_MEASUREMENT /end REF_MEASUREMENT /end GROUP
/begin GROUP Sa_OvrVoltMon.PwrDiscBTestStart.Cnt_lgc "MICROSAR RTE" /begin SUB_GROUP /end SUB_GROUP /begin FUNCTION_LIST /end FUNCTION_LIST /begin REF_CHARACTERISTIC /end REF_CHARACTERISTIC /begin REF_MEASUREMENT Sa_OvrVoltMon.PwrDiscBTestStart.Cnt_lgc /end REF_MEASUREMENT /end GROUP
/begin GROUP Sa_OvrVoltMon.ReceiverPorts "MICROSAR RTE" /begin SUB_GROUP Sa_OvrVoltMon.PwrDiscBTestStart.Cnt_lgc /end SUB_GROUP /begin FUNCTION_LIST /end FUNCTION_LIST /begin REF_CHARACTERISTIC /end REF_CHARACTERISTIC /begin REF_MEASUREMENT /end REF_MEASUREMENT /end GROUP
/begin GROUP Sa_OvrVoltMon.SystemState.Mode "MICROSAR RTE" /begin SUB_GROUP /end SUB_GROUP /begin FUNCTION_LIST /end FUNCTION_LIST /begin REF_CHARACTERISTIC /end REF_CHARACTERISTIC /begin REF_MEASUREMENT Sa_OvrVoltMon.SystemState.Mode /end REF_MEASUREMENT /end GROUP
/begin GROUP SrlComInput "MICROSAR RTE"
 /begin SUB_GROUP SrlComInput.ModeRequirePorts SrlComInput.ReceiverPorts SrlComInput.SenderPorts /end SUB_GROUP
 /begin FUNCTION_LIST /end FUNCTION_LIST
 /begin REF_CHARACTERISTIC /end REF_CHARACTERISTIC
 /begin REF_MEASUREMENT /end REF_MEASUREMENT
/end GROUP
/begin GROUP SrlComInput.AirTempOutside.DegC_f32 "MICROSAR RTE" /begin SUB_GROUP /end SUB_GROUP /begin FUNCTION_LIST /end FUNCTION_LIST /begin REF_CHARACTERISTIC /end REF_CHARACTERISTIC /begin REF_MEASUREMENT SrlComInput.AirTempOutside.DegC_f32 /end REF_MEASUREMENT /end GROUP
/begin GROUP SrlComInput.AmbTempAvg.DegC_f32 "MICROSAR RTE" /begin SUB_GROUP /end SUB_GROUP /begin FUNCTION_LIST /end FUNCTION_LIST /begin REF_CHARACTERISTIC /end REF_CHARACTERISTIC /begin REF_MEASUREMENT SrlComInput.AmbTempAvg.DegC_f32 /end REF_MEASUREMENT /end GROUP
/begin GROUP SrlComInput.AnaHwTorque.HwNm_f32 "MICROSAR RTE" /begin SUB_GROUP /end SUB_GROUP /begin FUNCTION_LIST /end FUNCTION_LIST /begin REF_CHARACTERISTIC /end REF_CHARACTERISTIC /begin REF_MEASUREMENT SrlComInput.AnaHwTorque.HwNm_f32 /end REF_MEASUREMENT /end GROUP
/begin GROUP SrlComInput.BattVolt.Volt_f32 "MICROSAR RTE" /begin SUB_GROUP /end SUB_GROUP /begin FUNCTION_LIST /end FUNCTION_LIST /begin REF_CHARACTERISTIC /end REF_CHARACTERISTIC /begin REF_MEASUREMENT SrlComInput.BattVolt.Volt_f32 /end REF_MEASUREMENT /end GROUP
/begin GROUP SrlComInput.CMDIgnStat.Cnt_u08 "MICROSAR RTE" /begin SUB_GROUP /end SUB_GROUP /begin FUNCTION_LIST /end FUNCTION_LIST /begin REF_CHARACTERISTIC /end REF_CHARACTERISTIC /begin REF_MEASUREMENT SrlComInput.CMDIgnStat.Cnt_u08 /end REF_MEASUREMENT /end GROUP
/begin GROUP SrlComInput.CanMsgReceived.Cnt_lgc "MICROSAR RTE" /begin SUB_GROUP /end SUB_GROUP /begin FUNCTION_LIST /end FUNCTION_LIST /begin REF_CHARACTERISTIC /end REF_CHARACTERISTIC /begin REF_MEASUREMENT SrlComInput.CanMsgReceived.Cnt_lgc /end REF_MEASUREMENT /end GROUP
/begin GROUP SrlComInput.CfgStatRQ.Cnt_u08 "MICROSAR RTE" /begin SUB_GROUP /end SUB_GROUP /begin FUNCTION_LIST /end FUNCTION_LIST /begin REF_CHARACTERISTIC /end REF_CHARACTERISTIC /begin REF_MEASUREMENT SrlComInput.CfgStatRQ.Cnt_u08 /end REF_MEASUREMENT /end GROUP
/begin GROUP SrlComInput.DSTEOLDisable.Cnt_lgc "MICROSAR RTE" /begin SUB_GROUP /end SUB_GROUP /begin FUNCTION_LIST /end FUNCTION_LIST /begin REF_CHARACTERISTIC /end REF_CHARACTERISTIC /begin REF_MEASUREMENT SrlComInput.DSTEOLDisable.Cnt_lgc /end REF_MEASUREMENT /end GROUP
/begin GROUP SrlComInput.DSTEnableRqst.Cnt_lgc "MICROSAR RTE" /begin SUB_GROUP /end SUB_GROUP /begin FUNCTION_LIST /end FUNCTION_LIST /begin REF_CHARACTERISTIC /end REF_CHARACTERISTIC /begin REF_MEASUREMENT SrlComInput.DSTEnableRqst.Cnt_lgc /end REF_MEASUREMENT /end GROUP
/begin GROUP SrlComInput.DSTErrCntrRecvLevel.Cnt_u08 "MICROSAR RTE" /begin SUB_GROUP /end SUB_GROUP /begin FUNCTION_LIST /end FUNCTION_LIST /begin REF_CHARACTERISTIC /end REF_CHARACTERISTIC /begin REF_MEASUREMENT SrlComInput.DSTErrCntrRecvLevel.Cnt_u08 /end REF_MEASUREMENT /end GROUP
/begin GROUP SrlComInput.DSTExtSystemFltActive.Cnt_lgc "MICROSAR RTE" /begin SUB_GROUP /end SUB_GROUP /begin FUNCTION_LIST /end FUNCTION_LIST /begin REF_CHARACTERISTIC /end REF_CHARACTERISTIC /begin REF_MEASUREMENT SrlComInput.DSTExtSystemFltActive.Cnt_lgc /end REF_MEASUREMENT /end GROUP
/begin GROUP SrlComInput.DSTFuncPresent.Cnt_lgc "MICROSAR RTE" /begin SUB_GROUP /end SUB_GROUP /begin FUNCTION_LIST /end FUNCTION_LIST /begin REF_CHARACTERISTIC /end REF_CHARACTERISTIC /begin REF_MEASUREMENT SrlComInput.DSTFuncPresent.Cnt_lgc /end REF_MEASUREMENT /end GROUP
/begin GROUP SrlComInput.DSTRevGearValid.Cnt_lgc "MICROSAR RTE" /begin SUB_GROUP /end SUB_GROUP /begin FUNCTION_LIST /end FUNCTION_LIST /begin REF_CHARACTERISTIC /end REF_CHARACTERISTIC /begin REF_MEASUREMENT SrlComInput.DSTRevGearValid.Cnt_lgc /end REF_MEASUREMENT /end GROUP
/begin GROUP SrlComInput.DSTSlewStart.Cnt_lgc "MICROSAR RTE" /begin SUB_GROUP /end SUB_GROUP /begin FUNCTION_LIST /end FUNCTION_LIST /begin REF_CHARACTERISTIC /end REF_CHARACTERISTIC /begin REF_MEASUREMENT SrlComInput.DSTSlewStart.Cnt_lgc /end REF_MEASUREMENT /end GROUP
/begin GROUP SrlComInput.DSTState.Cnt_u08 "MICROSAR RTE" /begin SUB_GROUP /end SUB_GROUP /begin FUNCTION_LIST /end FUNCTION_LIST /begin REF_CHARACTERISTIC /end REF_CHARACTERISTIC /begin REF_MEASUREMENT SrlComInput.DSTState.Cnt_u08 /end REF_MEASUREMENT /end GROUP
/begin GROUP SrlComInput.DSTTOCState.Uls_enum "MICROSAR RTE" /begin SUB_GROUP /end SUB_GROUP /begin FUNCTION_LIST /end FUNCTION_LIST /begin REF_CHARACTERISTIC /end REF_CHARACTERISTIC /begin REF_MEASUREMENT SrlComInput.DSTTOCState.Uls_enum /end REF_MEASUREMENT /end GROUP
/begin GROUP SrlComInput.DSTTrqOvCmdRqst.HwNm_f32 "MICROSAR RTE" /begin SUB_GROUP /end SUB_GROUP /begin FUNCTION_LIST /end FUNCTION_LIST /begin REF_CHARACTERISTIC /end REF_CHARACTERISTIC /begin REF_MEASUREMENT SrlComInput.DSTTrqOvCmdRqst.HwNm_f32 /end REF_MEASUREMENT /end GROUP
/begin GROUP SrlComInput.DSTTrqOvRqstValid.Cnt_lgc "MICROSAR RTE" /begin SUB_GROUP /end SUB_GROUP /begin FUNCTION_LIST /end FUNCTION_LIST /begin REF_CHARACTERISTIC /end REF_CHARACTERISTIC /begin REF_MEASUREMENT SrlComInput.DSTTrqOvRqstValid.Cnt_lgc /end REF_MEASUREMENT /end GROUP
/begin GROUP SrlComInput.DefaultVehSpd.Cnt_lgc "MICROSAR RTE" /begin SUB_GROUP /end SUB_GROUP /begin FUNCTION_LIST /end FUNCTION_LIST /begin REF_CHARACTERISTIC /end REF_CHARACTERISTIC /begin REF_MEASUREMENT SrlComInput.DefaultVehSpd.Cnt_lgc /end REF_MEASUREMENT /end GROUP
/begin GROUP SrlComInput.DesiredTunPers.Cnt_u16 "MICROSAR RTE" /begin SUB_GROUP /end SUB_GROUP /begin FUNCTION_LIST /end FUNCTION_LIST /begin REF_CHARACTERISTIC /end REF_CHARACTERISTIC /begin REF_MEASUREMENT SrlComInput.DesiredTunPers.Cnt_u16 /end REF_MEASUREMENT /end GROUP
/begin GROUP SrlComInput.DesiredTunPersTypH.Cnt_u08 "MICROSAR RTE" /begin SUB_GROUP /end SUB_GROUP /begin FUNCTION_LIST /end FUNCTION_LIST /begin REF_CHARACTERISTIC /end REF_CHARACTERISTIC /begin REF_MEASUREMENT SrlComInput.DesiredTunPersTypH.Cnt_u08 /end REF_MEASUREMENT /end GROUP
/begin GROUP SrlComInput.DesiredTunSet.Cnt_u16 "MICROSAR RTE" /begin SUB_GROUP /end SUB_GROUP /begin FUNCTION_LIST /end FUNCTION_LIST /begin REF_CHARACTERISTIC /end REF_CHARACTERISTIC /begin REF_MEASUREMENT SrlComInput.DesiredTunSet.Cnt_u16 /end REF_MEASUREMENT /end GROUP
/begin GROUP SrlComInput.EPS_Mode_Req.Cnt_u08 "MICROSAR RTE" /begin SUB_GROUP /end SUB_GROUP /begin FUNCTION_LIST /end FUNCTION_LIST /begin REF_CHARACTERISTIC /end REF_CHARACTERISTIC /begin REF_MEASUREMENT SrlComInput.EPS_Mode_Req.Cnt_u08 /end REF_MEASUREMENT /end GROUP
/begin GROUP SrlComInput.EngOilTemp.DegC_f32 "MICROSAR RTE" /begin SUB_GROUP /end SUB_GROUP /begin FUNCTION_LIST /end FUNCTION_LIST /begin REF_CHARACTERISTIC /end REF_CHARACTERISTIC /begin REF_MEASUREMENT SrlComInput.EngOilTemp.DegC_f32 /end REF_MEASUREMENT /end GROUP
/begin GROUP SrlComInput.EngRPM.Cnt_u16 "MICROSAR RTE" /begin SUB_GROUP /end SUB_GROUP /begin FUNCTION_LIST /end FUNCTION_LIST /begin REF_CHARACTERISTIC /end REF_CHARACTERISTIC /begin REF_MEASUREMENT SrlComInput.EngRPM.Cnt_u16 /end REF_MEASUREMENT /end GROUP
/begin GROUP SrlComInput.EssEngStop.Cnt_lgc "MICROSAR RTE" /begin SUB_GROUP /end SUB_GROUP /begin FUNCTION_LIST /end FUNCTION_LIST /begin REF_CHARACTERISTIC /end REF_CHARACTERISTIC /begin REF_MEASUREMENT SrlComInput.EssEngStop.Cnt_lgc /end REF_MEASUREMENT /end GROUP
/begin GROUP SrlComInput.EstFric.HwNm_f32 "MICROSAR RTE" /begin SUB_GROUP /end SUB_GROUP /begin FUNCTION_LIST /end FUNCTION_LIST /begin REF_CHARACTERISTIC /end REF_CHARACTERISTIC /begin REF_MEASUREMENT SrlComInput.EstFric.HwNm_f32 /end REF_MEASUREMENT /end GROUP
/begin GROUP SrlComInput.HaLFEnableRqst.Cnt_lgc "MICROSAR RTE" /begin SUB_GROUP /end SUB_GROUP /begin FUNCTION_LIST /end FUNCTION_LIST /begin REF_CHARACTERISTIC /end REF_CHARACTERISTIC /begin REF_MEASUREMENT SrlComInput.HaLFEnableRqst.Cnt_lgc /end REF_MEASUREMENT /end GROUP
/begin GROUP SrlComInput.HaLFErrInterfaceActive.Cnt_lgc "MICROSAR RTE" /begin SUB_GROUP /end SUB_GROUP /begin FUNCTION_LIST /end FUNCTION_LIST /begin REF_CHARACTERISTIC /end REF_CHARACTERISTIC /begin REF_MEASUREMENT SrlComInput.HaLFErrInterfaceActive.Cnt_lgc /end REF_MEASUREMENT /end GROUP
/begin GROUP SrlComInput.HaLFExtSystemFltActive.Cnt_lgc "MICROSAR RTE" /begin SUB_GROUP /end SUB_GROUP /begin FUNCTION_LIST /end FUNCTION_LIST /begin REF_CHARACTERISTIC /end REF_CHARACTERISTIC /begin REF_MEASUREMENT SrlComInput.HaLFExtSystemFltActive.Cnt_lgc /end REF_MEASUREMENT /end GROUP
/begin GROUP SrlComInput.HaLFFuncPresent.Cnt_lgc "MICROSAR RTE" /begin SUB_GROUP /end SUB_GROUP /begin FUNCTION_LIST /end FUNCTION_LIST /begin REF_CHARACTERISTIC /end REF_CHARACTERISTIC /begin REF_MEASUREMENT SrlComInput.HaLFFuncPresent.Cnt_lgc /end REF_MEASUREMENT /end GROUP
/begin GROUP SrlComInput.HaLFIntSystemFltActive.Cnt_lgc "MICROSAR RTE" /begin SUB_GROUP /end SUB_GROUP /begin FUNCTION_LIST /end FUNCTION_LIST /begin REF_CHARACTERISTIC /end REF_CHARACTERISTIC /begin REF_MEASUREMENT SrlComInput.HaLFIntSystemFltActive.Cnt_lgc /end REF_MEASUREMENT /end GROUP
/begin GROUP SrlComInput.HaLFSWATrqFail.Cnt_lgc "MICROSAR RTE" /begin SUB_GROUP /end SUB_GROUP /begin FUNCTION_LIST /end FUNCTION_LIST /begin REF_CHARACTERISTIC /end REF_CHARACTERISTIC /begin REF_MEASUREMENT SrlComInput.HaLFSWATrqFail.Cnt_lgc /end REF_MEASUREMENT /end GROUP
/begin GROUP SrlComInput.HaLFState.Cnt_u08 "MICROSAR RTE" /begin SUB_GROUP /end SUB_GROUP /begin FUNCTION_LIST /end FUNCTION_LIST /begin REF_CHARACTERISTIC /end REF_CHARACTERISTIC /begin REF_MEASUREMENT SrlComInput.HaLFState.Cnt_u08 /end REF_MEASUREMENT /end GROUP
/begin GROUP SrlComInput.HaLFSuspend.Cnt_lgc "MICROSAR RTE" /begin SUB_GROUP /end SUB_GROUP /begin FUNCTION_LIST /end FUNCTION_LIST /begin REF_CHARACTERISTIC /end REF_CHARACTERISTIC /begin REF_MEASUREMENT SrlComInput.HaLFSuspend.Cnt_lgc /end REF_MEASUREMENT /end GROUP
/begin GROUP SrlComInput.HaLFTrqOvCmdRqst.MtrNm_f32 "MICROSAR RTE" /begin SUB_GROUP /end SUB_GROUP /begin FUNCTION_LIST /end FUNCTION_LIST /begin REF_CHARACTERISTIC /end REF_CHARACTERISTIC /begin REF_MEASUREMENT SrlComInput.HaLFTrqOvCmdRqst.MtrNm_f32 /end REF_MEASUREMENT /end GROUP
/begin GROUP SrlComInput.HalfTrqOvRvrsGearEngage.Cnt_lgc "MICROSAR RTE" /begin SUB_GROUP /end SUB_GROUP /begin FUNCTION_LIST /end FUNCTION_LIST /begin REF_CHARACTERISTIC /end REF_CHARACTERISTIC /begin REF_MEASUREMENT SrlComInput.HalfTrqOvRvrsGearEngage.Cnt_lgc /end REF_MEASUREMENT /end GROUP
/begin GROUP SrlComInput.HandsOnDetect.Cnt_lgc "MICROSAR RTE" /begin SUB_GROUP /end SUB_GROUP /begin FUNCTION_LIST /end FUNCTION_LIST /begin REF_CHARACTERISTIC /end REF_CHARACTERISTIC /begin REF_MEASUREMENT SrlComInput.HandsOnDetect.Cnt_lgc /end REF_MEASUREMENT /end GROUP
/begin GROUP SrlComInput.IWSSCalcVspd.Kph_f32 "MICROSAR RTE" /begin SUB_GROUP /end SUB_GROUP /begin FUNCTION_LIST /end FUNCTION_LIST /begin REF_CHARACTERISTIC /end REF_CHARACTERISTIC /begin REF_MEASUREMENT SrlComInput.IWSSCalcVspd.Kph_f32 /end REF_MEASUREMENT /end GROUP
/begin GROUP SrlComInput.MEC.Cnt_enum "MICROSAR RTE" /begin SUB_GROUP /end SUB_GROUP /begin FUNCTION_LIST /end FUNCTION_LIST /begin REF_CHARACTERISTIC /end REF_CHARACTERISTIC /begin REF_MEASUREMENT SrlComInput.MEC.Cnt_enum /end REF_MEASUREMENT /end GROUP
/begin GROUP SrlComInput.ModeRequirePorts "MICROSAR RTE" /begin SUB_GROUP SrlComInput.SystemState.Mode /end SUB_GROUP /begin FUNCTION_LIST /end FUNCTION_LIST /begin REF_CHARACTERISTIC /end REF_CHARACTERISTIC /begin REF_MEASUREMENT /end REF_MEASUREMENT /end GROUP
/begin GROUP SrlComInput.NET_CFG_STAT_PT.Cnt_u16 "MICROSAR RTE" /begin SUB_GROUP /end SUB_GROUP /begin FUNCTION_LIST /end FUNCTION_LIST /begin REF_CHARACTERISTIC /end REF_CHARACTERISTIC /begin REF_MEASUREMENT SrlComInput.NET_CFG_STAT_PT.Cnt_u16 /end REF_MEASUREMENT /end GROUP
/begin GROUP SrlComInput.PABoostCurveSwitch.Cnt_lgc "MICROSAR RTE" /begin SUB_GROUP /end SUB_GROUP /begin FUNCTION_LIST /end FUNCTION_LIST /begin REF_CHARACTERISTIC /end REF_CHARACTERISTIC /begin REF_MEASUREMENT SrlComInput.PABoostCurveSwitch.Cnt_lgc /end REF_MEASUREMENT /end GROUP
/begin GROUP SrlComInput.PAEnableRqst.Cnt_lgc "MICROSAR RTE" /begin SUB_GROUP /end SUB_GROUP /begin FUNCTION_LIST /end FUNCTION_LIST /begin REF_CHARACTERISTIC /end REF_CHARACTERISTIC /begin REF_MEASUREMENT SrlComInput.PAEnableRqst.Cnt_lgc /end REF_MEASUREMENT /end GROUP
/begin GROUP SrlComInput.PAErrInterfaceActive.Cnt_lgc "MICROSAR RTE" /begin SUB_GROUP /end SUB_GROUP /begin FUNCTION_LIST /end FUNCTION_LIST /begin REF_CHARACTERISTIC /end REF_CHARACTERISTIC /begin REF_MEASUREMENT SrlComInput.PAErrInterfaceActive.Cnt_lgc /end REF_MEASUREMENT /end GROUP
/begin GROUP SrlComInput.PAExtSystemFltActive.Cnt_lgc "MICROSAR RTE" /begin SUB_GROUP /end SUB_GROUP /begin FUNCTION_LIST /end FUNCTION_LIST /begin REF_CHARACTERISTIC /end REF_CHARACTERISTIC /begin REF_MEASUREMENT SrlComInput.PAExtSystemFltActive.Cnt_lgc /end REF_MEASUREMENT /end GROUP
/begin GROUP SrlComInput.PAIntSystemFltActive.Cnt_lgc "MICROSAR RTE" /begin SUB_GROUP /end SUB_GROUP /begin FUNCTION_LIST /end FUNCTION_LIST /begin REF_CHARACTERISTIC /end REF_CHARACTERISTIC /begin REF_MEASUREMENT SrlComInput.PAIntSystemFltActive.Cnt_lgc /end REF_MEASUREMENT /end GROUP
/begin GROUP SrlComInput.PAManoeuvrePhase.Cnt_u08 "MICROSAR RTE" /begin SUB_GROUP /end SUB_GROUP /begin FUNCTION_LIST /end FUNCTION_LIST /begin REF_CHARACTERISTIC /end REF_CHARACTERISTIC /begin REF_MEASUREMENT SrlComInput.PAManoeuvrePhase.Cnt_u08 /end REF_MEASUREMENT /end GROUP
/begin GROUP SrlComInput.PATrqOvCmdRqst.HwNm_f32 "MICROSAR RTE" /begin SUB_GROUP /end SUB_GROUP /begin FUNCTION_LIST /end FUNCTION_LIST /begin REF_CHARACTERISTIC /end REF_CHARACTERISTIC /begin REF_MEASUREMENT SrlComInput.PATrqOvCmdRqst.HwNm_f32 /end REF_MEASUREMENT /end GROUP
/begin GROUP SrlComInput.PAWheelCriteriaMet.Cnt_lgc "MICROSAR RTE" /begin SUB_GROUP /end SUB_GROUP /begin FUNCTION_LIST /end FUNCTION_LIST /begin REF_CHARACTERISTIC /end REF_CHARACTERISTIC /begin REF_MEASUREMENT SrlComInput.PAWheelCriteriaMet.Cnt_lgc /end REF_MEASUREMENT /end GROUP
/begin GROUP SrlComInput.PAWhlDirRLStat.Cnt_u08 "MICROSAR RTE" /begin SUB_GROUP /end SUB_GROUP /begin FUNCTION_LIST /end FUNCTION_LIST /begin REF_CHARACTERISTIC /end REF_CHARACTERISTIC /begin REF_MEASUREMENT SrlComInput.PAWhlDirRLStat.Cnt_u08 /end REF_MEASUREMENT /end GROUP
/begin GROUP SrlComInput.PAWhlDirRRStat.Cnt_u08 "MICROSAR RTE" /begin SUB_GROUP /end SUB_GROUP /begin FUNCTION_LIST /end FUNCTION_LIST /begin REF_CHARACTERISTIC /end REF_CHARACTERISTIC /begin REF_MEASUREMENT SrlComInput.PAWhlDirRRStat.Cnt_u08 /end REF_MEASUREMENT /end GROUP
/begin GROUP SrlComInput.PAWhlPlsCntRLValid.Cnt_lgc "MICROSAR RTE" /begin SUB_GROUP /end SUB_GROUP /begin FUNCTION_LIST /end FUNCTION_LIST /begin REF_CHARACTERISTIC /end REF_CHARACTERISTIC /begin REF_MEASUREMENT SrlComInput.PAWhlPlsCntRLValid.Cnt_lgc /end REF_MEASUREMENT /end GROUP
/begin GROUP SrlComInput.PAWhlPlsCntRRValid.Cnt_lgc "MICROSAR RTE" /begin SUB_GROUP /end SUB_GROUP /begin FUNCTION_LIST /end FUNCTION_LIST /begin REF_CHARACTERISTIC /end REF_CHARACTERISTIC /begin REF_MEASUREMENT SrlComInput.PAWhlPlsCntRRValid.Cnt_lgc /end REF_MEASUREMENT /end GROUP
/begin GROUP SrlComInput.PrevHaLFEnableRqst.Cnt_lgc "MICROSAR RTE" /begin SUB_GROUP /end SUB_GROUP /begin FUNCTION_LIST /end FUNCTION_LIST /begin REF_CHARACTERISTIC /end REF_CHARACTERISTIC /begin REF_MEASUREMENT SrlComInput.PrevHaLFEnableRqst.Cnt_lgc /end REF_MEASUREMENT /end GROUP
/begin GROUP SrlComInput.PrevHaLFTrqOvCmdRqst.MtrNm_f32 "MICROSAR RTE" /begin SUB_GROUP /end SUB_GROUP /begin FUNCTION_LIST /end FUNCTION_LIST /begin REF_CHARACTERISTIC /end REF_CHARACTERISTIC /begin REF_MEASUREMENT SrlComInput.PrevHaLFTrqOvCmdRqst.MtrNm_f32 /end REF_MEASUREMENT /end GROUP
/begin GROUP SrlComInput.PrkAssistState.Cnt_u08 "MICROSAR RTE" /begin SUB_GROUP /end SUB_GROUP /begin FUNCTION_LIST /end FUNCTION_LIST /begin REF_CHARACTERISTIC /end REF_CHARACTERISTIC /begin REF_MEASUREMENT SrlComInput.PrkAssistState.Cnt_u08 /end REF_MEASUREMENT /end GROUP
/begin GROUP SrlComInput.PrkAssistSuspend.Cnt_lgc "MICROSAR RTE" /begin SUB_GROUP /end SUB_GROUP /begin FUNCTION_LIST /end FUNCTION_LIST /begin REF_CHARACTERISTIC /end REF_CHARACTERISTIC /begin REF_MEASUREMENT SrlComInput.PrkAssistSuspend.Cnt_lgc /end REF_MEASUREMENT /end GROUP
/begin GROUP SrlComInput.PrkAsstFuncPresent.Cnt_lgc "MICROSAR RTE" /begin SUB_GROUP /end SUB_GROUP /begin FUNCTION_LIST /end FUNCTION_LIST /begin REF_CHARACTERISTIC /end REF_CHARACTERISTIC /begin REF_MEASUREMENT SrlComInput.PrkAsstFuncPresent.Cnt_lgc /end REF_MEASUREMENT /end GROUP
/begin GROUP SrlComInput.ReceiverPorts "MICROSAR RTE"
 /begin SUB_GROUP SrlComInput.AnaHwTorque.HwNm_f32 SrlComInput.DSTSlewStart.Cnt_lgc SrlComInput.DSTState.Cnt_u08 SrlComInput.DefaultVehSpd.Cnt_lgc SrlComInput.EstFric.HwNm_f32 SrlComInput.HaLFState.Cnt_u08 SrlComInput.HaLFSuspend.Cnt_lgc SrlComInput.HandsOnDetect.Cnt_lgc SrlComInput.MEC.Cnt_enum SrlComInput.PABoostCurveSwitch.Cnt_lgc SrlComInput.PrkAssistState.Cnt_u08 SrlComInput.PrkAssistSuspend.Cnt_lgc SrlComInput.RxMsgsSrlComSvcDft.Cnt_lgc SrlComInput.StrClmTrq.HwNm_f32 /end SUB_GROUP
 /begin FUNCTION_LIST /end FUNCTION_LIST
 /begin REF_CHARACTERISTIC /end REF_CHARACTERISTIC
 /begin REF_MEASUREMENT /end REF_MEASUREMENT
/end GROUP
/begin GROUP SrlComInput.RxMsgsSrlComSvcDft.Cnt_lgc "MICROSAR RTE" /begin SUB_GROUP /end SUB_GROUP /begin FUNCTION_LIST /end FUNCTION_LIST /begin REF_CHARACTERISTIC /end REF_CHARACTERISTIC /begin REF_MEASUREMENT SrlComInput.RxMsgsSrlComSvcDft.Cnt_lgc /end REF_MEASUREMENT /end GROUP
/begin GROUP SrlComInput.SenderPorts "MICROSAR RTE"
 /begin SUB_GROUP SrlComInput.AirTempOutside.DegC_f32 SrlComInput.AmbTempAvg.DegC_f32 SrlComInput.BattVolt.Volt_f32 SrlComInput.CMDIgnStat.Cnt_u08 SrlComInput.CanMsgReceived.Cnt_lgc SrlComInput.CfgStatRQ.Cnt_u08 SrlComInput.DSTEOLDisable.Cnt_lgc SrlComInput.DSTEnableRqst.Cnt_lgc SrlComInput.DSTErrCntrRecvLevel.Cnt_u08 SrlComInput.DSTExtSystemFltActive.Cnt_lgc SrlComInput.DSTFuncPresent.Cnt_lgc SrlComInput.DSTRevGearValid.Cnt_lgc SrlComInput.DSTTOCState.Uls_enum SrlComInput.DSTTrqOvCmdRqst.HwNm_f32 SrlComInput.DSTTrqOvRqstValid.Cnt_lgc SrlComInput.DesiredTunPers.Cnt_u16 SrlComInput.DesiredTunPersTypH.Cnt_u08 SrlComInput.DesiredTunSet.Cnt_u16 SrlComInput.EPS_Mode_Req.Cnt_u08 SrlComInput.EngOilTemp.DegC_f32 SrlComInput.EngRPM.Cnt_u16 SrlComInput.EssEngStop.Cnt_lgc SrlComInput.HaLFEnableRqst.Cnt_lgc SrlComInput.HaLFErrInterfaceActive.Cnt_lgc SrlComInput.HaLFExtSystemFltActive.Cnt_lgc SrlComInput.HaLFFuncPresent.Cnt_lgc SrlComInput.HaLFIntSystemFltActive.Cnt_lgc SrlComInput.HaLFSWATrqFail.Cnt_lgc SrlComInput.HaLFTrqOvCmdRqst.MtrNm_f32 SrlComInput.HalfTrqOvRvrsGearEngage.Cnt_lgc SrlComInput.IWSSCalcVspd.Kph_f32 SrlComInput.NET_CFG_STAT_PT.Cnt_u16 SrlComInput.PAEnableRqst.Cnt_lgc SrlComInput.PAErrInterfaceActive.Cnt_lgc SrlComInput.PAExtSystemFltActive.Cnt_lgc SrlComInput.PAIntSystemFltActive.Cnt_lgc SrlComInput.PAManoeuvrePhase.Cnt_u08 SrlComInput.PATrqOvCmdRqst.HwNm_f32 SrlComInput.PAWheelCriteriaMet.Cnt_lgc SrlComInput.PAWhlDirRLStat.Cnt_u08 SrlComInput.PAWhlDirRRStat.Cnt_u08 SrlComInput.PAWhlPlsCntRLValid.Cnt_lgc SrlComInput.PAWhlPlsCntRRValid.Cnt_lgc SrlComInput.PrevHaLFEnableRqst.Cnt_lgc SrlComInput.PrevHaLFTrqOvCmdRqst.MtrNm_f32 SrlComInput.PrkAsstFuncPresent.Cnt_lgc SrlComInput.SpStPrsnt.Cnt_lgc SrlComInput.SrlComLWhlSpdVld.Cnt_lgc SrlComInput.SrlComRWhlSpdVld.Cnt_lgc SrlComInput.SrlComVehSpd.Kph_f32 SrlComInput.SrlComVehSpdValid.Cnt_lgc SrlComInput.StrgWhlAngl.HwDeg_f32 SrlComInput.StrgWhlAnglValid.Cnt_lgc SrlComInput.TrqOvReverseGearEngage.Cnt_lgc SrlComInput.VCBodyStyle.Cnt_u08 SrlComInput.VCCountry.Cnt_u08 SrlComInput.VCModelYear.Cnt_u08 SrlComInput.VCVehLine.Cnt_u08 /end SUB_GROUP
 /begin FUNCTION_LIST /end FUNCTION_LIST
 /begin REF_CHARACTERISTIC /end REF_CHARACTERISTIC
 /begin REF_MEASUREMENT /end REF_MEASUREMENT
/end GROUP
/begin GROUP SrlComInput.SpStPrsnt.Cnt_lgc "MICROSAR RTE" /begin SUB_GROUP /end SUB_GROUP /begin FUNCTION_LIST /end FUNCTION_LIST /begin REF_CHARACTERISTIC /end REF_CHARACTERISTIC /begin REF_MEASUREMENT SrlComInput.SpStPrsnt.Cnt_lgc /end REF_MEASUREMENT /end GROUP
/begin GROUP SrlComInput.SrlComLWhlSpdVld.Cnt_lgc "MICROSAR RTE" /begin SUB_GROUP /end SUB_GROUP /begin FUNCTION_LIST /end FUNCTION_LIST /begin REF_CHARACTERISTIC /end REF_CHARACTERISTIC /begin REF_MEASUREMENT SrlComInput.SrlComLWhlSpdVld.Cnt_lgc /end REF_MEASUREMENT /end GROUP
/begin GROUP SrlComInput.SrlComRWhlSpdVld.Cnt_lgc "MICROSAR RTE" /begin SUB_GROUP /end SUB_GROUP /begin FUNCTION_LIST /end FUNCTION_LIST /begin REF_CHARACTERISTIC /end REF_CHARACTERISTIC /begin REF_MEASUREMENT SrlComInput.SrlComRWhlSpdVld.Cnt_lgc /end REF_MEASUREMENT /end GROUP
/begin GROUP SrlComInput.SrlComVehSpd.Kph_f32 "MICROSAR RTE" /begin SUB_GROUP /end SUB_GROUP /begin FUNCTION_LIST /end FUNCTION_LIST /begin REF_CHARACTERISTIC /end REF_CHARACTERISTIC /begin REF_MEASUREMENT SrlComInput.SrlComVehSpd.Kph_f32 /end REF_MEASUREMENT /end GROUP
/begin GROUP SrlComInput.SrlComVehSpdValid.Cnt_lgc "MICROSAR RTE" /begin SUB_GROUP /end SUB_GROUP /begin FUNCTION_LIST /end FUNCTION_LIST /begin REF_CHARACTERISTIC /end REF_CHARACTERISTIC /begin REF_MEASUREMENT SrlComInput.SrlComVehSpdValid.Cnt_lgc /end REF_MEASUREMENT /end GROUP
/begin GROUP SrlComInput.StrClmTrq.HwNm_f32 "MICROSAR RTE" /begin SUB_GROUP /end SUB_GROUP /begin FUNCTION_LIST /end FUNCTION_LIST /begin REF_CHARACTERISTIC /end REF_CHARACTERISTIC /begin REF_MEASUREMENT SrlComInput.StrClmTrq.HwNm_f32 /end REF_MEASUREMENT /end GROUP
/begin GROUP SrlComInput.StrgWhlAngl.HwDeg_f32 "MICROSAR RTE" /begin SUB_GROUP /end SUB_GROUP /begin FUNCTION_LIST /end FUNCTION_LIST /begin REF_CHARACTERISTIC /end REF_CHARACTERISTIC /begin REF_MEASUREMENT SrlComInput.StrgWhlAngl.HwDeg_f32 /end REF_MEASUREMENT /end GROUP
/begin GROUP SrlComInput.StrgWhlAnglValid.Cnt_lgc "MICROSAR RTE" /begin SUB_GROUP /end SUB_GROUP /begin FUNCTION_LIST /end FUNCTION_LIST /begin REF_CHARACTERISTIC /end REF_CHARACTERISTIC /begin REF_MEASUREMENT SrlComInput.StrgWhlAnglValid.Cnt_lgc /end REF_MEASUREMENT /end GROUP
/begin GROUP SrlComInput.SystemState.Mode "MICROSAR RTE" /begin SUB_GROUP /end SUB_GROUP /begin FUNCTION_LIST /end FUNCTION_LIST /begin REF_CHARACTERISTIC /end REF_CHARACTERISTIC /begin REF_MEASUREMENT SrlComInput.SystemState.Mode /end REF_MEASUREMENT /end GROUP
/begin GROUP SrlComInput.TrqOvReverseGearEngage.Cnt_lgc "MICROSAR RTE" /begin SUB_GROUP /end SUB_GROUP /begin FUNCTION_LIST /end FUNCTION_LIST /begin REF_CHARACTERISTIC /end REF_CHARACTERISTIC /begin REF_MEASUREMENT SrlComInput.TrqOvReverseGearEngage.Cnt_lgc /end REF_MEASUREMENT /end GROUP
/begin GROUP SrlComInput.VCBodyStyle.Cnt_u08 "MICROSAR RTE" /begin SUB_GROUP /end SUB_GROUP /begin FUNCTION_LIST /end FUNCTION_LIST /begin REF_CHARACTERISTIC /end REF_CHARACTERISTIC /begin REF_MEASUREMENT SrlComInput.VCBodyStyle.Cnt_u08 /end REF_MEASUREMENT /end GROUP
/begin GROUP SrlComInput.VCCountry.Cnt_u08 "MICROSAR RTE" /begin SUB_GROUP /end SUB_GROUP /begin FUNCTION_LIST /end FUNCTION_LIST /begin REF_CHARACTERISTIC /end REF_CHARACTERISTIC /begin REF_MEASUREMENT SrlComInput.VCCountry.Cnt_u08 /end REF_MEASUREMENT /end GROUP
/begin GROUP SrlComInput.VCModelYear.Cnt_u08 "MICROSAR RTE" /begin SUB_GROUP /end SUB_GROUP /begin FUNCTION_LIST /end FUNCTION_LIST /begin REF_CHARACTERISTIC /end REF_CHARACTERISTIC /begin REF_MEASUREMENT SrlComInput.VCModelYear.Cnt_u08 /end REF_MEASUREMENT /end GROUP
/begin GROUP SrlComInput.VCVehLine.Cnt_u08 "MICROSAR RTE" /begin SUB_GROUP /end SUB_GROUP /begin FUNCTION_LIST /end FUNCTION_LIST /begin REF_CHARACTERISTIC /end REF_CHARACTERISTIC /begin REF_MEASUREMENT SrlComInput.VCVehLine.Cnt_u08 /end REF_MEASUREMENT /end GROUP
/begin GROUP SrlComOutput "MICROSAR RTE" /begin SUB_GROUP SrlComOutput.ModeRequirePorts SrlComOutput.ReceiverPorts /end SUB_GROUP /begin FUNCTION_LIST /end FUNCTION_LIST /begin REF_CHARACTERISTIC /end REF_CHARACTERISTIC /begin REF_MEASUREMENT /end REF_MEASUREMENT /end GROUP
/begin GROUP SrlComOutput.ATermActive.Cnt_lgc "MICROSAR RTE" /begin SUB_GROUP /end SUB_GROUP /begin FUNCTION_LIST /end FUNCTION_LIST /begin REF_CHARACTERISTIC /end REF_CHARACTERISTIC /begin REF_MEASUREMENT SrlComOutput.ATermActive.Cnt_lgc /end REF_MEASUREMENT /end GROUP
/begin GROUP SrlComOutput.ActiveFunctionBits.Cnt_u08 "MICROSAR RTE" /begin SUB_GROUP /end SUB_GROUP /begin FUNCTION_LIST /end FUNCTION_LIST /begin REF_CHARACTERISTIC /end REF_CHARACTERISTIC /begin REF_MEASUREMENT SrlComOutput.ActiveFunctionBits.Cnt_u08 /end REF_MEASUREMENT /end GROUP
/begin GROUP SrlComOutput.ActiveTunSet.Cnt_u16 "MICROSAR RTE" /begin SUB_GROUP /end SUB_GROUP /begin FUNCTION_LIST /end FUNCTION_LIST /begin REF_CHARACTERISTIC /end REF_CHARACTERISTIC /begin REF_MEASUREMENT SrlComOutput.ActiveTunSet.Cnt_u16 /end REF_MEASUREMENT /end GROUP
/begin GROUP SrlComOutput.CFG_STAT_RQ.Cnt_u08 "MICROSAR RTE" /begin SUB_GROUP /end SUB_GROUP /begin FUNCTION_LIST /end FUNCTION_LIST /begin REF_CHARACTERISTIC /end REF_CHARACTERISTIC /begin REF_MEASUREMENT SrlComOutput.CFG_STAT_RQ.Cnt_u08 /end REF_MEASUREMENT /end GROUP
/begin GROUP SrlComOutput.CRFMtrTrqCmd.MtrNm_f32 "MICROSAR RTE" /begin SUB_GROUP /end SUB_GROUP /begin FUNCTION_LIST /end FUNCTION_LIST /begin REF_CHARACTERISTIC /end REF_CHARACTERISTIC /begin REF_MEASUREMENT SrlComOutput.CRFMtrTrqCmd.MtrNm_f32 /end REF_MEASUREMENT /end GROUP
/begin GROUP SrlComOutput.CTermActive.Cnt_lgc "MICROSAR RTE" /begin SUB_GROUP /end SUB_GROUP /begin FUNCTION_LIST /end FUNCTION_LIST /begin REF_CHARACTERISTIC /end REF_CHARACTERISTIC /begin REF_MEASUREMENT SrlComOutput.CTermActive.Cnt_lgc /end REF_MEASUREMENT /end GROUP
/begin GROUP SrlComOutput.CanMsgReceived.Cnt_lgc "MICROSAR RTE" /begin SUB_GROUP /end SUB_GROUP /begin FUNCTION_LIST /end FUNCTION_LIST /begin REF_CHARACTERISTIC /end REF_CHARACTERISTIC /begin REF_MEASUREMENT SrlComOutput.CanMsgReceived.Cnt_lgc /end REF_MEASUREMENT /end GROUP
/begin GROUP SrlComOutput.DSTEOLDisable.Cnt_lgc "MICROSAR RTE" /begin SUB_GROUP /end SUB_GROUP /begin FUNCTION_LIST /end FUNCTION_LIST /begin REF_CHARACTERISTIC /end REF_CHARACTERISTIC /begin REF_MEASUREMENT SrlComOutput.DSTEOLDisable.Cnt_lgc /end REF_MEASUREMENT /end GROUP
/begin GROUP SrlComOutput.DSTExtSystemFltActive.Cnt_lgc "MICROSAR RTE" /begin SUB_GROUP /end SUB_GROUP /begin FUNCTION_LIST /end FUNCTION_LIST /begin REF_CHARACTERISTIC /end REF_CHARACTERISTIC /begin REF_MEASUREMENT SrlComOutput.DSTExtSystemFltActive.Cnt_lgc /end REF_MEASUREMENT /end GROUP
/begin GROUP SrlComOutput.DSTState.Cnt_u08 "MICROSAR RTE" /begin SUB_GROUP /end SUB_GROUP /begin FUNCTION_LIST /end FUNCTION_LIST /begin REF_CHARACTERISTIC /end REF_CHARACTERISTIC /begin REF_MEASUREMENT SrlComOutput.DSTState.Cnt_u08 /end REF_MEASUREMENT /end GROUP
/begin GROUP SrlComOutput.DesiredTunPers.Cnt_u16 "MICROSAR RTE" /begin SUB_GROUP /end SUB_GROUP /begin FUNCTION_LIST /end FUNCTION_LIST /begin REF_CHARACTERISTIC /end REF_CHARACTERISTIC /begin REF_MEASUREMENT SrlComOutput.DesiredTunPers.Cnt_u16 /end REF_MEASUREMENT /end GROUP
/begin GROUP SrlComOutput.DesiredTunPersTypH.Cnt_u08 "MICROSAR RTE" /begin SUB_GROUP /end SUB_GROUP /begin FUNCTION_LIST /end FUNCTION_LIST /begin REF_CHARACTERISTIC /end REF_CHARACTERISTIC /begin REF_MEASUREMENT SrlComOutput.DesiredTunPersTypH.Cnt_u08 /end REF_MEASUREMENT /end GROUP
/begin GROUP SrlComOutput.DiagStsNonRecRmpToZeroFltPres.Cnt_lgc "MICROSAR RTE" /begin SUB_GROUP /end SUB_GROUP /begin FUNCTION_LIST /end FUNCTION_LIST /begin REF_CHARACTERISTIC /end REF_CHARACTERISTIC /begin REF_MEASUREMENT SrlComOutput.DiagStsNonRecRmpToZeroFltPres.Cnt_lgc /end REF_MEASUREMENT /end GROUP
/begin GROUP SrlComOutput.DiagStsRecRmpToZeroFltPres.Cnt_lgc "MICROSAR RTE" /begin SUB_GROUP /end SUB_GROUP /begin FUNCTION_LIST /end FUNCTION_LIST /begin REF_CHARACTERISTIC /end REF_CHARACTERISTIC /begin REF_MEASUREMENT SrlComOutput.DiagStsRecRmpToZeroFltPres.Cnt_lgc /end REF_MEASUREMENT /end GROUP
/begin GROUP SrlComOutput.EPS_MODE_REQ.Cnt_u08 "MICROSAR RTE" /begin SUB_GROUP /end SUB_GROUP /begin FUNCTION_LIST /end FUNCTION_LIST /begin REF_CHARACTERISTIC /end REF_CHARACTERISTIC /begin REF_MEASUREMENT SrlComOutput.EPS_MODE_REQ.Cnt_u08 /end REF_MEASUREMENT /end GROUP
/begin GROUP SrlComOutput.EngRPM.Cnt_u16 "MICROSAR RTE" /begin SUB_GROUP /end SUB_GROUP /begin FUNCTION_LIST /end FUNCTION_LIST /begin REF_CHARACTERISTIC /end REF_CHARACTERISTIC /begin REF_MEASUREMENT SrlComOutput.EngRPM.Cnt_u16 /end REF_MEASUREMENT /end GROUP
/begin GROUP SrlComOutput.HaLFState.Cnt_u08 "MICROSAR RTE" /begin SUB_GROUP /end SUB_GROUP /begin FUNCTION_LIST /end FUNCTION_LIST /begin REF_CHARACTERISTIC /end REF_CHARACTERISTIC /begin REF_MEASUREMENT SrlComOutput.HaLFState.Cnt_u08 /end REF_MEASUREMENT /end GROUP
/begin GROUP SrlComOutput.HaLFSuspend.Cnt_lgc "MICROSAR RTE" /begin SUB_GROUP /end SUB_GROUP /begin FUNCTION_LIST /end FUNCTION_LIST /begin REF_CHARACTERISTIC /end REF_CHARACTERISTIC /begin REF_MEASUREMENT SrlComOutput.HaLFSuspend.Cnt_lgc /end REF_MEASUREMENT /end GROUP
/begin GROUP SrlComOutput.HandsOnDetect.Cnt_lgc "MICROSAR RTE" /begin SUB_GROUP /end SUB_GROUP /begin FUNCTION_LIST /end FUNCTION_LIST /begin REF_CHARACTERISTIC /end REF_CHARACTERISTIC /begin REF_MEASUREMENT SrlComOutput.HandsOnDetect.Cnt_lgc /end REF_MEASUREMENT /end GROUP
/begin GROUP SrlComOutput.HwTrq.HwNm_f32 "MICROSAR RTE" /begin SUB_GROUP /end SUB_GROUP /begin FUNCTION_LIST /end FUNCTION_LIST /begin REF_CHARACTERISTIC /end REF_CHARACTERISTIC /begin REF_MEASUREMENT SrlComOutput.HwTrq.HwNm_f32 /end REF_MEASUREMENT /end GROUP
/begin GROUP SrlComOutput.ModeRequirePorts "MICROSAR RTE" /begin SUB_GROUP SrlComOutput.SystemState.Mode /end SUB_GROUP /begin FUNCTION_LIST /end FUNCTION_LIST /begin REF_CHARACTERISTIC /end REF_CHARACTERISTIC /begin REF_MEASUREMENT /end REF_MEASUREMENT /end GROUP
/begin GROUP SrlComOutput.PrkAssistState.Cnt_u08 "MICROSAR RTE" /begin SUB_GROUP /end SUB_GROUP /begin FUNCTION_LIST /end FUNCTION_LIST /begin REF_CHARACTERISTIC /end REF_CHARACTERISTIC /begin REF_MEASUREMENT SrlComOutput.PrkAssistState.Cnt_u08 /end REF_MEASUREMENT /end GROUP
/begin GROUP SrlComOutput.PrkAssistSuspend.Cnt_lgc "MICROSAR RTE" /begin SUB_GROUP /end SUB_GROUP /begin FUNCTION_LIST /end FUNCTION_LIST /begin REF_CHARACTERISTIC /end REF_CHARACTERISTIC /begin REF_MEASUREMENT SrlComOutput.PrkAssistSuspend.Cnt_lgc /end REF_MEASUREMENT /end GROUP
/begin GROUP SrlComOutput.RampDwnStatusComplete.Cnt_lgc "MICROSAR RTE" /begin SUB_GROUP /end SUB_GROUP /begin FUNCTION_LIST /end FUNCTION_LIST /begin REF_CHARACTERISTIC /end REF_CHARACTERISTIC /begin REF_MEASUREMENT SrlComOutput.RampDwnStatusComplete.Cnt_lgc /end REF_MEASUREMENT /end GROUP
/begin GROUP SrlComOutput.ReceiverPorts "MICROSAR RTE"
 /begin SUB_GROUP SrlComOutput.ATermActive.Cnt_lgc SrlComOutput.ActiveFunctionBits.Cnt_u08 SrlComOutput.ActiveTunSet.Cnt_u16 SrlComOutput.CFG_STAT_RQ.Cnt_u08 SrlComOutput.CRFMtrTrqCmd.MtrNm_f32 SrlComOutput.CTermActive.Cnt_lgc SrlComOutput.CanMsgReceived.Cnt_lgc SrlComOutput.DSTEOLDisable.Cnt_lgc SrlComOutput.DSTExtSystemFltActive.Cnt_lgc SrlComOutput.DSTState.Cnt_u08 SrlComOutput.DesiredTunPers.Cnt_u16 SrlComOutput.DesiredTunPersTypH.Cnt_u08 SrlComOutput.DiagStsNonRecRmpToZeroFltPres.Cnt_lgc SrlComOutput.DiagStsRecRmpToZeroFltPres.Cnt_lgc SrlComOutput.EPS_MODE_REQ.Cnt_u08 SrlComOutput.EngRPM.Cnt_u16 SrlComOutput.HaLFState.Cnt_u08 SrlComOutput.HaLFSuspend.Cnt_lgc SrlComOutput.HandsOnDetect.Cnt_lgc SrlComOutput.HwTrq.HwNm_f32 SrlComOutput.PrkAssistState.Cnt_u08 SrlComOutput.PrkAssistSuspend.Cnt_lgc SrlComOutput.RampDwnStatusComplete.Cnt_lgc SrlComOutput.SpStPrsnt.Cnt_lgc SrlComOutput.SrlComHwTrqValid.Cnt_lgc SrlComOutput.SrlComVehSpdValid.Cnt_lgc SrlComOutput.SumLmtTrqCmd.MtrNm_f32 SrlComOutput.SupplyCurrent.Amp_f32 SrlComOutput.VehicleSpeed.Kph_f32 /end SUB_GROUP
 /begin FUNCTION_LIST /end FUNCTION_LIST
 /begin REF_CHARACTERISTIC /end REF_CHARACTERISTIC
 /begin REF_MEASUREMENT /end REF_MEASUREMENT
/end GROUP
/begin GROUP SrlComOutput.SpStPrsnt.Cnt_lgc "MICROSAR RTE" /begin SUB_GROUP /end SUB_GROUP /begin FUNCTION_LIST /end FUNCTION_LIST /begin REF_CHARACTERISTIC /end REF_CHARACTERISTIC /begin REF_MEASUREMENT SrlComOutput.SpStPrsnt.Cnt_lgc /end REF_MEASUREMENT /end GROUP
/begin GROUP SrlComOutput.SrlComHwTrqValid.Cnt_lgc "MICROSAR RTE" /begin SUB_GROUP /end SUB_GROUP /begin FUNCTION_LIST /end FUNCTION_LIST /begin REF_CHARACTERISTIC /end REF_CHARACTERISTIC /begin REF_MEASUREMENT SrlComOutput.SrlComHwTrqValid.Cnt_lgc /end REF_MEASUREMENT /end GROUP
/begin GROUP SrlComOutput.SrlComVehSpdValid.Cnt_lgc "MICROSAR RTE" /begin SUB_GROUP /end SUB_GROUP /begin FUNCTION_LIST /end FUNCTION_LIST /begin REF_CHARACTERISTIC /end REF_CHARACTERISTIC /begin REF_MEASUREMENT SrlComOutput.SrlComVehSpdValid.Cnt_lgc /end REF_MEASUREMENT /end GROUP
/begin GROUP SrlComOutput.SumLmtTrqCmd.MtrNm_f32 "MICROSAR RTE" /begin SUB_GROUP /end SUB_GROUP /begin FUNCTION_LIST /end FUNCTION_LIST /begin REF_CHARACTERISTIC /end REF_CHARACTERISTIC /begin REF_MEASUREMENT SrlComOutput.SumLmtTrqCmd.MtrNm_f32 /end REF_MEASUREMENT /end GROUP
/begin GROUP SrlComOutput.SupplyCurrent.Amp_f32 "MICROSAR RTE" /begin SUB_GROUP /end SUB_GROUP /begin FUNCTION_LIST /end FUNCTION_LIST /begin REF_CHARACTERISTIC /end REF_CHARACTERISTIC /begin REF_MEASUREMENT SrlComOutput.SupplyCurrent.Amp_f32 /end REF_MEASUREMENT /end GROUP
/begin GROUP SrlComOutput.SystemState.Mode "MICROSAR RTE" /begin SUB_GROUP /end SUB_GROUP /begin FUNCTION_LIST /end FUNCTION_LIST /begin REF_CHARACTERISTIC /end REF_CHARACTERISTIC /begin REF_MEASUREMENT SrlComOutput.SystemState.Mode /end REF_MEASUREMENT /end GROUP
/begin GROUP SrlComOutput.VehicleSpeed.Kph_f32 "MICROSAR RTE" /begin SUB_GROUP /end SUB_GROUP /begin FUNCTION_LIST /end FUNCTION_LIST /begin REF_CHARACTERISTIC /end REF_CHARACTERISTIC /begin REF_MEASUREMENT SrlComOutput.VehicleSpeed.Kph_f32 /end REF_MEASUREMENT /end GROUP
/begin GROUP StOpCtrl "MICROSAR RTE" /begin SUB_GROUP StOpCtrl.ReceiverPorts StOpCtrl.SenderPorts /end SUB_GROUP /begin FUNCTION_LIST /end FUNCTION_LIST /begin REF_CHARACTERISTIC /end REF_CHARACTERISTIC /begin REF_MEASUREMENT /end REF_MEASUREMENT /end GROUP
/begin GROUP StOpCtrl.DiagRampRate.XpmS_f32 "MICROSAR RTE" /begin SUB_GROUP /end SUB_GROUP /begin FUNCTION_LIST /end FUNCTION_LIST /begin REF_CHARACTERISTIC /end REF_CHARACTERISTIC /begin REF_MEASUREMENT StOpCtrl.DiagRampRate.XpmS_f32 /end REF_MEASUREMENT /end GROUP
/begin GROUP StOpCtrl.DiagRampValue.Uls_f32 "MICROSAR RTE" /begin SUB_GROUP /end SUB_GROUP /begin FUNCTION_LIST /end FUNCTION_LIST /begin REF_CHARACTERISTIC /end REF_CHARACTERISTIC /begin REF_MEASUREMENT StOpCtrl.DiagRampValue.Uls_f32 /end REF_MEASUREMENT /end GROUP
/begin GROUP StOpCtrl.DiagStsDiagRmpActive.Cnt_lgc "MICROSAR RTE" /begin SUB_GROUP /end SUB_GROUP /begin FUNCTION_LIST /end FUNCTION_LIST /begin REF_CHARACTERISTIC /end REF_CHARACTERISTIC /begin REF_MEASUREMENT StOpCtrl.DiagStsDiagRmpActive.Cnt_lgc /end REF_MEASUREMENT /end GROUP
/begin GROUP StOpCtrl.OperRampRate.XpmS_f32 "MICROSAR RTE" /begin SUB_GROUP /end SUB_GROUP /begin FUNCTION_LIST /end FUNCTION_LIST /begin REF_CHARACTERISTIC /end REF_CHARACTERISTIC /begin REF_MEASUREMENT StOpCtrl.OperRampRate.XpmS_f32 /end REF_MEASUREMENT /end GROUP
/begin GROUP StOpCtrl.OperRampValue.Uls_f32 "MICROSAR RTE" /begin SUB_GROUP /end SUB_GROUP /begin FUNCTION_LIST /end FUNCTION_LIST /begin REF_CHARACTERISTIC /end REF_CHARACTERISTIC /begin REF_MEASUREMENT StOpCtrl.OperRampValue.Uls_f32 /end REF_MEASUREMENT /end GROUP
/begin GROUP StOpCtrl.OutputRampMult.Uls_f32 "MICROSAR RTE" /begin SUB_GROUP /end SUB_GROUP /begin FUNCTION_LIST /end FUNCTION_LIST /begin REF_CHARACTERISTIC /end REF_CHARACTERISTIC /begin REF_MEASUREMENT StOpCtrl.OutputRampMult.Uls_f32 /end REF_MEASUREMENT /end GROUP
/begin GROUP StOpCtrl.RampDwnStatusComplete.Cnt_lgc "MICROSAR RTE" /begin SUB_GROUP /end SUB_GROUP /begin FUNCTION_LIST /end FUNCTION_LIST /begin REF_CHARACTERISTIC /end REF_CHARACTERISTIC /begin REF_MEASUREMENT StOpCtrl.RampDwnStatusComplete.Cnt_lgc /end REF_MEASUREMENT /end GROUP
/begin GROUP StOpCtrl.RampSrlComSvcDft.Cnt_lgc "MICROSAR RTE" /begin SUB_GROUP /end SUB_GROUP /begin FUNCTION_LIST /end FUNCTION_LIST /begin REF_CHARACTERISTIC /end REF_CHARACTERISTIC /begin REF_MEASUREMENT StOpCtrl.RampSrlComSvcDft.Cnt_lgc /end REF_MEASUREMENT /end GROUP
/begin GROUP StOpCtrl.ReceiverPorts "MICROSAR RTE"
 /begin SUB_GROUP StOpCtrl.DiagRampRate.XpmS_f32 StOpCtrl.DiagRampValue.Uls_f32 StOpCtrl.DiagStsDiagRmpActive.Cnt_lgc StOpCtrl.OperRampRate.XpmS_f32 StOpCtrl.OperRampValue.Uls_f32 StOpCtrl.RampSrlComSvcDft.Cnt_lgc /end SUB_GROUP
 /begin FUNCTION_LIST /end FUNCTION_LIST
 /begin REF_CHARACTERISTIC /end REF_CHARACTERISTIC
 /begin REF_MEASUREMENT /end REF_MEASUREMENT
/end GROUP
/begin GROUP StOpCtrl.SenderPorts "MICROSAR RTE"
 /begin SUB_GROUP StOpCtrl.OutputRampMult.Uls_f32 StOpCtrl.RampDwnStatusComplete.Cnt_lgc /end SUB_GROUP
 /begin FUNCTION_LIST /end FUNCTION_LIST
 /begin REF_CHARACTERISTIC /end REF_CHARACTERISTIC
 /begin REF_MEASUREMENT /end REF_MEASUREMENT
/end GROUP
/begin GROUP StaMd "MICROSAR RTE"
 /begin SUB_GROUP StaMd.ModeProvidePorts StaMd.ModeRequirePorts StaMd.ReceiverPorts /end SUB_GROUP
 /begin FUNCTION_LIST /end FUNCTION_LIST
 /begin REF_CHARACTERISTIC /end REF_CHARACTERISTIC
 /begin REF_MEASUREMENT /end REF_MEASUREMENT
/end GROUP
/begin GROUP StaMd.ATerm.Cnt_lgc "MICROSAR RTE" /begin SUB_GROUP /end SUB_GROUP /begin FUNCTION_LIST /end FUNCTION_LIST /begin REF_CHARACTERISTIC /end REF_CHARACTERISTIC /begin REF_MEASUREMENT StaMd.ATerm.Cnt_lgc /end REF_MEASUREMENT /end GROUP
/begin GROUP StaMd.CTerm.Cnt_lgc "MICROSAR RTE" /begin SUB_GROUP /end SUB_GROUP /begin FUNCTION_LIST /end FUNCTION_LIST /begin REF_CHARACTERISTIC /end REF_CHARACTERISTIC /begin REF_MEASUREMENT StaMd.CTerm.Cnt_lgc /end REF_MEASUREMENT /end GROUP
/begin GROUP StaMd.ControlledDampStatusComplete.Cnt_lgc "MICROSAR RTE" /begin SUB_GROUP /end SUB_GROUP /begin FUNCTION_LIST /end FUNCTION_LIST /begin REF_CHARACTERISTIC /end REF_CHARACTERISTIC /begin REF_MEASUREMENT StaMd.ControlledDampStatusComplete.Cnt_lgc /end REF_MEASUREMENT /end GROUP
/begin GROUP StaMd.CurrentSystemState.Mode "MICROSAR RTE" /begin SUB_GROUP /end SUB_GROUP /begin FUNCTION_LIST /end FUNCTION_LIST /begin REF_CHARACTERISTIC /end REF_CHARACTERISTIC /begin REF_MEASUREMENT StaMd.CurrentSystemState.Mode /end REF_MEASUREMENT /end GROUP
/begin GROUP StaMd.FTerm.Cnt_lgc "MICROSAR RTE" /begin SUB_GROUP /end SUB_GROUP /begin FUNCTION_LIST /end FUNCTION_LIST /begin REF_CHARACTERISTIC /end REF_CHARACTERISTIC /begin REF_MEASUREMENT StaMd.FTerm.Cnt_lgc /end REF_MEASUREMENT /end GROUP
/begin GROUP StaMd.ModeProvidePorts "MICROSAR RTE" /begin SUB_GROUP StaMd.SystemState.Mode /end SUB_GROUP /begin FUNCTION_LIST /end FUNCTION_LIST /begin REF_CHARACTERISTIC /end REF_CHARACTERISTIC /begin REF_MEASUREMENT /end REF_MEASUREMENT /end GROUP
/begin GROUP StaMd.ModeRequirePorts "MICROSAR RTE" /begin SUB_GROUP StaMd.CurrentSystemState.Mode /end SUB_GROUP /begin FUNCTION_LIST /end FUNCTION_LIST /begin REF_CHARACTERISTIC /end REF_CHARACTERISTIC /begin REF_MEASUREMENT /end REF_MEASUREMENT /end GROUP
/begin GROUP StaMd.RampStatusComplete.Cnt_lgc "MICROSAR RTE" /begin SUB_GROUP /end SUB_GROUP /begin FUNCTION_LIST /end FUNCTION_LIST /begin REF_CHARACTERISTIC /end REF_CHARACTERISTIC /begin REF_MEASUREMENT StaMd.RampStatusComplete.Cnt_lgc /end REF_MEASUREMENT /end GROUP
/begin GROUP StaMd.ReceiverPorts "MICROSAR RTE"
 /begin SUB_GROUP StaMd.ATerm.Cnt_lgc StaMd.CTerm.Cnt_lgc StaMd.ControlledDampStatusComplete.Cnt_lgc StaMd.FTerm.Cnt_lgc StaMd.RampStatusComplete.Cnt_lgc StaMd.TMFTestComplete.Cnt_lgc /end SUB_GROUP
 /begin FUNCTION_LIST /end FUNCTION_LIST
 /begin REF_CHARACTERISTIC /end REF_CHARACTERISTIC
 /begin REF_MEASUREMENT /end REF_MEASUREMENT
/end GROUP
/begin GROUP StaMd.SystemState.Mode "MICROSAR RTE" /begin SUB_GROUP /end SUB_GROUP /begin FUNCTION_LIST /end FUNCTION_LIST /begin REF_CHARACTERISTIC /end REF_CHARACTERISTIC /begin REF_MEASUREMENT StaMd.SystemState.Mode /end REF_MEASUREMENT /end GROUP
/begin GROUP StaMd.TMFTestComplete.Cnt_lgc "MICROSAR RTE" /begin SUB_GROUP /end SUB_GROUP /begin FUNCTION_LIST /end FUNCTION_LIST /begin REF_CHARACTERISTIC /end REF_CHARACTERISTIC /begin REF_MEASUREMENT StaMd.TMFTestComplete.Cnt_lgc /end REF_MEASUREMENT /end GROUP
/begin GROUP StabilityComp "MICROSAR RTE" /begin SUB_GROUP StabilityComp.ReceiverPorts StabilityComp.SenderPorts /end SUB_GROUP /begin FUNCTION_LIST /end FUNCTION_LIST /begin REF_CHARACTERISTIC /end REF_CHARACTERISTIC /begin REF_MEASUREMENT /end REF_MEASUREMENT /end GROUP
/begin GROUP StabilityComp.AssistCmd.MtrNm_f32 "MICROSAR RTE" /begin SUB_GROUP /end SUB_GROUP /begin FUNCTION_LIST /end FUNCTION_LIST /begin REF_CHARACTERISTIC /end REF_CHARACTERISTIC /begin REF_MEASUREMENT StabilityComp.AssistCmd.MtrNm_f32 /end REF_MEASUREMENT /end GROUP
/begin GROUP StabilityComp.AssistDDFactor.Uls_f32 "MICROSAR RTE" /begin SUB_GROUP /end SUB_GROUP /begin FUNCTION_LIST /end FUNCTION_LIST /begin REF_CHARACTERISTIC /end REF_CHARACTERISTIC /begin REF_MEASUREMENT StabilityComp.AssistDDFactor.Uls_f32 /end REF_MEASUREMENT /end GROUP
/begin GROUP StabilityComp.AsstFWActive.Uls_f32 "MICROSAR RTE" /begin SUB_GROUP /end SUB_GROUP /begin FUNCTION_LIST /end FUNCTION_LIST /begin REF_CHARACTERISTIC /end REF_CHARACTERISTIC /begin REF_MEASUREMENT StabilityComp.AsstFWActive.Uls_f32 /end REF_MEASUREMENT /end GROUP
/begin GROUP StabilityComp.CombinedAssist.MtrNm_f32 "MICROSAR RTE" /begin SUB_GROUP /end SUB_GROUP /begin FUNCTION_LIST /end FUNCTION_LIST /begin REF_CHARACTERISTIC /end REF_CHARACTERISTIC /begin REF_MEASUREMENT StabilityComp.CombinedAssist.MtrNm_f32 /end REF_MEASUREMENT /end GROUP
/begin GROUP StabilityComp.HwTorque.HwNm_f32 "MICROSAR RTE" /begin SUB_GROUP /end SUB_GROUP /begin FUNCTION_LIST /end FUNCTION_LIST /begin REF_CHARACTERISTIC /end REF_CHARACTERISTIC /begin REF_MEASUREMENT StabilityComp.HwTorque.HwNm_f32 /end REF_MEASUREMENT /end GROUP
/begin GROUP StabilityComp.ReceiverPorts "MICROSAR RTE"
 /begin SUB_GROUP StabilityComp.AssistDDFactor.Uls_f32 StabilityComp.AsstFWActive.Uls_f32 StabilityComp.CombinedAssist.MtrNm_f32 StabilityComp.HwTorque.HwNm_f32 StabilityComp.SysAssistCmd_MtrNm.MtrNm_f32 StabilityComp.VehicleSpeed.Kph_f32 /end SUB_GROUP
 /begin FUNCTION_LIST /end FUNCTION_LIST
 /begin REF_CHARACTERISTIC /end REF_CHARACTERISTIC
 /begin REF_MEASUREMENT /end REF_MEASUREMENT
/end GROUP
/begin GROUP StabilityComp.SenderPorts "MICROSAR RTE" /begin SUB_GROUP StabilityComp.AssistCmd.MtrNm_f32 /end SUB_GROUP /begin FUNCTION_LIST /end FUNCTION_LIST /begin REF_CHARACTERISTIC /end REF_CHARACTERISTIC /begin REF_MEASUREMENT /end REF_MEASUREMENT /end GROUP
/begin GROUP StabilityComp.SysAssistCmd_MtrNm.MtrNm_f32 "MICROSAR RTE" /begin SUB_GROUP /end SUB_GROUP /begin FUNCTION_LIST /end FUNCTION_LIST /begin REF_CHARACTERISTIC /end REF_CHARACTERISTIC /begin REF_MEASUREMENT StabilityComp.SysAssistCmd_MtrNm.MtrNm_f32 /end REF_MEASUREMENT /end GROUP
/begin GROUP StabilityComp.VehicleSpeed.Kph_f32 "MICROSAR RTE" /begin SUB_GROUP /end SUB_GROUP /begin FUNCTION_LIST /end FUNCTION_LIST /begin REF_CHARACTERISTIC /end REF_CHARACTERISTIC /begin REF_MEASUREMENT StabilityComp.VehicleSpeed.Kph_f32 /end REF_MEASUREMENT /end GROUP
/begin GROUP TmprlMon "MICROSAR RTE"
 /begin SUB_GROUP TmprlMon.ModeRequirePorts TmprlMon.ReceiverPorts TmprlMon.SenderPorts /end SUB_GROUP
 /begin FUNCTION_LIST /end FUNCTION_LIST
 /begin REF_CHARACTERISTIC /end REF_CHARACTERISTIC
 /begin REF_MEASUREMENT /end REF_MEASUREMENT
/end GROUP
/begin GROUP TmprlMon.ModeRequirePorts "MICROSAR RTE" /begin SUB_GROUP TmprlMon.SystemState.Mode /end SUB_GROUP /begin FUNCTION_LIST /end FUNCTION_LIST /begin REF_CHARACTERISTIC /end REF_CHARACTERISTIC /begin REF_MEASUREMENT /end REF_MEASUREMENT /end GROUP
/begin GROUP TmprlMon.ReceiverPorts "MICROSAR RTE" /begin SUB_GROUP TmprlMon.TMFTestStart.Cnt_lgc /end SUB_GROUP /begin FUNCTION_LIST /end FUNCTION_LIST /begin REF_CHARACTERISTIC /end REF_CHARACTERISTIC /begin REF_MEASUREMENT /end REF_MEASUREMENT /end GROUP
/begin GROUP TmprlMon.SenderPorts "MICROSAR RTE" /begin SUB_GROUP TmprlMon.TMFTestComplete.Cnt_lgc /end SUB_GROUP /begin FUNCTION_LIST /end FUNCTION_LIST /begin REF_CHARACTERISTIC /end REF_CHARACTERISTIC /begin REF_MEASUREMENT /end REF_MEASUREMENT /end GROUP
/begin GROUP TmprlMon.SystemState.Mode "MICROSAR RTE" /begin SUB_GROUP /end SUB_GROUP /begin FUNCTION_LIST /end FUNCTION_LIST /begin REF_CHARACTERISTIC /end REF_CHARACTERISTIC /begin REF_MEASUREMENT TmprlMon.SystemState.Mode /end REF_MEASUREMENT /end GROUP
/begin GROUP TmprlMon.TMFTestComplete.Cnt_lgc "MICROSAR RTE" /begin SUB_GROUP /end SUB_GROUP /begin FUNCTION_LIST /end FUNCTION_LIST /begin REF_CHARACTERISTIC /end REF_CHARACTERISTIC /begin REF_MEASUREMENT TmprlMon.TMFTestComplete.Cnt_lgc /end REF_MEASUREMENT /end GROUP
/begin GROUP TmprlMon.TMFTestStart.Cnt_lgc "MICROSAR RTE" /begin SUB_GROUP /end SUB_GROUP /begin FUNCTION_LIST /end FUNCTION_LIST /begin REF_CHARACTERISTIC /end REF_CHARACTERISTIC /begin REF_MEASUREMENT TmprlMon.TMFTestStart.Cnt_lgc /end REF_MEASUREMENT /end GROUP
/begin GROUP TrqCmdScl "MICROSAR RTE"
 /begin SUB_GROUP TrqCmdScl.PerInstanceMemories TrqCmdScl.ReceiverPorts TrqCmdScl.SenderPorts /end SUB_GROUP
 /begin FUNCTION_LIST /end FUNCTION_LIST
 /begin REF_CHARACTERISTIC /end REF_CHARACTERISTIC
 /begin REF_MEASUREMENT /end REF_MEASUREMENT
/end GROUP
/begin GROUP TrqCmdScl.MRFMtrTrqCmd.MtrNm_f32 "MICROSAR RTE" /begin SUB_GROUP /end SUB_GROUP /begin FUNCTION_LIST /end FUNCTION_LIST /begin REF_CHARACTERISTIC /end REF_CHARACTERISTIC /begin REF_MEASUREMENT TrqCmdScl.MRFMtrTrqCmd.MtrNm_f32 /end REF_MEASUREMENT /end GROUP
/begin GROUP TrqCmdScl.MRFMtrTrqCmdScl.MtrNm_f32 "MICROSAR RTE" /begin SUB_GROUP /end SUB_GROUP /begin FUNCTION_LIST /end FUNCTION_LIST /begin REF_CHARACTERISTIC /end REF_CHARACTERISTIC /begin REF_MEASUREMENT TrqCmdScl.MRFMtrTrqCmdScl.MtrNm_f32 /end REF_MEASUREMENT /end GROUP
/begin GROUP TrqCmdScl.PerInstanceMemories "MICROSAR RTE" /begin SUB_GROUP TrqCmdScl.TorqueCmdSF_Uls_f32 /end SUB_GROUP /begin FUNCTION_LIST /end FUNCTION_LIST /begin REF_CHARACTERISTIC /end REF_CHARACTERISTIC /begin REF_MEASUREMENT /end REF_MEASUREMENT /end GROUP
/begin GROUP TrqCmdScl.ReceiverPorts "MICROSAR RTE" /begin SUB_GROUP TrqCmdScl.MRFMtrTrqCmd.MtrNm_f32 /end SUB_GROUP /begin FUNCTION_LIST /end FUNCTION_LIST /begin REF_CHARACTERISTIC /end REF_CHARACTERISTIC /begin REF_MEASUREMENT /end REF_MEASUREMENT /end GROUP
/begin GROUP TrqCmdScl.SenderPorts "MICROSAR RTE" /begin SUB_GROUP TrqCmdScl.MRFMtrTrqCmdScl.MtrNm_f32 /end SUB_GROUP /begin FUNCTION_LIST /end FUNCTION_LIST /begin REF_CHARACTERISTIC /end REF_CHARACTERISTIC /begin REF_MEASUREMENT /end REF_MEASUREMENT /end GROUP
/begin GROUP TrqCmdScl.TorqueCmdSF_Uls_f32 "MICROSAR RTE" /begin SUB_GROUP /end SUB_GROUP /begin FUNCTION_LIST /end FUNCTION_LIST /begin REF_CHARACTERISTIC /end REF_CHARACTERISTIC /begin REF_MEASUREMENT TrqCmdScl.TorqueCmdSF_Uls_f32 /end REF_MEASUREMENT /end GROUP
/begin GROUP VehPwrMd "MICROSAR RTE" /begin SUB_GROUP VehPwrMd.ReceiverPorts VehPwrMd.SenderPorts /end SUB_GROUP /begin FUNCTION_LIST /end FUNCTION_LIST /begin REF_CHARACTERISTIC /end REF_CHARACTERISTIC /begin REF_MEASUREMENT /end REF_MEASUREMENT /end GROUP
/begin GROUP VehPwrMd.ATermActive.Cnt_lgc "MICROSAR RTE" /begin SUB_GROUP /end SUB_GROUP /begin FUNCTION_LIST /end FUNCTION_LIST /begin REF_CHARACTERISTIC /end REF_CHARACTERISTIC /begin REF_MEASUREMENT VehPwrMd.ATermActive.Cnt_lgc /end REF_MEASUREMENT /end GROUP
/begin GROUP VehPwrMd.CTermActive.Cnt_lgc "MICROSAR RTE" /begin SUB_GROUP /end SUB_GROUP /begin FUNCTION_LIST /end FUNCTION_LIST /begin REF_CHARACTERISTIC /end REF_CHARACTERISTIC /begin REF_MEASUREMENT VehPwrMd.CTermActive.Cnt_lgc /end REF_MEASUREMENT /end GROUP
/begin GROUP VehPwrMd.DefaultVehSpd.Cnt_lgc "MICROSAR RTE" /begin SUB_GROUP /end SUB_GROUP /begin FUNCTION_LIST /end FUNCTION_LIST /begin REF_CHARACTERISTIC /end REF_CHARACTERISTIC /begin REF_MEASUREMENT VehPwrMd.DefaultVehSpd.Cnt_lgc /end REF_MEASUREMENT /end GROUP
/begin GROUP VehPwrMd.EngONSrlComSvcDft.Cnt_lgc "MICROSAR RTE" /begin SUB_GROUP /end SUB_GROUP /begin FUNCTION_LIST /end FUNCTION_LIST /begin REF_CHARACTERISTIC /end REF_CHARACTERISTIC /begin REF_MEASUREMENT VehPwrMd.EngONSrlComSvcDft.Cnt_lgc /end REF_MEASUREMENT /end GROUP
/begin GROUP VehPwrMd.EngRPM.Cnt_u16 "MICROSAR RTE" /begin SUB_GROUP /end SUB_GROUP /begin FUNCTION_LIST /end FUNCTION_LIST /begin REF_CHARACTERISTIC /end REF_CHARACTERISTIC /begin REF_MEASUREMENT VehPwrMd.EngRPM.Cnt_u16 /end REF_MEASUREMENT /end GROUP
/begin GROUP VehPwrMd.EssEngStop.Cnt_lgc "MICROSAR RTE" /begin SUB_GROUP /end SUB_GROUP /begin FUNCTION_LIST /end FUNCTION_LIST /begin REF_CHARACTERISTIC /end REF_CHARACTERISTIC /begin REF_MEASUREMENT VehPwrMd.EssEngStop.Cnt_lgc /end REF_MEASUREMENT /end GROUP
/begin GROUP VehPwrMd.OperRampRate.XpmS_f32 "MICROSAR RTE" /begin SUB_GROUP /end SUB_GROUP /begin FUNCTION_LIST /end FUNCTION_LIST /begin REF_CHARACTERISTIC /end REF_CHARACTERISTIC /begin REF_MEASUREMENT VehPwrMd.OperRampRate.XpmS_f32 /end REF_MEASUREMENT /end GROUP
/begin GROUP VehPwrMd.OperRampValue.Uls_f32 "MICROSAR RTE" /begin SUB_GROUP /end SUB_GROUP /begin FUNCTION_LIST /end FUNCTION_LIST /begin REF_CHARACTERISTIC /end REF_CHARACTERISTIC /begin REF_MEASUREMENT VehPwrMd.OperRampValue.Uls_f32 /end REF_MEASUREMENT /end GROUP
/begin GROUP VehPwrMd.ReceiverPorts "MICROSAR RTE"
 /begin SUB_GROUP VehPwrMd.DefaultVehSpd.Cnt_lgc VehPwrMd.EngONSrlComSvcDft.Cnt_lgc VehPwrMd.EngRPM.Cnt_u16 VehPwrMd.EssEngStop.Cnt_lgc VehPwrMd.SpStPrsnt.Cnt_lgc VehPwrMd.VehSpd.Kph_f32 VehPwrMd.VehSpdValid.Cnt_lgc /end SUB_GROUP
 /begin FUNCTION_LIST /end FUNCTION_LIST
 /begin REF_CHARACTERISTIC /end REF_CHARACTERISTIC
 /begin REF_MEASUREMENT /end REF_MEASUREMENT
/end GROUP
/begin GROUP VehPwrMd.SenderPorts "MICROSAR RTE"
 /begin SUB_GROUP VehPwrMd.ATermActive.Cnt_lgc VehPwrMd.CTermActive.Cnt_lgc VehPwrMd.OperRampRate.XpmS_f32 VehPwrMd.OperRampValue.Uls_f32 /end SUB_GROUP
 /begin FUNCTION_LIST /end FUNCTION_LIST
 /begin REF_CHARACTERISTIC /end REF_CHARACTERISTIC
 /begin REF_MEASUREMENT /end REF_MEASUREMENT
/end GROUP
/begin GROUP VehPwrMd.SpStPrsnt.Cnt_lgc "MICROSAR RTE" /begin SUB_GROUP /end SUB_GROUP /begin FUNCTION_LIST /end FUNCTION_LIST /begin REF_CHARACTERISTIC /end REF_CHARACTERISTIC /begin REF_MEASUREMENT VehPwrMd.SpStPrsnt.Cnt_lgc /end REF_MEASUREMENT /end GROUP
/begin GROUP VehPwrMd.VehSpd.Kph_f32 "MICROSAR RTE" /begin SUB_GROUP /end SUB_GROUP /begin FUNCTION_LIST /end FUNCTION_LIST /begin REF_CHARACTERISTIC /end REF_CHARACTERISTIC /begin REF_MEASUREMENT VehPwrMd.VehSpd.Kph_f32 /end REF_MEASUREMENT /end GROUP
/begin GROUP VehPwrMd.VehSpdValid.Cnt_lgc "MICROSAR RTE" /begin SUB_GROUP /end SUB_GROUP /begin FUNCTION_LIST /end FUNCTION_LIST /begin REF_CHARACTERISTIC /end REF_CHARACTERISTIC /begin REF_MEASUREMENT VehPwrMd.VehSpdValid.Cnt_lgc /end REF_MEASUREMENT /end GROUP
/begin GROUP VehSpdLmt "MICROSAR RTE" /begin SUB_GROUP VehSpdLmt.ReceiverPorts VehSpdLmt.SenderPorts /end SUB_GROUP /begin FUNCTION_LIST /end FUNCTION_LIST /begin REF_CHARACTERISTIC /end REF_CHARACTERISTIC /begin REF_MEASUREMENT /end REF_MEASUREMENT /end GROUP
/begin GROUP VehSpdLmt.AstVehSpdLimit.MtrNm_f32 "MICROSAR RTE" /begin SUB_GROUP /end SUB_GROUP /begin FUNCTION_LIST /end FUNCTION_LIST /begin REF_CHARACTERISTIC /end REF_CHARACTERISTIC /begin REF_MEASUREMENT VehSpdLmt.AstVehSpdLimit.MtrNm_f32 /end REF_MEASUREMENT /end GROUP
/begin GROUP VehSpdLmt.CCWPosition.HwDeg_f32 "MICROSAR RTE" /begin SUB_GROUP /end SUB_GROUP /begin FUNCTION_LIST /end FUNCTION_LIST /begin REF_CHARACTERISTIC /end REF_CHARACTERISTIC /begin REF_MEASUREMENT VehSpdLmt.CCWPosition.HwDeg_f32 /end REF_MEASUREMENT /end GROUP
/begin GROUP VehSpdLmt.CWPosition.HwDeg_f32 "MICROSAR RTE" /begin SUB_GROUP /end SUB_GROUP /begin FUNCTION_LIST /end FUNCTION_LIST /begin REF_CHARACTERISTIC /end REF_CHARACTERISTIC /begin REF_MEASUREMENT VehSpdLmt.CWPosition.HwDeg_f32 /end REF_MEASUREMENT /end GROUP
/begin GROUP VehSpdLmt.HwPos.HwDeg_f32 "MICROSAR RTE" /begin SUB_GROUP /end SUB_GROUP /begin FUNCTION_LIST /end FUNCTION_LIST /begin REF_CHARACTERISTIC /end REF_CHARACTERISTIC /begin REF_MEASUREMENT VehSpdLmt.HwPos.HwDeg_f32 /end REF_MEASUREMENT /end GROUP
/begin GROUP VehSpdLmt.HwPosAuth.Uls_f32 "MICROSAR RTE" /begin SUB_GROUP /end SUB_GROUP /begin FUNCTION_LIST /end FUNCTION_LIST /begin REF_CHARACTERISTIC /end REF_CHARACTERISTIC /begin REF_MEASUREMENT VehSpdLmt.HwPosAuth.Uls_f32 /end REF_MEASUREMENT /end GROUP
/begin GROUP VehSpdLmt.ReceiverPorts "MICROSAR RTE"
 /begin SUB_GROUP VehSpdLmt.CCWPosition.HwDeg_f32 VehSpdLmt.CWPosition.HwDeg_f32 VehSpdLmt.HwPos.HwDeg_f32 VehSpdLmt.HwPosAuth.Uls_f32 VehSpdLmt.VehSpd.Kph_f32 /end SUB_GROUP
 /begin FUNCTION_LIST /end FUNCTION_LIST
 /begin REF_CHARACTERISTIC /end REF_CHARACTERISTIC
 /begin REF_MEASUREMENT /end REF_MEASUREMENT
/end GROUP
/begin GROUP VehSpdLmt.SenderPorts "MICROSAR RTE" /begin SUB_GROUP VehSpdLmt.AstVehSpdLimit.MtrNm_f32 /end SUB_GROUP /begin FUNCTION_LIST /end FUNCTION_LIST /begin REF_CHARACTERISTIC /end REF_CHARACTERISTIC /begin REF_MEASUREMENT /end REF_MEASUREMENT /end GROUP
/begin GROUP VehSpdLmt.VehSpd.Kph_f32 "MICROSAR RTE" /begin SUB_GROUP /end SUB_GROUP /begin FUNCTION_LIST /end FUNCTION_LIST /begin REF_CHARACTERISTIC /end REF_CHARACTERISTIC /begin REF_MEASUREMENT VehSpdLmt.VehSpd.Kph_f32 /end REF_MEASUREMENT /end GROUP
/begin GROUP Xcp "MICROSAR RTE" /begin SUB_GROUP Xcp.ReceiverPorts Xcp.SenderPorts /end SUB_GROUP /begin FUNCTION_LIST /end FUNCTION_LIST /begin REF_CHARACTERISTIC /end REF_CHARACTERISTIC /begin REF_MEASUREMENT /end REF_MEASUREMENT /end GROUP
/begin GROUP Xcp.ActiveTunOvrPtrAddr.Cnt_u32 "MICROSAR RTE" /begin SUB_GROUP /end SUB_GROUP /begin FUNCTION_LIST /end FUNCTION_LIST /begin REF_CHARACTERISTIC /end REF_CHARACTERISTIC /begin REF_MEASUREMENT Xcp.ActiveTunOvrPtrAddr.Cnt_u32 /end REF_MEASUREMENT /end GROUP
/begin GROUP Xcp.ActiveTunPers.Cnt_u16 "MICROSAR RTE" /begin SUB_GROUP /end SUB_GROUP /begin FUNCTION_LIST /end FUNCTION_LIST /begin REF_CHARACTERISTIC /end REF_CHARACTERISTIC /begin REF_MEASUREMENT Xcp.ActiveTunPers.Cnt_u16 /end REF_MEASUREMENT /end GROUP
/begin GROUP Xcp.ActiveTunSet.Cnt_u16 "MICROSAR RTE" /begin SUB_GROUP /end SUB_GROUP /begin FUNCTION_LIST /end FUNCTION_LIST /begin REF_CHARACTERISTIC /end REF_CHARACTERISTIC /begin REF_MEASUREMENT Xcp.ActiveTunSet.Cnt_u16 /end REF_MEASUREMENT /end GROUP
/begin GROUP Xcp.DesiredTunPers.Cnt_u16 "MICROSAR RTE" /begin SUB_GROUP /end SUB_GROUP /begin FUNCTION_LIST /end FUNCTION_LIST /begin REF_CHARACTERISTIC /end REF_CHARACTERISTIC /begin REF_MEASUREMENT Xcp.DesiredTunPers.Cnt_u16 /end REF_MEASUREMENT /end GROUP
/begin GROUP Xcp.DesiredTunSet.Cnt_u16 "MICROSAR RTE" /begin SUB_GROUP /end SUB_GROUP /begin FUNCTION_LIST /end FUNCTION_LIST /begin REF_CHARACTERISTIC /end REF_CHARACTERISTIC /begin REF_MEASUREMENT Xcp.DesiredTunSet.Cnt_u16 /end REF_MEASUREMENT /end GROUP
/begin GROUP Xcp.ReceiverPorts "MICROSAR RTE"
 /begin SUB_GROUP Xcp.ActiveTunPers.Cnt_u16 Xcp.ActiveTunSet.Cnt_u16 Xcp.DesiredTunPers.Cnt_u16 Xcp.DesiredTunSet.Cnt_u16 /end SUB_GROUP
 /begin FUNCTION_LIST /end FUNCTION_LIST
 /begin REF_CHARACTERISTIC /end REF_CHARACTERISTIC
 /begin REF_MEASUREMENT /end REF_MEASUREMENT
/end GROUP
/begin GROUP Xcp.SenderPorts "MICROSAR RTE"
 /begin SUB_GROUP Xcp.ActiveTunOvrPtrAddr.Cnt_u32 Xcp.TuningSessionActPtr.Cnt_u8 /end SUB_GROUP
 /begin FUNCTION_LIST /end FUNCTION_LIST
 /begin REF_CHARACTERISTIC /end REF_CHARACTERISTIC
 /begin REF_MEASUREMENT /end REF_MEASUREMENT
/end GROUP
/begin GROUP Xcp.TuningSessionActPtr.Cnt_u8 "MICROSAR RTE" /begin SUB_GROUP /end SUB_GROUP /begin FUNCTION_LIST /end FUNCTION_LIST /begin REF_CHARACTERISTIC /end REF_CHARACTERISTIC /begin REF_MEASUREMENT Xcp.TuningSessionActPtr.Cnt_u8 /end REF_MEASUREMENT /end GROUP
/begin RECORD_LAYOUT RTE_RL_FLOAT64_IEEE FNC_VALUES 1 FLOAT64_IEEE ROW_DIR DIRECT /end RECORD_LAYOUT
/begin RECORD_LAYOUT RTE_RL_BOOLEAN FNC_VALUES 1 UBYTE ROW_DIR DIRECT /end RECORD_LAYOUT
/**********************************************************************************************************************
* COMPU_METHOD / COMPU_VTAB_RANGE
*********************************************************************************************************************/
/begin COMPU_METHOD RTE_CM_BOOLEAN "" TAB_VERB "%3.1" "" COMPU_TAB_REF RTE_CM_BOOLEAN /end COMPU_METHOD
/begin COMPU_VTAB_RANGE RTE_CM_BOOLEAN "" 2 0 0 "false" 1 255 "true" /end COMPU_VTAB_RANGE
/begin COMPU_METHOD RTE_CM_STRING "" TAB_VERB "%.1" "" COMPU_TAB_REF RTE_CM_STRING /end COMPU_METHOD
/begin COMPU_VTAB_RANGE RTE_CM_STRING "" 256 0 31 "UNDEFINED" 32 32 " " 33 33 "!" 34 34 "\"" 35 35 "#" 36 36 "$" 37 37 "%" 38 38 "&" 39 39 "'" 40 40 "(" 41 41 ")" 42 42 "*" 43 43 "+" 44 44 "," 45 45 "-" 46 46 "." 47 47 "/" 48 48 "0" 49 49 "1" 50 50 "2" 51 51 "3" 52 52 "4" 53 53 "5" 54 54 "6" 55 55 "7" 56 56 "8" 57 57 "9" 58 58 ":" 59 59 ";" 60 60 "<" 61 61 "=" 62 62 ">" 63 63 "?" 64 64 "@" 65 65 "A" 66 66 "B" 67 67 "C" 68 68 "D" 69 69 "E" 70 70 "F" 71 71 "G" 72 72 "H" 73 73 "I" 74 74 "J" 75 75 "K" 76 76 "L" 77 77 "M" 78 78 "N" 79 79 "O" 80 80 "P" 81 81 "Q" 82 82 "R" 83 83 "S" 84 84 "T" 85 85 "U" 86 86 "V" 87 87 "W" 88 88 "X" 89 89 "Y" 90 90 "Z" 91 91 "[" 92 92 "\\" 93 93 "]" 94 94 "^" 95 95 "_" 96 96 "`" 97 97 "a" 98 98 "b" 99 99 "c" 100 100 "d" 101 101 "e" 102 102 "f" 103 103 "g" 104 104 "h" 105 105 "i" 106 106 "j" 107 107 "k" 108 108 "l" 109 109 "m" 110 110 "n" 111 111 "o" 112 112 "p" 113 113 "q" 114 114 "r" 115 115 "s" 116 116 "t" 117 117 "u" 118 118 "v" 119 119 "w" 120 120 "x" 121 121 "y" 122 122 "z" 123 123 "{" 124 124 "|" 125 125 "}" 126 126 "~" 127 255 "UNDEFINED" /end COMPU_VTAB_RANGE
/begin COMPU_METHOD RTE_CM_ENUM_StaMd_Mode "" TAB_VERB "%.1" "" COMPU_TAB_REF RTE_CM_ENUM_StaMd_Mode /end COMPU_METHOD
/begin COMPU_VTAB_RANGE RTE_CM_ENUM_StaMd_Mode "" 5 0 0 "RTE_MODE_StaMd_Mode_DISABLE" 1 1 "RTE_MODE_StaMd_Mode_OFF" 2 2 "RTE_MODE_StaMd_Mode_OPERATE" 3 3 "RTE_MODE_StaMd_Mode_WARMINIT" 4 4 "RTE_TRANSITION_StaMd_Mode" /end COMPU_VTAB_RANGE
/begin COMPU_METHOD RTE_CM_ENUM_ManufModeType "" TAB_VERB "%.1" "" COMPU_TAB_REF RTE_CM_ENUM_ManufModeType /end COMPU_METHOD
/begin COMPU_VTAB_RANGE RTE_CM_ENUM_ManufModeType "" 3 0 0 "ProductionMode" 1 1 "ManufacturingMode" 2 2 "EngineeringMode" /end COMPU_VTAB_RANGE
/begin COMPU_METHOD RTE_CM_ENUM_TOC_STATE "" TAB_VERB "%.1" "" COMPU_TAB_REF RTE_CM_ENUM_TOC_STATE /end COMPU_METHOD
/begin COMPU_VTAB_RANGE RTE_CM_ENUM_TOC_STATE "" 9 0 0 "TOCSTATE_OFF" 1 1 "TOCSTATE_TNA" 2 2 "TOCSTATE_PNA" 3 3 "TOCSTATE_READY" 4 4 "TOCSTATE_REQUESTDENIED" 5 5 "TOCSTATE_ACTIVEMODE05" 6 6 "TOCSTATE_ACTIVEMODE06" 7 7 "TOCSTATE_ACTIVEMODE07" 8 8 "TOCSTATE_NOTAVAILABLE" /end COMPU_VTAB_RANGE
/begin COMPU_METHOD RTE_CM_ENUM_TuningSessionAddrPtrEnum "" TAB_VERB "%.1" "" COMPU_TAB_REF RTE_CM_ENUM_TuningSessionAddrPtrEnum /end COMPU_METHOD
/begin COMPU_VTAB_RANGE RTE_CM_ENUM_TuningSessionAddrPtrEnum "" 4 0 0 "TUN_SESSION_PTR_PERS" 1 1 "TUN_SESSION_PTR_SETS" 2 2 "TUN_SESSION_PTR_COMMON" 255 255 "TUN_SESSION_PTR_DISABLED" /end COMPU_VTAB_RANGE
