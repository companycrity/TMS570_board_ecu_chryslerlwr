/begin XCP_ON_CAN 0x0100 /*XCP on CAN version*/ CAN_ID_MASTER 0x000006da /* CMD/STIM */ CAN_ID_SLAVE 0x0000059a /* RES/ERR/EV/SERV/DAQ */ BAUDRATE 500000 /* BAUDRATE */ SAMPLE_POINT 76 /* SAMPLE_POINT */ SAMPLE_RATE 0 /* SAMPLE_RATE */ BTL_CYCLES 17 /* BTL_CYCLES */ SJW 4 /* length synchr. segment */ /end XCP_ON_CAN
