AUTOSAR XML (schema 321)
package /PortInterface
  client server interface EpsEn
    operation OP_GET: possible-error=EpsEn/E_NOT_OK
      arg signal: type=IoHwAb_BoolType, direction=OUT
    error E_NOT_OK: error-code=1
  client server interface StateRequest: is-service=true
    5 x operation, all with possible-error=StateRequest/E_NOT_OK:
      GetState
        arg state: type=EcuM_StateType, direction=OUT
      ReleasePOSTRUN
      ReleaseRUN
      RequestPOSTRUN
      RequestRUN
    error E_NOT_OK: error-code=1
  7 x sender receiver interface:
    BoolStatusFlag_Cnt_lgc
      data Cnt_lgc: sw-calibration-access=READ-ONLY, type=Boolean
    Count_Cnt_u16
      data Cnt_u16: sw-calibration-access=READ-ONLY, type=UInt16
    Enable
      data Cnt_lgc: sw-calibration-access=READ-ONLY, type=Boolean
    RampRate
      data XpmS_f32: sw-calibration-access=READ-ONLY, type=Float
    StaMdsTerm
      data Cnt_lgc: sw-calibration-access=READ-ONLY, type=Boolean
    UnityScalar
      data Uls_f32: sw-calibration-access=READ-ONLY, type=Float
    VehSpd
      data Kph_f32: sw-calibration-access=READ-ONLY, type=Float
