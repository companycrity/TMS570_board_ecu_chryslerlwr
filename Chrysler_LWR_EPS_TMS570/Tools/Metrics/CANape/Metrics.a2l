/* @@@@ File written by CANAPE_VERSION 10 0 10 @@@@ */ ASAP2_VERSION 1 60
/begin PROJECT Rte ""
/begin MODULE CPP ""
/begin MOD_COMMON "" BYTE_ORDER MSB_FIRST ALIGNMENT_BYTE 1 ALIGNMENT_WORD 1 ALIGNMENT_LONG 1 ALIGNMENT_INT64 1 ALIGNMENT_FLOAT32_IEEE 1 ALIGNMENT_FLOAT64_IEEE 1 /end MOD_COMMON
/begin IF_DATA XCP
 /begin PROTOCOL_LAYER 0x0100 0x07D0 0x2710 0x00 0x00 0x00 0x00 0x00 0x08 0x08 BYTE_ORDER_MSB_FIRST ADDRESS_GRANULARITY_BYTE OPTIONAL_CMD ALLOC_ODT_ENTRY OPTIONAL_CMD ALLOC_ODT OPTIONAL_CMD ALLOC_DAQ OPTIONAL_CMD FREE_DAQ OPTIONAL_CMD GET_DAQ_EVENT_INFO OPTIONAL_CMD GET_DAQ_RESOLUTION_INFO OPTIONAL_CMD GET_DAQ_PROCESSOR_INFO OPTIONAL_CMD START_STOP_SYNCH OPTIONAL_CMD START_STOP_DAQ_LIST OPTIONAL_CMD GET_DAQ_LIST_MODE OPTIONAL_CMD SET_DAQ_LIST_MODE OPTIONAL_CMD WRITE_DAQ OPTIONAL_CMD SET_DAQ_PTR OPTIONAL_CMD CLEAR_DAQ_LIST OPTIONAL_CMD DOWNLOAD OPTIONAL_CMD SHORT_UPLOAD OPTIONAL_CMD UPLOAD OPTIONAL_CMD SET_MTA OPTIONAL_CMD GET_COMM_MODE_INFO COMMUNICATION_MODE_SUPPORTED BLOCK SLAVE MASTER 0x2B 0x00 /end PROTOCOL_LAYER
 /begin DAQ DYNAMIC 0x00 0x01 0x00 OPTIMISATION_TYPE_DEFAULT ADDRESS_EXTENSION_FREE IDENTIFICATION_FIELD_TYPE_ABSOLUTE GRANULARITY_ODT_ENTRY_SIZE_DAQ_BYTE 0x07 OVERLOAD_INDICATION_PID PRESCALER_SUPPORTED /begin TIMESTAMP_SUPPORTED 0x01 SIZE_WORD UNIT_1US /end TIMESTAMP_SUPPORTED /begin EVENT "2ms_DAQ" "2ms_DAQ" 0x00 DAQ 0x01 0x02 0x06 0x00 /end EVENT /end DAQ
 /begin PAG 0x00 /end PAG
 /begin PGM PGM_MODE_ABSOLUTE 0x00 0x00 /end PGM
 /begin XCP_ON_CAN 0x0100 CAN_ID_MASTER 0x06DA CAN_ID_SLAVE 0x059A BAUDRATE 0x07A120 SAMPLE_POINT 0x4B SAMPLE_RATE SINGLE BTL_CYCLES 0x08 SJW 0x02 SYNC_EDGE SINGLE MAX_DLC_REQUIRED /end XCP_ON_CAN
/end IF_DATA
/begin MOD_PAR "" /end MOD_PAR
/begin COMPU_VTAB_RANGE RTE_CM_BOOLEAN "" 2 0 0 "false" 1 255 "true" DEFAULT_VALUE "" /end COMPU_VTAB_RANGE
/begin COMPU_VTAB RTE_CM_ENUM_FETFAULTTYPE_ENUM "" TAB_VERB 3 0 "NOFAULT" 1 "LOWER" 2 "UPPER" DEFAULT_VALUE "" /end COMPU_VTAB
/begin COMPU_VTAB RTE_CM_ENUM_FETPHASETYPE_ENUM "" TAB_VERB 4 0 "NOPHASE" 1 "PHASEA" 2 "PHASEB" 3 "PHASEC" DEFAULT_VALUE "" /end COMPU_VTAB
/begin COMPU_VTAB RTE_CM_ENUM_ManufModeType "" TAB_VERB 3 0 "ProductionMode" 1 "ManufacturingMode" 2 "EngineeringMode" DEFAULT_VALUE "" /end COMPU_VTAB
/begin COMPU_VTAB RTE_CM_ENUM_StaMd_Mode "" TAB_VERB 5 0 "RTE_MODE_StaMd_Mode_DISABLE" 1 "RTE_MODE_StaMd_Mode_OFF" 2 "RTE_MODE_StaMd_Mode_OPERATE" 3 "RTE_MODE_StaMd_Mode_WARMINIT" 4 "RTE_TRANSITION_StaMd_Mode" DEFAULT_VALUE "" /end COMPU_VTAB
/begin COMPU_VTAB RTE_CM_ENUM_TOC_STATE "" TAB_VERB 9 0 "TOCSTATE_OFF" 1 "TOCSTATE_TNA" 2 "TOCSTATE_PNA" 3 "TOCSTATE_READY" 4 "TOCSTATE_REQUESTDENIED" 5 "TOCSTATE_ACTIVEMODE05" 6 "TOCSTATE_ACTIVEMODE06" 7 "TOCSTATE_ACTIVEMODE07" 8 "TOCSTATE_NOTAVAILABLE" DEFAULT_VALUE "" /end COMPU_VTAB
/begin COMPU_VTAB_RANGE RTE_CM_STRING "" 97 0 31 "UNDEFINED" 32 32 " " 33 33 "!" 34 34 "\"" 35 35 "#" 36 36 "$" 37 37 "%" 38 38 "&" 39 39 "'" 40 40 "(" 41 41 ")" 42 42 "*" 43 43 "+" 44 44 "," 45 45 "-" 46 46 "." 47 47 "/" 48 48 "0" 49 49 "1" 50 50 "2" 51 51 "3" 52 52 "4" 53 53 "5" 54 54 "6" 55 55 "7" 56 56 "8" 57 57 "9" 58 58 ":" 59 59 ";" 60 60 "<" 61 61 "=" 62 62 ">" 63 63 "?" 64 64 "@" 65 65 "A" 66 66 "B" 67 67 "C" 68 68 "D" 69 69 "E" 70 70 "F" 71 71 "G" 72 72 "H" 73 73 "I" 74 74 "J" 75 75 "K" 76 76 "L" 77 77 "M" 78 78 "N" 79 79 "O" 80 80 "P" 81 81 "Q" 82 82 "R" 83 83 "S" 84 84 "T" 85 85 "U" 86 86 "V" 87 87 "W" 88 88 "X" 89 89 "Y" 90 90 "Z" 91 91 "[" 92 92 "\\" 93 93 "]" 94 94 "^" 95 95 "_" 96 96 "`" 97 97 "a" 98 98 "b" 99 99 "c" 100 100 "d" 101 101 "e" 102 102 "f" 103 103 "g" 104 104 "h" 105 105 "i" 106 106 "j" 107 107 "k" 108 108 "l" 109 109 "m" 110 110 "n" 111 111 "o" 112 112 "p" 113 113 "q" 114 114 "r" 115 115 "s" 116 116 "t" 117 117 "u" 118 118 "v" 119 119 "w" 120 120 "x" 121 121 "y" 122 122 "z" 123 123 "{" 124 124 "|" 125 125 "}" 126 126 "~" 127 255 "UNDEFINED" DEFAULT_VALUE "" /end COMPU_VTAB_RANGE
/begin COMPU_METHOD Metrics_TaskTimes_Str._0_.ActiveTimeMax_Cnt_u32.CONVERSION "@@@@RuleName created by CANape" LINEAR "%3.1" "" COEFFS_LINEAR 0.00625 0 /end COMPU_METHOD
/begin COMPU_METHOD Metrics_TaskTimes_Str._0_.RunTimeMax_Cnt_u32.CONVERSION "@@@@RuleName created by CANape" LINEAR "%3.1" "" COEFFS_LINEAR 0.00625 0 /end COMPU_METHOD
/begin COMPU_METHOD Metrics_TaskTimes_Str._10_.ActiveTimeMax_Cnt_u32.CONVERSION "@@@@RuleName created by CANape" LINEAR "%3.1" "" COEFFS_LINEAR 0.00625 0 /end COMPU_METHOD
/begin COMPU_METHOD Metrics_TaskTimes_Str._10_.RunTimeMax_Cnt_u32.CONVERSION "@@@@RuleName created by CANape" LINEAR "%3.1" "" COEFFS_LINEAR 0.00625 0 /end COMPU_METHOD
/begin COMPU_METHOD Metrics_TaskTimes_Str._11_.ActiveTimeMax_Cnt_u32.CONVERSION "@@@@RuleName created by CANape" LINEAR "%3.1" "" COEFFS_LINEAR 0.00625 0 /end COMPU_METHOD
/begin COMPU_METHOD Metrics_TaskTimes_Str._11_.RunTimeMax_Cnt_u32.CONVERSION "@@@@RuleName created by CANape" LINEAR "%3.1" "" COEFFS_LINEAR 0.00625 0 /end COMPU_METHOD
/begin COMPU_METHOD Metrics_TaskTimes_Str._12_.ActiveTimeMax_Cnt_u32.CONVERSION "@@@@RuleName created by CANape" LINEAR "%3.1" "" COEFFS_LINEAR 0.00625 0 /end COMPU_METHOD
/begin COMPU_METHOD Metrics_TaskTimes_Str._12_.RunTimeMax_Cnt_u32.CONVERSION "@@@@RuleName created by CANape" LINEAR "%3.1" "" COEFFS_LINEAR 0.00625 0 /end COMPU_METHOD
/begin COMPU_METHOD Metrics_TaskTimes_Str._13_.ActiveTimeMax_Cnt_u32.CONVERSION "@@@@RuleName created by CANape" LINEAR "%3.1" "" COEFFS_LINEAR 0.00625 0 /end COMPU_METHOD
/begin COMPU_METHOD Metrics_TaskTimes_Str._13_.RunTimeMax_Cnt_u32.CONVERSION "@@@@RuleName created by CANape" LINEAR "%3.1" "" COEFFS_LINEAR 0.00625 0 /end COMPU_METHOD
/begin COMPU_METHOD Metrics_TaskTimes_Str._14_.ActiveTimeMax_Cnt_u32.CONVERSION "@@@@RuleName created by CANape" LINEAR "%3.1" "" COEFFS_LINEAR 0.00625 0 /end COMPU_METHOD
/begin COMPU_METHOD Metrics_TaskTimes_Str._14_.RunTimeMax_Cnt_u32.CONVERSION "@@@@RuleName created by CANape" LINEAR "%3.1" "" COEFFS_LINEAR 0.00625 0 /end COMPU_METHOD
/begin COMPU_METHOD Metrics_TaskTimes_Str._15_.ActiveTimeMax_Cnt_u32.CONVERSION "@@@@RuleName created by CANape" LINEAR "%3.1" "" COEFFS_LINEAR 0.00625 0 /end COMPU_METHOD
/begin COMPU_METHOD Metrics_TaskTimes_Str._15_.RunTimeMax_Cnt_u32.CONVERSION "@@@@RuleName created by CANape" LINEAR "%3.1" "" COEFFS_LINEAR 0.00625 0 /end COMPU_METHOD
/begin COMPU_METHOD Metrics_TaskTimes_Str._16_.ActiveTimeMax_Cnt_u32.CONVERSION "@@@@RuleName created by CANape" LINEAR "%3.1" "" COEFFS_LINEAR 0.00625 0 /end COMPU_METHOD
/begin COMPU_METHOD Metrics_TaskTimes_Str._16_.RunTimeMax_Cnt_u32.CONVERSION "@@@@RuleName created by CANape" LINEAR "%3.1" "" COEFFS_LINEAR 0.00625 0 /end COMPU_METHOD
/begin COMPU_METHOD Metrics_TaskTimes_Str._17_.ActiveTimeMax_Cnt_u32.CONVERSION "@@@@RuleName created by CANape" LINEAR "%3.1" "" COEFFS_LINEAR 0.00625 0 /end COMPU_METHOD
/begin COMPU_METHOD Metrics_TaskTimes_Str._17_.RunTimeMax_Cnt_u32.CONVERSION "@@@@RuleName created by CANape" LINEAR "%3.1" "" COEFFS_LINEAR 0.00625 0 /end COMPU_METHOD
/begin COMPU_METHOD Metrics_TaskTimes_Str._18_.ActiveTimeMax_Cnt_u32.CONVERSION "@@@@RuleName created by CANape" LINEAR "%3.1" "" COEFFS_LINEAR 0.00625 0 /end COMPU_METHOD
/begin COMPU_METHOD Metrics_TaskTimes_Str._18_.RunTimeMax_Cnt_u32.CONVERSION "@@@@RuleName created by CANape" LINEAR "%3.1" "" COEFFS_LINEAR 0.00625 0 /end COMPU_METHOD
/begin COMPU_METHOD Metrics_TaskTimes_Str._19_.ActiveTimeMax_Cnt_u32.CONVERSION "@@@@RuleName created by CANape" LINEAR "%3.1" "" COEFFS_LINEAR 0.00625 0 /end COMPU_METHOD
/begin COMPU_METHOD Metrics_TaskTimes_Str._19_.RunTimeMax_Cnt_u32.CONVERSION "@@@@RuleName created by CANape" LINEAR "%3.1" "" COEFFS_LINEAR 0.00625 0 /end COMPU_METHOD
/begin COMPU_METHOD Metrics_TaskTimes_Str._1_.ActiveTimeMax_Cnt_u32.CONVERSION "@@@@RuleName created by CANape" LINEAR "%3.1" "" COEFFS_LINEAR 0.00625 0 /end COMPU_METHOD
/begin COMPU_METHOD Metrics_TaskTimes_Str._1_.RunTimeMax_Cnt_u32.CONVERSION "@@@@RuleName created by CANape" LINEAR "%3.1" "" COEFFS_LINEAR 0.00625 0 /end COMPU_METHOD
/begin COMPU_METHOD Metrics_TaskTimes_Str._20_.ActiveTimeMax_Cnt_u32.CONVERSION "@@@@RuleName created by CANape" LINEAR "%3.1" "" COEFFS_LINEAR 0.00625 0 /end COMPU_METHOD
/begin COMPU_METHOD Metrics_TaskTimes_Str._20_.RunTimeMax_Cnt_u32.CONVERSION "@@@@RuleName created by CANape" LINEAR "%3.1" "" COEFFS_LINEAR 0.00625 0 /end COMPU_METHOD
/begin COMPU_METHOD Metrics_TaskTimes_Str._21_.ActiveTimeMax_Cnt_u32.CONVERSION "@@@@RuleName created by CANape" LINEAR "%3.1" "" COEFFS_LINEAR 0.00625 0 /end COMPU_METHOD
/begin COMPU_METHOD Metrics_TaskTimes_Str._21_.RunTimeMax_Cnt_u32.CONVERSION "@@@@RuleName created by CANape" LINEAR "%3.1" "" COEFFS_LINEAR 0.00625 0 /end COMPU_METHOD
/begin COMPU_METHOD Metrics_TaskTimes_Str._22_.ActiveTimeMax_Cnt_u32.CONVERSION "@@@@RuleName created by CANape" LINEAR "%3.1" "" COEFFS_LINEAR 0.00625 0 /end COMPU_METHOD
/begin COMPU_METHOD Metrics_TaskTimes_Str._22_.RunTimeMax_Cnt_u32.CONVERSION "@@@@RuleName created by CANape" LINEAR "%3.1" "" COEFFS_LINEAR 0.00625 0 /end COMPU_METHOD
/begin COMPU_METHOD Metrics_TaskTimes_Str._23_.ActiveTimeMax_Cnt_u32.CONVERSION "@@@@RuleName created by CANape" LINEAR "%3.1" "" COEFFS_LINEAR 0.00625 0 /end COMPU_METHOD
/begin COMPU_METHOD Metrics_TaskTimes_Str._23_.RunTimeMax_Cnt_u32.CONVERSION "@@@@RuleName created by CANape" LINEAR "%3.1" "" COEFFS_LINEAR 0.00625 0 /end COMPU_METHOD
/begin COMPU_METHOD Metrics_TaskTimes_Str._24_.ActiveTimeMax_Cnt_u32.CONVERSION "@@@@RuleName created by CANape" LINEAR "%3.1" "" COEFFS_LINEAR 0.00625 0 /end COMPU_METHOD
/begin COMPU_METHOD Metrics_TaskTimes_Str._24_.RunTimeMax_Cnt_u32.CONVERSION "@@@@RuleName created by CANape" LINEAR "%3.1" "" COEFFS_LINEAR 0.00625 0 /end COMPU_METHOD
/begin COMPU_METHOD Metrics_TaskTimes_Str._25_.ActiveTimeMax_Cnt_u32.CONVERSION "@@@@RuleName created by CANape" LINEAR "%3.1" "" COEFFS_LINEAR 0.00625 0 /end COMPU_METHOD
/begin COMPU_METHOD Metrics_TaskTimes_Str._25_.RunTimeMax_Cnt_u32.CONVERSION "@@@@RuleName created by CANape" LINEAR "%3.1" "" COEFFS_LINEAR 0.00625 0 /end COMPU_METHOD
/begin COMPU_METHOD Metrics_TaskTimes_Str._26_.ActiveTimeMax_Cnt_u32.CONVERSION "@@@@RuleName created by CANape" LINEAR "%3.1" "" COEFFS_LINEAR 0.00625 0 /end COMPU_METHOD
/begin COMPU_METHOD Metrics_TaskTimes_Str._26_.RunTimeMax_Cnt_u32.CONVERSION "@@@@RuleName created by CANape" LINEAR "%3.1" "" COEFFS_LINEAR 0.00625 0 /end COMPU_METHOD
/begin COMPU_METHOD Metrics_TaskTimes_Str._27_.ActiveTimeMax_Cnt_u32.CONVERSION "@@@@RuleName created by CANape" LINEAR "%3.1" "" COEFFS_LINEAR 0.00625 0 /end COMPU_METHOD
/begin COMPU_METHOD Metrics_TaskTimes_Str._27_.RunTimeMax_Cnt_u32.CONVERSION "@@@@RuleName created by CANape" LINEAR "%3.1" "" COEFFS_LINEAR 0.00625 0 /end COMPU_METHOD
/begin COMPU_METHOD Metrics_TaskTimes_Str._28_.ActiveTimeMax_Cnt_u32.CONVERSION "@@@@RuleName created by CANape" LINEAR "%3.1" "" COEFFS_LINEAR 0.00625 0 /end COMPU_METHOD
/begin COMPU_METHOD Metrics_TaskTimes_Str._28_.RunTimeMax_Cnt_u32.CONVERSION "@@@@RuleName created by CANape" LINEAR "%3.1" "" COEFFS_LINEAR 0.00625 0 /end COMPU_METHOD
/begin COMPU_METHOD Metrics_TaskTimes_Str._29_.ActiveTimeMax_Cnt_u32.CONVERSION "@@@@RuleName created by CANape" LINEAR "%3.1" "" COEFFS_LINEAR 0.00625 0 /end COMPU_METHOD
/begin COMPU_METHOD Metrics_TaskTimes_Str._29_.RunTimeMax_Cnt_u32.CONVERSION "@@@@RuleName created by CANape" LINEAR "%3.1" "" COEFFS_LINEAR 0.00625 0 /end COMPU_METHOD
/begin COMPU_METHOD Metrics_TaskTimes_Str._2_.ActiveTimeMax_Cnt_u32.CONVERSION "@@@@RuleName created by CANape" LINEAR "%3.1" "" COEFFS_LINEAR 0.00625 0 /end COMPU_METHOD
/begin COMPU_METHOD Metrics_TaskTimes_Str._2_.RunTimeMax_Cnt_u32.CONVERSION "@@@@RuleName created by CANape" LINEAR "%3.1" "" COEFFS_LINEAR 0.00625 0 /end COMPU_METHOD
/begin COMPU_METHOD Metrics_TaskTimes_Str._30_.ActiveTimeMax_Cnt_u32.CONVERSION "@@@@RuleName created by CANape" LINEAR "%3.1" "" COEFFS_LINEAR 0.00625 0 /end COMPU_METHOD
/begin COMPU_METHOD Metrics_TaskTimes_Str._30_.RunTimeMax_Cnt_u32.CONVERSION "@@@@RuleName created by CANape" LINEAR "%3.1" "" COEFFS_LINEAR 0.00625 0 /end COMPU_METHOD
/begin COMPU_METHOD Metrics_TaskTimes_Str._31_.ActiveTimeMax_Cnt_u32.CONVERSION "@@@@RuleName created by CANape" LINEAR "%3.1" "" COEFFS_LINEAR 0.00625 0 /end COMPU_METHOD
/begin COMPU_METHOD Metrics_TaskTimes_Str._31_.RunTimeMax_Cnt_u32.CONVERSION "@@@@RuleName created by CANape" LINEAR "%3.1" "" COEFFS_LINEAR 0.00625 0 /end COMPU_METHOD
/begin COMPU_METHOD Metrics_TaskTimes_Str._32_.ActiveTimeMax_Cnt_u32.CONVERSION "@@@@RuleName created by CANape" LINEAR "%3.1" "" COEFFS_LINEAR 0.00625 0 /end COMPU_METHOD
/begin COMPU_METHOD Metrics_TaskTimes_Str._32_.RunTimeMax_Cnt_u32.CONVERSION "@@@@RuleName created by CANape" LINEAR "%3.1" "" COEFFS_LINEAR 0.00625 0 /end COMPU_METHOD
/begin COMPU_METHOD Metrics_TaskTimes_Str._3_.ActiveTimeMax_Cnt_u32.CONVERSION "@@@@RuleName created by CANape" LINEAR "%3.1" "" COEFFS_LINEAR 0.00625 0 /end COMPU_METHOD
/begin COMPU_METHOD Metrics_TaskTimes_Str._3_.RunTimeMax_Cnt_u32.CONVERSION "@@@@RuleName created by CANape" LINEAR "%3.1" "" COEFFS_LINEAR 0.00625 0 /end COMPU_METHOD
/begin COMPU_METHOD Metrics_TaskTimes_Str._4_.ActiveTimeMax_Cnt_u32.CONVERSION "@@@@RuleName created by CANape" LINEAR "%3.1" "" COEFFS_LINEAR 0.00625 0 /end COMPU_METHOD
/begin COMPU_METHOD Metrics_TaskTimes_Str._4_.RunTimeMax_Cnt_u32.CONVERSION "@@@@RuleName created by CANape" LINEAR "%3.1" "" COEFFS_LINEAR 0.00625 0 /end COMPU_METHOD
/begin COMPU_METHOD Metrics_TaskTimes_Str._5_.ActiveTimeMax_Cnt_u32.CONVERSION "@@@@RuleName created by CANape" LINEAR "%3.1" "" COEFFS_LINEAR 0.00625 0 /end COMPU_METHOD
/begin COMPU_METHOD Metrics_TaskTimes_Str._5_.RunTimeMax_Cnt_u32.CONVERSION "@@@@RuleName created by CANape" LINEAR "%3.1" "" COEFFS_LINEAR 0.00625 0 /end COMPU_METHOD
/begin COMPU_METHOD Metrics_TaskTimes_Str._6_.ActiveTimeMax_Cnt_u32.CONVERSION "@@@@RuleName created by CANape" LINEAR "%3.1" "" COEFFS_LINEAR 0.00625 0 /end COMPU_METHOD
/begin COMPU_METHOD Metrics_TaskTimes_Str._6_.RunTimeMax_Cnt_u32.CONVERSION "@@@@RuleName created by CANape" LINEAR "%3.1" "" COEFFS_LINEAR 0.00625 0 /end COMPU_METHOD
/begin COMPU_METHOD Metrics_TaskTimes_Str._7_.ActiveTimeMax_Cnt_u32.CONVERSION "@@@@RuleName created by CANape" LINEAR "%3.1" "" COEFFS_LINEAR 0.00625 0 /end COMPU_METHOD
/begin COMPU_METHOD Metrics_TaskTimes_Str._7_.RunTimeMax_Cnt_u32.CONVERSION "@@@@RuleName created by CANape" LINEAR "%3.1" "" COEFFS_LINEAR 0.00625 0 /end COMPU_METHOD
/begin COMPU_METHOD Metrics_TaskTimes_Str._8_.ActiveTimeMax_Cnt_u32.CONVERSION "@@@@RuleName created by CANape" LINEAR "%3.1" "" COEFFS_LINEAR 0.00625 0 /end COMPU_METHOD
/begin COMPU_METHOD Metrics_TaskTimes_Str._8_.RunTimeMax_Cnt_u32.CONVERSION "@@@@RuleName created by CANape" LINEAR "%3.1" "" COEFFS_LINEAR 0.00625 0 /end COMPU_METHOD
/begin COMPU_METHOD Metrics_TaskTimes_Str._9_.ActiveTimeMax_Cnt_u32.CONVERSION "@@@@RuleName created by CANape" LINEAR "%3.1" "" COEFFS_LINEAR 0.00625 0 /end COMPU_METHOD
/begin COMPU_METHOD Metrics_TaskTimes_Str._9_.RunTimeMax_Cnt_u32.CONVERSION "@@@@RuleName created by CANape" LINEAR "%3.1" "" COEFFS_LINEAR 0.00625 0 /end COMPU_METHOD
/begin COMPU_METHOD RTE_CM_BOOLEAN "" TAB_VERB "%3.1" "" COMPU_TAB_REF RTE_CM_BOOLEAN /end COMPU_METHOD
/begin COMPU_METHOD RTE_CM_ENUM_FETFAULTTYPE_ENUM "" TAB_VERB "%.1" "" COMPU_TAB_REF RTE_CM_ENUM_FETFAULTTYPE_ENUM /end COMPU_METHOD
/begin COMPU_METHOD RTE_CM_ENUM_FETPHASETYPE_ENUM "" TAB_VERB "%.1" "" COMPU_TAB_REF RTE_CM_ENUM_FETPHASETYPE_ENUM /end COMPU_METHOD
/begin COMPU_METHOD RTE_CM_ENUM_ManufModeType "" TAB_VERB "%.1" "" COMPU_TAB_REF RTE_CM_ENUM_ManufModeType /end COMPU_METHOD
/begin COMPU_METHOD RTE_CM_ENUM_StaMd_Mode "" TAB_VERB "%.1" "" COMPU_TAB_REF RTE_CM_ENUM_StaMd_Mode /end COMPU_METHOD
/begin COMPU_METHOD RTE_CM_ENUM_TOC_STATE "" TAB_VERB "%.1" "" COMPU_TAB_REF RTE_CM_ENUM_TOC_STATE /end COMPU_METHOD
/begin COMPU_METHOD RTE_CM_STRING "" TAB_VERB "%.1" "" COMPU_TAB_REF RTE_CM_STRING /end COMPU_METHOD
/begin CHARACTERISTIC Metrics_TaskTimes_Str._0_.ActiveTimeMax_Cnt_u32 "" VALUE 0x80044BC __ULONG_S 0 Metrics_TaskTimes_Str._0_.ActiveTimeMax_Cnt_u32.CONVERSION 0 4294967295 FORMAT "%.2" /end CHARACTERISTIC
/begin CHARACTERISTIC Metrics_TaskTimes_Str._0_.CpuUse_Pct_f32 "" VALUE 0x80044D4 __FLOAT32_IEEE_S 0 NO_COMPU_METHOD -3.4e+038 3.4e+038 FORMAT "%.15" PHYS_UNIT "%" /end CHARACTERISTIC
/begin CHARACTERISTIC Metrics_TaskTimes_Str._0_.RunTimeMax_Cnt_u32 "" VALUE 0x80044C0 __ULONG_S 0 Metrics_TaskTimes_Str._0_.RunTimeMax_Cnt_u32.CONVERSION 0 4294967295 FORMAT "%.2" /end CHARACTERISTIC
/begin CHARACTERISTIC Metrics_TaskTimes_Str._0_.StackSize_Byte_u16 "" VALUE 0x80044DA __UWORD_S 0 NO_COMPU_METHOD 0 65535 FORMAT "%.15" /end CHARACTERISTIC
/begin CHARACTERISTIC Metrics_TaskTimes_Str._0_.StackUse_Byte_u16 "" VALUE 0x80044D8 __UWORD_S 0 NO_COMPU_METHOD 0 65535 FORMAT "%.15" /end CHARACTERISTIC
/begin CHARACTERISTIC Metrics_TaskTimes_Str._10_.ActiveTimeMax_Cnt_u32 "" VALUE 0x80045FC __ULONG_S 0 Metrics_TaskTimes_Str._10_.ActiveTimeMax_Cnt_u32.CONVERSION 0 4294967295 FORMAT "%.2" /end CHARACTERISTIC
/begin CHARACTERISTIC Metrics_TaskTimes_Str._10_.CpuUse_Pct_f32 "" VALUE 0x8004614 __FLOAT32_IEEE_S 0 NO_COMPU_METHOD -3.4e+038 3.4e+038 FORMAT "%.15" PHYS_UNIT "%" /end CHARACTERISTIC
/begin CHARACTERISTIC Metrics_TaskTimes_Str._10_.RunTimeMax_Cnt_u32 "" VALUE 0x8004600 __ULONG_S 0 Metrics_TaskTimes_Str._10_.RunTimeMax_Cnt_u32.CONVERSION 0 4294967295 FORMAT "%.2" /end CHARACTERISTIC
/begin CHARACTERISTIC Metrics_TaskTimes_Str._10_.StackSize_Byte_u16 "" VALUE 0x800461A __UWORD_S 0 NO_COMPU_METHOD 0 65535 FORMAT "%.15" /end CHARACTERISTIC
/begin CHARACTERISTIC Metrics_TaskTimes_Str._10_.StackUse_Byte_u16 "" VALUE 0x8004618 __UWORD_S 0 NO_COMPU_METHOD 0 65535 FORMAT "%.15" /end CHARACTERISTIC
/begin CHARACTERISTIC Metrics_TaskTimes_Str._11_.ActiveTimeMax_Cnt_u32 "" VALUE 0x800461C __ULONG_S 0 Metrics_TaskTimes_Str._11_.ActiveTimeMax_Cnt_u32.CONVERSION 0 4294967295 FORMAT "%.2" /end CHARACTERISTIC
/begin CHARACTERISTIC Metrics_TaskTimes_Str._11_.CpuUse_Pct_f32 "" VALUE 0x8004634 __FLOAT32_IEEE_S 0 NO_COMPU_METHOD -3.4e+038 3.4e+038 FORMAT "%.15" PHYS_UNIT "%" /end CHARACTERISTIC
/begin CHARACTERISTIC Metrics_TaskTimes_Str._11_.RunTimeMax_Cnt_u32 "" VALUE 0x8004620 __ULONG_S 0 Metrics_TaskTimes_Str._11_.RunTimeMax_Cnt_u32.CONVERSION 0 4294967295 FORMAT "%.2" /end CHARACTERISTIC
/begin CHARACTERISTIC Metrics_TaskTimes_Str._11_.StackSize_Byte_u16 "" VALUE 0x800463A __UWORD_S 0 NO_COMPU_METHOD 0 65535 FORMAT "%.15" /end CHARACTERISTIC
/begin CHARACTERISTIC Metrics_TaskTimes_Str._11_.StackUse_Byte_u16 "" VALUE 0x8004638 __UWORD_S 0 NO_COMPU_METHOD 0 65535 FORMAT "%.15" /end CHARACTERISTIC
/begin CHARACTERISTIC Metrics_TaskTimes_Str._12_.ActiveTimeMax_Cnt_u32 "" VALUE 0x800463C __ULONG_S 0 Metrics_TaskTimes_Str._12_.ActiveTimeMax_Cnt_u32.CONVERSION 0 4294967295 FORMAT "%.2" /end CHARACTERISTIC
/begin CHARACTERISTIC Metrics_TaskTimes_Str._12_.CpuUse_Pct_f32 "" VALUE 0x8004654 __FLOAT32_IEEE_S 0 NO_COMPU_METHOD -3.4e+038 3.4e+038 FORMAT "%.15" PHYS_UNIT "%" /end CHARACTERISTIC
/begin CHARACTERISTIC Metrics_TaskTimes_Str._12_.RunTimeMax_Cnt_u32 "" VALUE 0x8004640 __ULONG_S 0 Metrics_TaskTimes_Str._12_.RunTimeMax_Cnt_u32.CONVERSION 0 4294967295 FORMAT "%.2" /end CHARACTERISTIC
/begin CHARACTERISTIC Metrics_TaskTimes_Str._12_.StackSize_Byte_u16 "" VALUE 0x800465A __UWORD_S 0 NO_COMPU_METHOD 0 65535 FORMAT "%.15" /end CHARACTERISTIC
/begin CHARACTERISTIC Metrics_TaskTimes_Str._12_.StackUse_Byte_u16 "" VALUE 0x8004658 __UWORD_S 0 NO_COMPU_METHOD 0 65535 FORMAT "%.15" /end CHARACTERISTIC
/begin CHARACTERISTIC Metrics_TaskTimes_Str._13_.ActiveTimeMax_Cnt_u32 "" VALUE 0x800465C __ULONG_S 0 Metrics_TaskTimes_Str._13_.ActiveTimeMax_Cnt_u32.CONVERSION 0 4294967295 FORMAT "%.2" /end CHARACTERISTIC
/begin CHARACTERISTIC Metrics_TaskTimes_Str._13_.CpuUse_Pct_f32 "" VALUE 0x8004674 __FLOAT32_IEEE_S 0 NO_COMPU_METHOD -3.4e+038 3.4e+038 FORMAT "%.15" PHYS_UNIT "%" /end CHARACTERISTIC
/begin CHARACTERISTIC Metrics_TaskTimes_Str._13_.RunTimeMax_Cnt_u32 "" VALUE 0x8004660 __ULONG_S 0 Metrics_TaskTimes_Str._13_.RunTimeMax_Cnt_u32.CONVERSION 0 4294967295 FORMAT "%.2" /end CHARACTERISTIC
/begin CHARACTERISTIC Metrics_TaskTimes_Str._13_.StackSize_Byte_u16 "" VALUE 0x800467A __UWORD_S 0 NO_COMPU_METHOD 0 65535 FORMAT "%.15" /end CHARACTERISTIC
/begin CHARACTERISTIC Metrics_TaskTimes_Str._13_.StackUse_Byte_u16 "" VALUE 0x8004678 __UWORD_S 0 NO_COMPU_METHOD 0 65535 FORMAT "%.15" /end CHARACTERISTIC
/begin CHARACTERISTIC Metrics_TaskTimes_Str._14_.ActiveTimeMax_Cnt_u32 "" VALUE 0x800467C __ULONG_S 0 Metrics_TaskTimes_Str._14_.ActiveTimeMax_Cnt_u32.CONVERSION 0 4294967295 FORMAT "%.2" /end CHARACTERISTIC
/begin CHARACTERISTIC Metrics_TaskTimes_Str._14_.CpuUse_Pct_f32 "" VALUE 0x8004694 __FLOAT32_IEEE_S 0 NO_COMPU_METHOD -3.4e+038 3.4e+038 FORMAT "%.15" PHYS_UNIT "%" /end CHARACTERISTIC
/begin CHARACTERISTIC Metrics_TaskTimes_Str._14_.RunTimeMax_Cnt_u32 "" VALUE 0x8004680 __ULONG_S 0 Metrics_TaskTimes_Str._14_.RunTimeMax_Cnt_u32.CONVERSION 0 4294967295 FORMAT "%.2" /end CHARACTERISTIC
/begin CHARACTERISTIC Metrics_TaskTimes_Str._14_.StackSize_Byte_u16 "" VALUE 0x800469A __UWORD_S 0 NO_COMPU_METHOD 0 65535 FORMAT "%.15" /end CHARACTERISTIC
/begin CHARACTERISTIC Metrics_TaskTimes_Str._14_.StackUse_Byte_u16 "" VALUE 0x8004698 __UWORD_S 0 NO_COMPU_METHOD 0 65535 FORMAT "%.15" /end CHARACTERISTIC
/begin CHARACTERISTIC Metrics_TaskTimes_Str._15_.ActiveTimeMax_Cnt_u32 "" VALUE 0x800469C __ULONG_S 0 Metrics_TaskTimes_Str._15_.ActiveTimeMax_Cnt_u32.CONVERSION 0 4294967295 FORMAT "%.2" /end CHARACTERISTIC
/begin CHARACTERISTIC Metrics_TaskTimes_Str._15_.CpuUse_Pct_f32 "" VALUE 0x80046B4 __FLOAT32_IEEE_S 0 NO_COMPU_METHOD -3.4e+038 3.4e+038 FORMAT "%.15" PHYS_UNIT "%" /end CHARACTERISTIC
/begin CHARACTERISTIC Metrics_TaskTimes_Str._15_.RunTimeMax_Cnt_u32 "" VALUE 0x80046A0 __ULONG_S 0 Metrics_TaskTimes_Str._15_.RunTimeMax_Cnt_u32.CONVERSION 0 4294967295 FORMAT "%.2" /end CHARACTERISTIC
/begin CHARACTERISTIC Metrics_TaskTimes_Str._15_.StackSize_Byte_u16 "" VALUE 0x80046BA __UWORD_S 0 NO_COMPU_METHOD 0 65535 FORMAT "%.15" /end CHARACTERISTIC
/begin CHARACTERISTIC Metrics_TaskTimes_Str._15_.StackUse_Byte_u16 "" VALUE 0x80046B8 __UWORD_S 0 NO_COMPU_METHOD 0 65535 FORMAT "%.15" /end CHARACTERISTIC
/begin CHARACTERISTIC Metrics_TaskTimes_Str._16_.ActiveTimeMax_Cnt_u32 "" VALUE 0x80046BC __ULONG_S 0 Metrics_TaskTimes_Str._16_.ActiveTimeMax_Cnt_u32.CONVERSION 0 4294967295 FORMAT "%.2" /end CHARACTERISTIC
/begin CHARACTERISTIC Metrics_TaskTimes_Str._16_.CpuUse_Pct_f32 "" VALUE 0x80046D4 __FLOAT32_IEEE_S 0 NO_COMPU_METHOD -3.4e+038 3.4e+038 FORMAT "%.15" PHYS_UNIT "%" /end CHARACTERISTIC
/begin CHARACTERISTIC Metrics_TaskTimes_Str._16_.RunTimeMax_Cnt_u32 "" VALUE 0x80046C0 __ULONG_S 0 Metrics_TaskTimes_Str._16_.RunTimeMax_Cnt_u32.CONVERSION 0 4294967295 FORMAT "%.2" /end CHARACTERISTIC
/begin CHARACTERISTIC Metrics_TaskTimes_Str._16_.StackSize_Byte_u16 "" VALUE 0x80046DA __UWORD_S 0 NO_COMPU_METHOD 0 65535 FORMAT "%.15" /end CHARACTERISTIC
/begin CHARACTERISTIC Metrics_TaskTimes_Str._16_.StackUse_Byte_u16 "" VALUE 0x80046D8 __UWORD_S 0 NO_COMPU_METHOD 0 65535 FORMAT "%.15" /end CHARACTERISTIC
/begin CHARACTERISTIC Metrics_TaskTimes_Str._17_.ActiveTimeMax_Cnt_u32 "" VALUE 0x80046DC __ULONG_S 0 Metrics_TaskTimes_Str._17_.ActiveTimeMax_Cnt_u32.CONVERSION 0 4294967295 FORMAT "%.2" /end CHARACTERISTIC
/begin CHARACTERISTIC Metrics_TaskTimes_Str._17_.CpuUse_Pct_f32 "" VALUE 0x80046F4 __FLOAT32_IEEE_S 0 NO_COMPU_METHOD -3.4e+038 3.4e+038 FORMAT "%.15" PHYS_UNIT "%" /end CHARACTERISTIC
/begin CHARACTERISTIC Metrics_TaskTimes_Str._17_.RunTimeMax_Cnt_u32 "" VALUE 0x80046E0 __ULONG_S 0 Metrics_TaskTimes_Str._17_.RunTimeMax_Cnt_u32.CONVERSION 0 4294967295 FORMAT "%.2" /end CHARACTERISTIC
/begin CHARACTERISTIC Metrics_TaskTimes_Str._17_.StackSize_Byte_u16 "" VALUE 0x80046FA __UWORD_S 0 NO_COMPU_METHOD 0 65535 FORMAT "%.15" /end CHARACTERISTIC
/begin CHARACTERISTIC Metrics_TaskTimes_Str._17_.StackUse_Byte_u16 "" VALUE 0x80046F8 __UWORD_S 0 NO_COMPU_METHOD 0 65535 FORMAT "%.15" /end CHARACTERISTIC
/begin CHARACTERISTIC Metrics_TaskTimes_Str._18_.ActiveTimeMax_Cnt_u32 "" VALUE 0x80046FC __ULONG_S 0 Metrics_TaskTimes_Str._18_.ActiveTimeMax_Cnt_u32.CONVERSION 0 4294967295 FORMAT "%.2" /end CHARACTERISTIC
/begin CHARACTERISTIC Metrics_TaskTimes_Str._18_.CpuUse_Pct_f32 "" VALUE 0x8004714 __FLOAT32_IEEE_S 0 NO_COMPU_METHOD -3.4e+038 3.4e+038 FORMAT "%.15" PHYS_UNIT "%" /end CHARACTERISTIC
/begin CHARACTERISTIC Metrics_TaskTimes_Str._18_.RunTimeMax_Cnt_u32 "" VALUE 0x8004700 __ULONG_S 0 Metrics_TaskTimes_Str._18_.RunTimeMax_Cnt_u32.CONVERSION 0 4294967295 FORMAT "%.2" /end CHARACTERISTIC
/begin CHARACTERISTIC Metrics_TaskTimes_Str._18_.StackSize_Byte_u16 "" VALUE 0x800471A __UWORD_S 0 NO_COMPU_METHOD 0 65535 FORMAT "%.15" /end CHARACTERISTIC
/begin CHARACTERISTIC Metrics_TaskTimes_Str._18_.StackUse_Byte_u16 "" VALUE 0x8004718 __UWORD_S 0 NO_COMPU_METHOD 0 65535 FORMAT "%.15" /end CHARACTERISTIC
/begin CHARACTERISTIC Metrics_TaskTimes_Str._19_.ActiveTimeMax_Cnt_u32 "" VALUE 0x800471C __ULONG_S 0 Metrics_TaskTimes_Str._19_.ActiveTimeMax_Cnt_u32.CONVERSION 0 4294967295 FORMAT "%.2" /end CHARACTERISTIC
/begin CHARACTERISTIC Metrics_TaskTimes_Str._19_.CpuUse_Pct_f32 "" VALUE 0x8004734 __FLOAT32_IEEE_S 0 NO_COMPU_METHOD -3.4e+038 3.4e+038 FORMAT "%.15" PHYS_UNIT "%" /end CHARACTERISTIC
/begin CHARACTERISTIC Metrics_TaskTimes_Str._19_.RunTimeMax_Cnt_u32 "" VALUE 0x8004720 __ULONG_S 0 Metrics_TaskTimes_Str._19_.RunTimeMax_Cnt_u32.CONVERSION 0 4294967295 FORMAT "%.2" /end CHARACTERISTIC
/begin CHARACTERISTIC Metrics_TaskTimes_Str._19_.StackSize_Byte_u16 "" VALUE 0x800473A __UWORD_S 0 NO_COMPU_METHOD 0 65535 FORMAT "%.15" /end CHARACTERISTIC
/begin CHARACTERISTIC Metrics_TaskTimes_Str._19_.StackUse_Byte_u16 "" VALUE 0x8004738 __UWORD_S 0 NO_COMPU_METHOD 0 65535 FORMAT "%.15" /end CHARACTERISTIC
/begin CHARACTERISTIC Metrics_TaskTimes_Str._1_.ActiveTimeMax_Cnt_u32 "" VALUE 0x80044DC __ULONG_S 0 Metrics_TaskTimes_Str._1_.ActiveTimeMax_Cnt_u32.CONVERSION 0 4294967295 FORMAT "%.2" /end CHARACTERISTIC
/begin CHARACTERISTIC Metrics_TaskTimes_Str._1_.CpuUse_Pct_f32 "" VALUE 0x80044F4 __FLOAT32_IEEE_S 0 NO_COMPU_METHOD -3.4e+038 3.4e+038 FORMAT "%.15" PHYS_UNIT "%" /end CHARACTERISTIC
/begin CHARACTERISTIC Metrics_TaskTimes_Str._1_.RunTimeMax_Cnt_u32 "" VALUE 0x80044E0 __ULONG_S 0 Metrics_TaskTimes_Str._1_.RunTimeMax_Cnt_u32.CONVERSION 0 4294967295 FORMAT "%.2" /end CHARACTERISTIC
/begin CHARACTERISTIC Metrics_TaskTimes_Str._1_.StackSize_Byte_u16 "" VALUE 0x80044FA __UWORD_S 0 NO_COMPU_METHOD 0 65535 FORMAT "%.15" /end CHARACTERISTIC
/begin CHARACTERISTIC Metrics_TaskTimes_Str._1_.StackUse_Byte_u16 "" VALUE 0x80044F8 __UWORD_S 0 NO_COMPU_METHOD 0 65535 FORMAT "%.15" /end CHARACTERISTIC
/begin CHARACTERISTIC Metrics_TaskTimes_Str._20_.ActiveTimeMax_Cnt_u32 "" VALUE 0x800473C __ULONG_S 0 Metrics_TaskTimes_Str._20_.ActiveTimeMax_Cnt_u32.CONVERSION 0 4294967295 FORMAT "%.2" /end CHARACTERISTIC
/begin CHARACTERISTIC Metrics_TaskTimes_Str._20_.CpuUse_Pct_f32 "" VALUE 0x8004754 __FLOAT32_IEEE_S 0 NO_COMPU_METHOD -3.4e+038 3.4e+038 FORMAT "%.15" PHYS_UNIT "%" /end CHARACTERISTIC
/begin CHARACTERISTIC Metrics_TaskTimes_Str._20_.RunTimeMax_Cnt_u32 "" VALUE 0x8004740 __ULONG_S 0 Metrics_TaskTimes_Str._20_.RunTimeMax_Cnt_u32.CONVERSION 0 4294967295 FORMAT "%.2" /end CHARACTERISTIC
/begin CHARACTERISTIC Metrics_TaskTimes_Str._20_.StackSize_Byte_u16 "" VALUE 0x800475A __UWORD_S 0 NO_COMPU_METHOD 0 65535 FORMAT "%.15" /end CHARACTERISTIC
/begin CHARACTERISTIC Metrics_TaskTimes_Str._20_.StackUse_Byte_u16 "" VALUE 0x8004758 __UWORD_S 0 NO_COMPU_METHOD 0 65535 FORMAT "%.15" /end CHARACTERISTIC
/begin CHARACTERISTIC Metrics_TaskTimes_Str._21_.ActiveTimeMax_Cnt_u32 "" VALUE 0x800475C __ULONG_S 0 Metrics_TaskTimes_Str._21_.ActiveTimeMax_Cnt_u32.CONVERSION 0 4294967295 FORMAT "%.2" /end CHARACTERISTIC
/begin CHARACTERISTIC Metrics_TaskTimes_Str._21_.CpuUse_Pct_f32 "" VALUE 0x8004774 __FLOAT32_IEEE_S 0 NO_COMPU_METHOD -3.4e+038 3.4e+038 FORMAT "%.15" PHYS_UNIT "%" /end CHARACTERISTIC
/begin CHARACTERISTIC Metrics_TaskTimes_Str._21_.RunTimeMax_Cnt_u32 "" VALUE 0x8004760 __ULONG_S 0 Metrics_TaskTimes_Str._21_.RunTimeMax_Cnt_u32.CONVERSION 0 4294967295 FORMAT "%.2" /end CHARACTERISTIC
/begin CHARACTERISTIC Metrics_TaskTimes_Str._21_.StackSize_Byte_u16 "" VALUE 0x800477A __UWORD_S 0 NO_COMPU_METHOD 0 65535 FORMAT "%.15" /end CHARACTERISTIC
/begin CHARACTERISTIC Metrics_TaskTimes_Str._21_.StackUse_Byte_u16 "" VALUE 0x8004778 __UWORD_S 0 NO_COMPU_METHOD 0 65535 FORMAT "%.15" /end CHARACTERISTIC
/begin CHARACTERISTIC Metrics_TaskTimes_Str._22_.ActiveTimeMax_Cnt_u32 "" VALUE 0x800477C __ULONG_S 0 Metrics_TaskTimes_Str._22_.ActiveTimeMax_Cnt_u32.CONVERSION 0 4294967295 FORMAT "%.2" /end CHARACTERISTIC
/begin CHARACTERISTIC Metrics_TaskTimes_Str._22_.CpuUse_Pct_f32 "" VALUE 0x8004794 __FLOAT32_IEEE_S 0 NO_COMPU_METHOD -3.4e+038 3.4e+038 FORMAT "%.15" PHYS_UNIT "%" /end CHARACTERISTIC
/begin CHARACTERISTIC Metrics_TaskTimes_Str._22_.RunTimeMax_Cnt_u32 "" VALUE 0x8004780 __ULONG_S 0 Metrics_TaskTimes_Str._22_.RunTimeMax_Cnt_u32.CONVERSION 0 4294967295 FORMAT "%.2" /end CHARACTERISTIC
/begin CHARACTERISTIC Metrics_TaskTimes_Str._22_.StackSize_Byte_u16 "" VALUE 0x800479A __UWORD_S 0 NO_COMPU_METHOD 0 65535 FORMAT "%.15" /end CHARACTERISTIC
/begin CHARACTERISTIC Metrics_TaskTimes_Str._22_.StackUse_Byte_u16 "" VALUE 0x8004798 __UWORD_S 0 NO_COMPU_METHOD 0 65535 FORMAT "%.15" /end CHARACTERISTIC
/begin CHARACTERISTIC Metrics_TaskTimes_Str._23_.ActiveTimeMax_Cnt_u32 "" VALUE 0x800479C __ULONG_S 0 Metrics_TaskTimes_Str._23_.ActiveTimeMax_Cnt_u32.CONVERSION 0 4294967295 FORMAT "%.2" /end CHARACTERISTIC
/begin CHARACTERISTIC Metrics_TaskTimes_Str._23_.CpuUse_Pct_f32 "" VALUE 0x80047B4 __FLOAT32_IEEE_S 0 NO_COMPU_METHOD -3.4e+038 3.4e+038 FORMAT "%.15" PHYS_UNIT "%" /end CHARACTERISTIC
/begin CHARACTERISTIC Metrics_TaskTimes_Str._23_.RunTimeMax_Cnt_u32 "" VALUE 0x80047A0 __ULONG_S 0 Metrics_TaskTimes_Str._23_.RunTimeMax_Cnt_u32.CONVERSION 0 4294967295 FORMAT "%.2" /end CHARACTERISTIC
/begin CHARACTERISTIC Metrics_TaskTimes_Str._23_.StackSize_Byte_u16 "" VALUE 0x80047BA __UWORD_S 0 NO_COMPU_METHOD 0 65535 FORMAT "%.15" /end CHARACTERISTIC
/begin CHARACTERISTIC Metrics_TaskTimes_Str._23_.StackUse_Byte_u16 "" VALUE 0x80047B8 __UWORD_S 0 NO_COMPU_METHOD 0 65535 FORMAT "%.15" /end CHARACTERISTIC
/begin CHARACTERISTIC Metrics_TaskTimes_Str._24_.ActiveTimeMax_Cnt_u32 "" VALUE 0x80047BC __ULONG_S 0 Metrics_TaskTimes_Str._24_.ActiveTimeMax_Cnt_u32.CONVERSION 0 4294967295 FORMAT "%.2" /end CHARACTERISTIC
/begin CHARACTERISTIC Metrics_TaskTimes_Str._24_.CpuUse_Pct_f32 "" VALUE 0x80047D4 __FLOAT32_IEEE_S 0 NO_COMPU_METHOD -3.4e+038 3.4e+038 FORMAT "%.15" PHYS_UNIT "%" /end CHARACTERISTIC
/begin CHARACTERISTIC Metrics_TaskTimes_Str._24_.RunTimeMax_Cnt_u32 "" VALUE 0x80047C0 __ULONG_S 0 Metrics_TaskTimes_Str._24_.RunTimeMax_Cnt_u32.CONVERSION 0 4294967295 FORMAT "%.2" /end CHARACTERISTIC
/begin CHARACTERISTIC Metrics_TaskTimes_Str._24_.StackSize_Byte_u16 "" VALUE 0x80047DA __UWORD_S 0 NO_COMPU_METHOD 0 65535 FORMAT "%.15" /end CHARACTERISTIC
/begin CHARACTERISTIC Metrics_TaskTimes_Str._24_.StackUse_Byte_u16 "" VALUE 0x80047D8 __UWORD_S 0 NO_COMPU_METHOD 0 65535 FORMAT "%.15" /end CHARACTERISTIC
/begin CHARACTERISTIC Metrics_TaskTimes_Str._25_.ActiveTimeMax_Cnt_u32 "" VALUE 0x80047DC __ULONG_S 0 Metrics_TaskTimes_Str._25_.ActiveTimeMax_Cnt_u32.CONVERSION 0 4294967295 FORMAT "%.2" /end CHARACTERISTIC
/begin CHARACTERISTIC Metrics_TaskTimes_Str._25_.CpuUse_Pct_f32 "" VALUE 0x80047F4 __FLOAT32_IEEE_S 0 NO_COMPU_METHOD -3.4e+038 3.4e+038 FORMAT "%.15" PHYS_UNIT "%" /end CHARACTERISTIC
/begin CHARACTERISTIC Metrics_TaskTimes_Str._25_.RunTimeMax_Cnt_u32 "" VALUE 0x80047E0 __ULONG_S 0 Metrics_TaskTimes_Str._25_.RunTimeMax_Cnt_u32.CONVERSION 0 4294967295 FORMAT "%.2" /end CHARACTERISTIC
/begin CHARACTERISTIC Metrics_TaskTimes_Str._25_.StackSize_Byte_u16 "" VALUE 0x80047FA __UWORD_S 0 NO_COMPU_METHOD 0 65535 FORMAT "%.15" /end CHARACTERISTIC
/begin CHARACTERISTIC Metrics_TaskTimes_Str._25_.StackUse_Byte_u16 "" VALUE 0x80047F8 __UWORD_S 0 NO_COMPU_METHOD 0 65535 FORMAT "%.15" /end CHARACTERISTIC
/begin CHARACTERISTIC Metrics_TaskTimes_Str._26_.ActiveTimeMax_Cnt_u32 "" VALUE 0x80047FC __ULONG_S 0 Metrics_TaskTimes_Str._26_.ActiveTimeMax_Cnt_u32.CONVERSION 0 4294967295 FORMAT "%.2" /end CHARACTERISTIC
/begin CHARACTERISTIC Metrics_TaskTimes_Str._26_.CpuUse_Pct_f32 "" VALUE 0x8004814 __FLOAT32_IEEE_S 0 NO_COMPU_METHOD -3.4e+038 3.4e+038 FORMAT "%.15" PHYS_UNIT "%" /end CHARACTERISTIC
/begin CHARACTERISTIC Metrics_TaskTimes_Str._26_.RunTimeMax_Cnt_u32 "" VALUE 0x8004800 __ULONG_S 0 Metrics_TaskTimes_Str._26_.RunTimeMax_Cnt_u32.CONVERSION 0 4294967295 FORMAT "%.2" /end CHARACTERISTIC
/begin CHARACTERISTIC Metrics_TaskTimes_Str._26_.StackSize_Byte_u16 "" VALUE 0x800481A __UWORD_S 0 NO_COMPU_METHOD 0 65535 FORMAT "%.15" /end CHARACTERISTIC
/begin CHARACTERISTIC Metrics_TaskTimes_Str._26_.StackUse_Byte_u16 "" VALUE 0x8004818 __UWORD_S 0 NO_COMPU_METHOD 0 65535 FORMAT "%.15" /end CHARACTERISTIC
/begin CHARACTERISTIC Metrics_TaskTimes_Str._27_.ActiveTimeMax_Cnt_u32 "" VALUE 0x800481C __ULONG_S 0 Metrics_TaskTimes_Str._27_.ActiveTimeMax_Cnt_u32.CONVERSION 0 4294967295 FORMAT "%.2" /end CHARACTERISTIC
/begin CHARACTERISTIC Metrics_TaskTimes_Str._27_.CpuUse_Pct_f32 "" VALUE 0x8004834 __FLOAT32_IEEE_S 0 NO_COMPU_METHOD -3.4e+038 3.4e+038 FORMAT "%.15" PHYS_UNIT "%" /end CHARACTERISTIC
/begin CHARACTERISTIC Metrics_TaskTimes_Str._27_.RunTimeMax_Cnt_u32 "" VALUE 0x8004820 __ULONG_S 0 Metrics_TaskTimes_Str._27_.RunTimeMax_Cnt_u32.CONVERSION 0 4294967295 FORMAT "%.2" /end CHARACTERISTIC
/begin CHARACTERISTIC Metrics_TaskTimes_Str._27_.StackSize_Byte_u16 "" VALUE 0x800483A __UWORD_S 0 NO_COMPU_METHOD 0 65535 FORMAT "%.15" /end CHARACTERISTIC
/begin CHARACTERISTIC Metrics_TaskTimes_Str._27_.StackUse_Byte_u16 "" VALUE 0x8004838 __UWORD_S 0 NO_COMPU_METHOD 0 65535 FORMAT "%.15" /end CHARACTERISTIC
/begin CHARACTERISTIC Metrics_TaskTimes_Str._28_.ActiveTimeMax_Cnt_u32 "" VALUE 0x800483C __ULONG_S 0 Metrics_TaskTimes_Str._28_.ActiveTimeMax_Cnt_u32.CONVERSION 0 4294967295 FORMAT "%.2" /end CHARACTERISTIC
/begin CHARACTERISTIC Metrics_TaskTimes_Str._28_.CpuUse_Pct_f32 "" VALUE 0x8004854 __FLOAT32_IEEE_S 0 NO_COMPU_METHOD -3.4e+038 3.4e+038 FORMAT "%.15" PHYS_UNIT "%" /end CHARACTERISTIC
/begin CHARACTERISTIC Metrics_TaskTimes_Str._28_.RunTimeMax_Cnt_u32 "" VALUE 0x8004840 __ULONG_S 0 Metrics_TaskTimes_Str._28_.RunTimeMax_Cnt_u32.CONVERSION 0 4294967295 FORMAT "%.2" /end CHARACTERISTIC
/begin CHARACTERISTIC Metrics_TaskTimes_Str._28_.StackSize_Byte_u16 "" VALUE 0x800485A __UWORD_S 0 NO_COMPU_METHOD 0 65535 FORMAT "%.15" /end CHARACTERISTIC
/begin CHARACTERISTIC Metrics_TaskTimes_Str._28_.StackUse_Byte_u16 "" VALUE 0x8004858 __UWORD_S 0 NO_COMPU_METHOD 0 65535 FORMAT "%.15" /end CHARACTERISTIC
/begin CHARACTERISTIC Metrics_TaskTimes_Str._29_.ActiveTimeMax_Cnt_u32 "" VALUE 0x800485C __ULONG_S 0 Metrics_TaskTimes_Str._29_.ActiveTimeMax_Cnt_u32.CONVERSION 0 4294967295 FORMAT "%.2" /end CHARACTERISTIC
/begin CHARACTERISTIC Metrics_TaskTimes_Str._29_.CpuUse_Pct_f32 "" VALUE 0x8004874 __FLOAT32_IEEE_S 0 NO_COMPU_METHOD -3.4e+038 3.4e+038 FORMAT "%.15" PHYS_UNIT "%" /end CHARACTERISTIC
/begin CHARACTERISTIC Metrics_TaskTimes_Str._29_.RunTimeMax_Cnt_u32 "" VALUE 0x8004860 __ULONG_S 0 Metrics_TaskTimes_Str._29_.RunTimeMax_Cnt_u32.CONVERSION 0 4294967295 FORMAT "%.2" /end CHARACTERISTIC
/begin CHARACTERISTIC Metrics_TaskTimes_Str._29_.StackSize_Byte_u16 "" VALUE 0x800487A __UWORD_S 0 NO_COMPU_METHOD 0 65535 FORMAT "%.15" /end CHARACTERISTIC
/begin CHARACTERISTIC Metrics_TaskTimes_Str._29_.StackUse_Byte_u16 "" VALUE 0x8004878 __UWORD_S 0 NO_COMPU_METHOD 0 65535 FORMAT "%.15" /end CHARACTERISTIC
/begin CHARACTERISTIC Metrics_TaskTimes_Str._2_.ActiveTimeMax_Cnt_u32 "" VALUE 0x80044FC __ULONG_S 0 Metrics_TaskTimes_Str._2_.ActiveTimeMax_Cnt_u32.CONVERSION 0 4294967295 FORMAT "%.2" /end CHARACTERISTIC
/begin CHARACTERISTIC Metrics_TaskTimes_Str._2_.CpuUse_Pct_f32 "" VALUE 0x8004514 __FLOAT32_IEEE_S 0 NO_COMPU_METHOD -3.4e+038 3.4e+038 FORMAT "%.15" PHYS_UNIT "%" /end CHARACTERISTIC
/begin CHARACTERISTIC Metrics_TaskTimes_Str._2_.RunTimeMax_Cnt_u32 "" VALUE 0x8004500 __ULONG_S 0 Metrics_TaskTimes_Str._2_.RunTimeMax_Cnt_u32.CONVERSION 0 4294967295 FORMAT "%.2" /end CHARACTERISTIC
/begin CHARACTERISTIC Metrics_TaskTimes_Str._2_.StackSize_Byte_u16 "" VALUE 0x800451A __UWORD_S 0 NO_COMPU_METHOD 0 65535 FORMAT "%.15" /end CHARACTERISTIC
/begin CHARACTERISTIC Metrics_TaskTimes_Str._2_.StackUse_Byte_u16 "" VALUE 0x8004518 __UWORD_S 0 NO_COMPU_METHOD 0 65535 FORMAT "%.15" /end CHARACTERISTIC
/begin CHARACTERISTIC Metrics_TaskTimes_Str._30_.ActiveTimeMax_Cnt_u32 "" VALUE 0x800487C __ULONG_S 0 Metrics_TaskTimes_Str._30_.ActiveTimeMax_Cnt_u32.CONVERSION 0 4294967295 FORMAT "%.2" /end CHARACTERISTIC
/begin CHARACTERISTIC Metrics_TaskTimes_Str._30_.CpuUse_Pct_f32 "" VALUE 0x8004894 __FLOAT32_IEEE_S 0 NO_COMPU_METHOD -3.4e+038 3.4e+038 FORMAT "%.15" PHYS_UNIT "%" /end CHARACTERISTIC
/begin CHARACTERISTIC Metrics_TaskTimes_Str._30_.RunTimeMax_Cnt_u32 "" VALUE 0x8004880 __ULONG_S 0 Metrics_TaskTimes_Str._30_.RunTimeMax_Cnt_u32.CONVERSION 0 4294967295 FORMAT "%.2" /end CHARACTERISTIC
/begin CHARACTERISTIC Metrics_TaskTimes_Str._30_.StackSize_Byte_u16 "" VALUE 0x800489A __UWORD_S 0 NO_COMPU_METHOD 0 65535 FORMAT "%.15" /end CHARACTERISTIC
/begin CHARACTERISTIC Metrics_TaskTimes_Str._30_.StackUse_Byte_u16 "" VALUE 0x8004898 __UWORD_S 0 NO_COMPU_METHOD 0 65535 FORMAT "%.15" /end CHARACTERISTIC
/begin CHARACTERISTIC Metrics_TaskTimes_Str._31_.ActiveTimeMax_Cnt_u32 "" VALUE 0x800489C __ULONG_S 0 Metrics_TaskTimes_Str._31_.ActiveTimeMax_Cnt_u32.CONVERSION 0 4294967295 FORMAT "%.2" /end CHARACTERISTIC
/begin CHARACTERISTIC Metrics_TaskTimes_Str._31_.CpuUse_Pct_f32 "" VALUE 0x80048B4 __FLOAT32_IEEE_S 0 NO_COMPU_METHOD -3.4e+038 3.4e+038 FORMAT "%.15" PHYS_UNIT "%" /end CHARACTERISTIC
/begin CHARACTERISTIC Metrics_TaskTimes_Str._31_.RunTimeMax_Cnt_u32 "" VALUE 0x80048A0 __ULONG_S 0 Metrics_TaskTimes_Str._31_.RunTimeMax_Cnt_u32.CONVERSION 0 4294967295 FORMAT "%.2" /end CHARACTERISTIC
/begin CHARACTERISTIC Metrics_TaskTimes_Str._31_.StackSize_Byte_u16 "" VALUE 0x80048BA __UWORD_S 0 NO_COMPU_METHOD 0 65535 FORMAT "%.15" /end CHARACTERISTIC
/begin CHARACTERISTIC Metrics_TaskTimes_Str._31_.StackUse_Byte_u16 "" VALUE 0x80048B8 __UWORD_S 0 NO_COMPU_METHOD 0 65535 FORMAT "%.15" /end CHARACTERISTIC
/begin CHARACTERISTIC Metrics_TaskTimes_Str._32_.ActiveTimeMax_Cnt_u32 "" VALUE 0x80048BC __ULONG_S 0 Metrics_TaskTimes_Str._32_.ActiveTimeMax_Cnt_u32.CONVERSION 0 4294967295 FORMAT "%.2" /end CHARACTERISTIC
/begin CHARACTERISTIC Metrics_TaskTimes_Str._32_.CpuUse_Pct_f32 "" VALUE 0x80048D4 __FLOAT32_IEEE_S 0 NO_COMPU_METHOD -3.4e+038 3.4e+038 FORMAT "%.15" PHYS_UNIT "%" /end CHARACTERISTIC
/begin CHARACTERISTIC Metrics_TaskTimes_Str._32_.RunTimeMax_Cnt_u32 "" VALUE 0x80048C0 __ULONG_S 0 Metrics_TaskTimes_Str._32_.RunTimeMax_Cnt_u32.CONVERSION 0 4294967295 FORMAT "%.2" /end CHARACTERISTIC
/begin CHARACTERISTIC Metrics_TaskTimes_Str._32_.StackSize_Byte_u16 "" VALUE 0x80048DA __UWORD_S 0 NO_COMPU_METHOD 0 65535 FORMAT "%.15" /end CHARACTERISTIC
/begin CHARACTERISTIC Metrics_TaskTimes_Str._32_.StackUse_Byte_u16 "" VALUE 0x80048D8 __UWORD_S 0 NO_COMPU_METHOD 0 65535 FORMAT "%.15" /end CHARACTERISTIC
/begin CHARACTERISTIC Metrics_TaskTimes_Str._3_.ActiveTimeMax_Cnt_u32 "" VALUE 0x800451C __ULONG_S 0 Metrics_TaskTimes_Str._3_.ActiveTimeMax_Cnt_u32.CONVERSION 0 4294967295 FORMAT "%.2" /end CHARACTERISTIC
/begin CHARACTERISTIC Metrics_TaskTimes_Str._3_.CpuUse_Pct_f32 "" VALUE 0x8004534 __FLOAT32_IEEE_S 0 NO_COMPU_METHOD -3.4e+038 3.4e+038 FORMAT "%.15" PHYS_UNIT "%" /end CHARACTERISTIC
/begin CHARACTERISTIC Metrics_TaskTimes_Str._3_.RunTimeMax_Cnt_u32 "" VALUE 0x8004520 __ULONG_S 0 Metrics_TaskTimes_Str._3_.RunTimeMax_Cnt_u32.CONVERSION 0 4294967295 FORMAT "%.2" /end CHARACTERISTIC
/begin CHARACTERISTIC Metrics_TaskTimes_Str._3_.StackSize_Byte_u16 "" VALUE 0x800453A __UWORD_S 0 NO_COMPU_METHOD 0 65535 FORMAT "%.15" /end CHARACTERISTIC
/begin CHARACTERISTIC Metrics_TaskTimes_Str._3_.StackUse_Byte_u16 "" VALUE 0x8004538 __UWORD_S 0 NO_COMPU_METHOD 0 65535 FORMAT "%.15" /end CHARACTERISTIC
/begin CHARACTERISTIC Metrics_TaskTimes_Str._4_.ActiveTimeMax_Cnt_u32 "" VALUE 0x800453C __ULONG_S 0 Metrics_TaskTimes_Str._4_.ActiveTimeMax_Cnt_u32.CONVERSION 0 4294967295 FORMAT "%.2" /end CHARACTERISTIC
/begin CHARACTERISTIC Metrics_TaskTimes_Str._4_.CpuUse_Pct_f32 "" VALUE 0x8004554 __FLOAT32_IEEE_S 0 NO_COMPU_METHOD -3.4e+038 3.4e+038 FORMAT "%.15" PHYS_UNIT "%" /end CHARACTERISTIC
/begin CHARACTERISTIC Metrics_TaskTimes_Str._4_.RunTimeMax_Cnt_u32 "" VALUE 0x8004540 __ULONG_S 0 Metrics_TaskTimes_Str._4_.RunTimeMax_Cnt_u32.CONVERSION 0 4294967295 FORMAT "%.2" /end CHARACTERISTIC
/begin CHARACTERISTIC Metrics_TaskTimes_Str._4_.StackSize_Byte_u16 "" VALUE 0x800455A __UWORD_S 0 NO_COMPU_METHOD 0 65535 FORMAT "%.15" /end CHARACTERISTIC
/begin CHARACTERISTIC Metrics_TaskTimes_Str._4_.StackUse_Byte_u16 "" VALUE 0x8004558 __UWORD_S 0 NO_COMPU_METHOD 0 65535 FORMAT "%.15" /end CHARACTERISTIC
/begin CHARACTERISTIC Metrics_TaskTimes_Str._5_.ActiveTimeMax_Cnt_u32 "" VALUE 0x800455C __ULONG_S 0 Metrics_TaskTimes_Str._5_.ActiveTimeMax_Cnt_u32.CONVERSION 0 4294967295 FORMAT "%.2" /end CHARACTERISTIC
/begin CHARACTERISTIC Metrics_TaskTimes_Str._5_.CpuUse_Pct_f32 "" VALUE 0x8004574 __FLOAT32_IEEE_S 0 NO_COMPU_METHOD -3.4e+038 3.4e+038 FORMAT "%.15" PHYS_UNIT "%" /end CHARACTERISTIC
/begin CHARACTERISTIC Metrics_TaskTimes_Str._5_.RunTimeMax_Cnt_u32 "" VALUE 0x8004560 __ULONG_S 0 Metrics_TaskTimes_Str._5_.RunTimeMax_Cnt_u32.CONVERSION 0 4294967295 FORMAT "%.2" /end CHARACTERISTIC
/begin CHARACTERISTIC Metrics_TaskTimes_Str._5_.StackSize_Byte_u16 "" VALUE 0x800457A __UWORD_S 0 NO_COMPU_METHOD 0 65535 FORMAT "%.15" /end CHARACTERISTIC
/begin CHARACTERISTIC Metrics_TaskTimes_Str._5_.StackUse_Byte_u16 "" VALUE 0x8004578 __UWORD_S 0 NO_COMPU_METHOD 0 65535 FORMAT "%.15" /end CHARACTERISTIC
/begin CHARACTERISTIC Metrics_TaskTimes_Str._6_.ActiveTimeMax_Cnt_u32 "" VALUE 0x800457C __ULONG_S 0 Metrics_TaskTimes_Str._6_.ActiveTimeMax_Cnt_u32.CONVERSION 0 4294967295 FORMAT "%.2" /end CHARACTERISTIC
/begin CHARACTERISTIC Metrics_TaskTimes_Str._6_.CpuUse_Pct_f32 "" VALUE 0x8004594 __FLOAT32_IEEE_S 0 NO_COMPU_METHOD -3.4e+038 3.4e+038 FORMAT "%.15" PHYS_UNIT "%" /end CHARACTERISTIC
/begin CHARACTERISTIC Metrics_TaskTimes_Str._6_.RunTimeMax_Cnt_u32 "" VALUE 0x8004580 __ULONG_S 0 Metrics_TaskTimes_Str._6_.RunTimeMax_Cnt_u32.CONVERSION 0 4294967295 FORMAT "%.2" /end CHARACTERISTIC
/begin CHARACTERISTIC Metrics_TaskTimes_Str._6_.StackSize_Byte_u16 "" VALUE 0x800459A __UWORD_S 0 NO_COMPU_METHOD 0 65535 FORMAT "%.15" /end CHARACTERISTIC
/begin CHARACTERISTIC Metrics_TaskTimes_Str._6_.StackUse_Byte_u16 "" VALUE 0x8004598 __UWORD_S 0 NO_COMPU_METHOD 0 65535 FORMAT "%.15" /end CHARACTERISTIC
/begin CHARACTERISTIC Metrics_TaskTimes_Str._7_.ActiveTimeMax_Cnt_u32 "" VALUE 0x800459C __ULONG_S 0 Metrics_TaskTimes_Str._7_.ActiveTimeMax_Cnt_u32.CONVERSION 0 4294967295 FORMAT "%.2" /end CHARACTERISTIC
/begin CHARACTERISTIC Metrics_TaskTimes_Str._7_.CpuUse_Pct_f32 "" VALUE 0x80045B4 __FLOAT32_IEEE_S 0 NO_COMPU_METHOD -3.4e+038 3.4e+038 FORMAT "%.15" PHYS_UNIT "%" /end CHARACTERISTIC
/begin CHARACTERISTIC Metrics_TaskTimes_Str._7_.RunTimeMax_Cnt_u32 "" VALUE 0x80045A0 __ULONG_S 0 Metrics_TaskTimes_Str._7_.RunTimeMax_Cnt_u32.CONVERSION 0 4294967295 FORMAT "%.2" /end CHARACTERISTIC
/begin CHARACTERISTIC Metrics_TaskTimes_Str._7_.StackSize_Byte_u16 "" VALUE 0x80045BA __UWORD_S 0 NO_COMPU_METHOD 0 65535 FORMAT "%.15" /end CHARACTERISTIC
/begin CHARACTERISTIC Metrics_TaskTimes_Str._7_.StackUse_Byte_u16 "" VALUE 0x80045B8 __UWORD_S 0 NO_COMPU_METHOD 0 65535 FORMAT "%.15" /end CHARACTERISTIC
/begin CHARACTERISTIC Metrics_TaskTimes_Str._8_.ActiveTimeMax_Cnt_u32 "" VALUE 0x80045BC __ULONG_S 0 Metrics_TaskTimes_Str._8_.ActiveTimeMax_Cnt_u32.CONVERSION 0 4294967295 FORMAT "%.2" /end CHARACTERISTIC
/begin CHARACTERISTIC Metrics_TaskTimes_Str._8_.CpuUse_Pct_f32 "" VALUE 0x80045D4 __FLOAT32_IEEE_S 0 NO_COMPU_METHOD -3.4e+038 3.4e+038 FORMAT "%.15" PHYS_UNIT "%" /end CHARACTERISTIC
/begin CHARACTERISTIC Metrics_TaskTimes_Str._8_.RunTimeMax_Cnt_u32 "" VALUE 0x80045C0 __ULONG_S 0 Metrics_TaskTimes_Str._8_.RunTimeMax_Cnt_u32.CONVERSION 0 4294967295 FORMAT "%.2" /end CHARACTERISTIC
/begin CHARACTERISTIC Metrics_TaskTimes_Str._8_.StackSize_Byte_u16 "" VALUE 0x80045DA __UWORD_S 0 NO_COMPU_METHOD 0 65535 FORMAT "%.15" /end CHARACTERISTIC
/begin CHARACTERISTIC Metrics_TaskTimes_Str._8_.StackUse_Byte_u16 "" VALUE 0x80045D8 __UWORD_S 0 NO_COMPU_METHOD 0 65535 FORMAT "%.15" /end CHARACTERISTIC
/begin CHARACTERISTIC Metrics_TaskTimes_Str._9_.ActiveTimeMax_Cnt_u32 "" VALUE 0x80045DC __ULONG_S 0 Metrics_TaskTimes_Str._9_.ActiveTimeMax_Cnt_u32.CONVERSION 0 4294967295 FORMAT "%.2" /end CHARACTERISTIC
/begin CHARACTERISTIC Metrics_TaskTimes_Str._9_.CpuUse_Pct_f32 "" VALUE 0x80045F4 __FLOAT32_IEEE_S 0 NO_COMPU_METHOD -3.4e+038 3.4e+038 FORMAT "%.15" PHYS_UNIT "%" /end CHARACTERISTIC
/begin CHARACTERISTIC Metrics_TaskTimes_Str._9_.RunTimeMax_Cnt_u32 "" VALUE 0x80045E0 __ULONG_S 0 Metrics_TaskTimes_Str._9_.RunTimeMax_Cnt_u32.CONVERSION 0 4294967295 FORMAT "%.2" /end CHARACTERISTIC
/begin CHARACTERISTIC Metrics_TaskTimes_Str._9_.StackSize_Byte_u16 "" VALUE 0x80045FA __UWORD_S 0 NO_COMPU_METHOD 0 65535 FORMAT "%.15" /end CHARACTERISTIC
/begin CHARACTERISTIC Metrics_TaskTimes_Str._9_.StackUse_Byte_u16 "" VALUE 0x80045F8 __UWORD_S 0 NO_COMPU_METHOD 0 65535 FORMAT "%.15" /end CHARACTERISTIC
/begin CHARACTERISTIC PreemptionBlocks "" VAL_BLK 0x8004A35 __UBYTE_Z 0 NO_COMPU_METHOD 0 255 READ_ONLY MATRIX_DIM 33 33 1 SYMBOL_LINK "Metrics_MaxPreemption_Cnt_M_u08" 0 FORMAT "%.15" /end CHARACTERISTIC
/begin GROUP ActiveTime "Comment"
 /begin REF_CHARACTERISTIC Metrics_TaskTimes_Str._0_.ActiveTimeMax_Cnt_u32 Metrics_TaskTimes_Str._10_.ActiveTimeMax_Cnt_u32 Metrics_TaskTimes_Str._11_.ActiveTimeMax_Cnt_u32 Metrics_TaskTimes_Str._12_.ActiveTimeMax_Cnt_u32 Metrics_TaskTimes_Str._13_.ActiveTimeMax_Cnt_u32 Metrics_TaskTimes_Str._14_.ActiveTimeMax_Cnt_u32 Metrics_TaskTimes_Str._15_.ActiveTimeMax_Cnt_u32 Metrics_TaskTimes_Str._16_.ActiveTimeMax_Cnt_u32 Metrics_TaskTimes_Str._17_.ActiveTimeMax_Cnt_u32 Metrics_TaskTimes_Str._18_.ActiveTimeMax_Cnt_u32 Metrics_TaskTimes_Str._19_.ActiveTimeMax_Cnt_u32 Metrics_TaskTimes_Str._1_.ActiveTimeMax_Cnt_u32 Metrics_TaskTimes_Str._20_.ActiveTimeMax_Cnt_u32 Metrics_TaskTimes_Str._21_.ActiveTimeMax_Cnt_u32 Metrics_TaskTimes_Str._22_.ActiveTimeMax_Cnt_u32 Metrics_TaskTimes_Str._23_.ActiveTimeMax_Cnt_u32 Metrics_TaskTimes_Str._24_.ActiveTimeMax_Cnt_u32 Metrics_TaskTimes_Str._25_.ActiveTimeMax_Cnt_u32 Metrics_TaskTimes_Str._26_.ActiveTimeMax_Cnt_u32 Metrics_TaskTimes_Str._27_.ActiveTimeMax_Cnt_u32 Metrics_TaskTimes_Str._28_.ActiveTimeMax_Cnt_u32 Metrics_TaskTimes_Str._29_.ActiveTimeMax_Cnt_u32 Metrics_TaskTimes_Str._2_.ActiveTimeMax_Cnt_u32 Metrics_TaskTimes_Str._30_.ActiveTimeMax_Cnt_u32 Metrics_TaskTimes_Str._31_.ActiveTimeMax_Cnt_u32 Metrics_TaskTimes_Str._32_.ActiveTimeMax_Cnt_u32 Metrics_TaskTimes_Str._3_.ActiveTimeMax_Cnt_u32 Metrics_TaskTimes_Str._4_.ActiveTimeMax_Cnt_u32 Metrics_TaskTimes_Str._5_.ActiveTimeMax_Cnt_u32 Metrics_TaskTimes_Str._6_.ActiveTimeMax_Cnt_u32 Metrics_TaskTimes_Str._7_.ActiveTimeMax_Cnt_u32 Metrics_TaskTimes_Str._8_.ActiveTimeMax_Cnt_u32 Metrics_TaskTimes_Str._9_.ActiveTimeMax_Cnt_u32 /end REF_CHARACTERISTIC
/end GROUP
/begin GROUP Metrics "Comment" ROOT /begin SUB_GROUP ActiveTime RunTime StackSize StackUse Utilization /end SUB_GROUP /begin REF_CHARACTERISTIC PreemptionBlocks /end REF_CHARACTERISTIC /end GROUP
/begin GROUP RunTime "Comment"
 /begin REF_CHARACTERISTIC Metrics_TaskTimes_Str._0_.RunTimeMax_Cnt_u32 Metrics_TaskTimes_Str._10_.RunTimeMax_Cnt_u32 Metrics_TaskTimes_Str._11_.RunTimeMax_Cnt_u32 Metrics_TaskTimes_Str._12_.RunTimeMax_Cnt_u32 Metrics_TaskTimes_Str._13_.RunTimeMax_Cnt_u32 Metrics_TaskTimes_Str._14_.RunTimeMax_Cnt_u32 Metrics_TaskTimes_Str._15_.RunTimeMax_Cnt_u32 Metrics_TaskTimes_Str._16_.RunTimeMax_Cnt_u32 Metrics_TaskTimes_Str._17_.RunTimeMax_Cnt_u32 Metrics_TaskTimes_Str._18_.RunTimeMax_Cnt_u32 Metrics_TaskTimes_Str._19_.RunTimeMax_Cnt_u32 Metrics_TaskTimes_Str._1_.RunTimeMax_Cnt_u32 Metrics_TaskTimes_Str._20_.RunTimeMax_Cnt_u32 Metrics_TaskTimes_Str._21_.RunTimeMax_Cnt_u32 Metrics_TaskTimes_Str._22_.RunTimeMax_Cnt_u32 Metrics_TaskTimes_Str._23_.RunTimeMax_Cnt_u32 Metrics_TaskTimes_Str._24_.RunTimeMax_Cnt_u32 Metrics_TaskTimes_Str._25_.RunTimeMax_Cnt_u32 Metrics_TaskTimes_Str._26_.RunTimeMax_Cnt_u32 Metrics_TaskTimes_Str._27_.RunTimeMax_Cnt_u32 Metrics_TaskTimes_Str._28_.RunTimeMax_Cnt_u32 Metrics_TaskTimes_Str._29_.RunTimeMax_Cnt_u32 Metrics_TaskTimes_Str._2_.RunTimeMax_Cnt_u32 Metrics_TaskTimes_Str._30_.RunTimeMax_Cnt_u32 Metrics_TaskTimes_Str._31_.RunTimeMax_Cnt_u32 Metrics_TaskTimes_Str._32_.RunTimeMax_Cnt_u32 Metrics_TaskTimes_Str._3_.RunTimeMax_Cnt_u32 Metrics_TaskTimes_Str._4_.RunTimeMax_Cnt_u32 Metrics_TaskTimes_Str._5_.RunTimeMax_Cnt_u32 Metrics_TaskTimes_Str._6_.RunTimeMax_Cnt_u32 Metrics_TaskTimes_Str._7_.RunTimeMax_Cnt_u32 Metrics_TaskTimes_Str._8_.RunTimeMax_Cnt_u32 Metrics_TaskTimes_Str._9_.RunTimeMax_Cnt_u32 /end REF_CHARACTERISTIC
/end GROUP
/begin GROUP StackSize "Comment"
 /begin REF_CHARACTERISTIC Metrics_TaskTimes_Str._0_.StackSize_Byte_u16 Metrics_TaskTimes_Str._10_.StackSize_Byte_u16 Metrics_TaskTimes_Str._11_.StackSize_Byte_u16 Metrics_TaskTimes_Str._12_.StackSize_Byte_u16 Metrics_TaskTimes_Str._13_.StackSize_Byte_u16 Metrics_TaskTimes_Str._14_.StackSize_Byte_u16 Metrics_TaskTimes_Str._15_.StackSize_Byte_u16 Metrics_TaskTimes_Str._16_.StackSize_Byte_u16 Metrics_TaskTimes_Str._17_.StackSize_Byte_u16 Metrics_TaskTimes_Str._18_.StackSize_Byte_u16 Metrics_TaskTimes_Str._19_.StackSize_Byte_u16 Metrics_TaskTimes_Str._1_.StackSize_Byte_u16 Metrics_TaskTimes_Str._20_.StackSize_Byte_u16 Metrics_TaskTimes_Str._21_.StackSize_Byte_u16 Metrics_TaskTimes_Str._22_.StackSize_Byte_u16 Metrics_TaskTimes_Str._23_.StackSize_Byte_u16 Metrics_TaskTimes_Str._24_.StackSize_Byte_u16 Metrics_TaskTimes_Str._25_.StackSize_Byte_u16 Metrics_TaskTimes_Str._26_.StackSize_Byte_u16 Metrics_TaskTimes_Str._27_.StackSize_Byte_u16 Metrics_TaskTimes_Str._28_.StackSize_Byte_u16 Metrics_TaskTimes_Str._29_.StackSize_Byte_u16 Metrics_TaskTimes_Str._2_.StackSize_Byte_u16 Metrics_TaskTimes_Str._30_.StackSize_Byte_u16 Metrics_TaskTimes_Str._31_.StackSize_Byte_u16 Metrics_TaskTimes_Str._32_.StackSize_Byte_u16 Metrics_TaskTimes_Str._3_.StackSize_Byte_u16 Metrics_TaskTimes_Str._4_.StackSize_Byte_u16 Metrics_TaskTimes_Str._5_.StackSize_Byte_u16 Metrics_TaskTimes_Str._6_.StackSize_Byte_u16 Metrics_TaskTimes_Str._7_.StackSize_Byte_u16 Metrics_TaskTimes_Str._8_.StackSize_Byte_u16 Metrics_TaskTimes_Str._9_.StackSize_Byte_u16 /end REF_CHARACTERISTIC
/end GROUP
/begin GROUP StackUse "Comment"
 /begin REF_CHARACTERISTIC Metrics_TaskTimes_Str._0_.StackUse_Byte_u16 Metrics_TaskTimes_Str._10_.StackUse_Byte_u16 Metrics_TaskTimes_Str._11_.StackUse_Byte_u16 Metrics_TaskTimes_Str._12_.StackUse_Byte_u16 Metrics_TaskTimes_Str._13_.StackUse_Byte_u16 Metrics_TaskTimes_Str._14_.StackUse_Byte_u16 Metrics_TaskTimes_Str._15_.StackUse_Byte_u16 Metrics_TaskTimes_Str._16_.StackUse_Byte_u16 Metrics_TaskTimes_Str._17_.StackUse_Byte_u16 Metrics_TaskTimes_Str._18_.StackUse_Byte_u16 Metrics_TaskTimes_Str._19_.StackUse_Byte_u16 Metrics_TaskTimes_Str._1_.StackUse_Byte_u16 Metrics_TaskTimes_Str._20_.StackUse_Byte_u16 Metrics_TaskTimes_Str._21_.StackUse_Byte_u16 Metrics_TaskTimes_Str._22_.StackUse_Byte_u16 Metrics_TaskTimes_Str._23_.StackUse_Byte_u16 Metrics_TaskTimes_Str._24_.StackUse_Byte_u16 Metrics_TaskTimes_Str._25_.StackUse_Byte_u16 Metrics_TaskTimes_Str._26_.StackUse_Byte_u16 Metrics_TaskTimes_Str._27_.StackUse_Byte_u16 Metrics_TaskTimes_Str._28_.StackUse_Byte_u16 Metrics_TaskTimes_Str._29_.StackUse_Byte_u16 Metrics_TaskTimes_Str._2_.StackUse_Byte_u16 Metrics_TaskTimes_Str._30_.StackUse_Byte_u16 Metrics_TaskTimes_Str._31_.StackUse_Byte_u16 Metrics_TaskTimes_Str._32_.StackUse_Byte_u16 Metrics_TaskTimes_Str._3_.StackUse_Byte_u16 Metrics_TaskTimes_Str._4_.StackUse_Byte_u16 Metrics_TaskTimes_Str._5_.StackUse_Byte_u16 Metrics_TaskTimes_Str._6_.StackUse_Byte_u16 Metrics_TaskTimes_Str._7_.StackUse_Byte_u16 Metrics_TaskTimes_Str._8_.StackUse_Byte_u16 Metrics_TaskTimes_Str._9_.StackUse_Byte_u16 /end REF_CHARACTERISTIC
/end GROUP
/begin GROUP Utilization "Comment"
 /begin REF_CHARACTERISTIC Metrics_TaskTimes_Str._0_.CpuUse_Pct_f32 Metrics_TaskTimes_Str._10_.CpuUse_Pct_f32 Metrics_TaskTimes_Str._11_.CpuUse_Pct_f32 Metrics_TaskTimes_Str._12_.CpuUse_Pct_f32 Metrics_TaskTimes_Str._13_.CpuUse_Pct_f32 Metrics_TaskTimes_Str._14_.CpuUse_Pct_f32 Metrics_TaskTimes_Str._15_.CpuUse_Pct_f32 Metrics_TaskTimes_Str._16_.CpuUse_Pct_f32 Metrics_TaskTimes_Str._17_.CpuUse_Pct_f32 Metrics_TaskTimes_Str._18_.CpuUse_Pct_f32 Metrics_TaskTimes_Str._19_.CpuUse_Pct_f32 Metrics_TaskTimes_Str._1_.CpuUse_Pct_f32 Metrics_TaskTimes_Str._20_.CpuUse_Pct_f32 Metrics_TaskTimes_Str._21_.CpuUse_Pct_f32 Metrics_TaskTimes_Str._22_.CpuUse_Pct_f32 Metrics_TaskTimes_Str._23_.CpuUse_Pct_f32 Metrics_TaskTimes_Str._24_.CpuUse_Pct_f32 Metrics_TaskTimes_Str._25_.CpuUse_Pct_f32 Metrics_TaskTimes_Str._26_.CpuUse_Pct_f32 Metrics_TaskTimes_Str._27_.CpuUse_Pct_f32 Metrics_TaskTimes_Str._28_.CpuUse_Pct_f32 Metrics_TaskTimes_Str._29_.CpuUse_Pct_f32 Metrics_TaskTimes_Str._2_.CpuUse_Pct_f32 Metrics_TaskTimes_Str._30_.CpuUse_Pct_f32 Metrics_TaskTimes_Str._31_.CpuUse_Pct_f32 Metrics_TaskTimes_Str._32_.CpuUse_Pct_f32 Metrics_TaskTimes_Str._3_.CpuUse_Pct_f32 Metrics_TaskTimes_Str._4_.CpuUse_Pct_f32 Metrics_TaskTimes_Str._5_.CpuUse_Pct_f32 Metrics_TaskTimes_Str._6_.CpuUse_Pct_f32 Metrics_TaskTimes_Str._7_.CpuUse_Pct_f32 Metrics_TaskTimes_Str._8_.CpuUse_Pct_f32 Metrics_TaskTimes_Str._9_.CpuUse_Pct_f32 /end REF_CHARACTERISTIC
/end GROUP
/begin RECORD_LAYOUT RTE_RL_BOOLEAN FNC_VALUES 1 UBYTE ROW_DIR DIRECT /end RECORD_LAYOUT
/begin RECORD_LAYOUT RTE_RL_FLOAT32_IEEE FNC_VALUES 1 FLOAT32_IEEE ROW_DIR DIRECT /end RECORD_LAYOUT
/begin RECORD_LAYOUT RTE_RL_FLOAT64_IEEE FNC_VALUES 1 FLOAT64_IEEE ROW_DIR DIRECT /end RECORD_LAYOUT
/begin RECORD_LAYOUT RTE_RL_SBYTE FNC_VALUES 1 SBYTE ROW_DIR DIRECT /end RECORD_LAYOUT
/begin RECORD_LAYOUT RTE_RL_SLONG FNC_VALUES 1 SLONG ROW_DIR DIRECT /end RECORD_LAYOUT
/begin RECORD_LAYOUT RTE_RL_SWORD FNC_VALUES 1 SWORD ROW_DIR DIRECT /end RECORD_LAYOUT
/begin RECORD_LAYOUT RTE_RL_UBYTE FNC_VALUES 1 UBYTE ROW_DIR DIRECT /end RECORD_LAYOUT
/begin RECORD_LAYOUT RTE_RL_ULONG FNC_VALUES 1 ULONG ROW_DIR DIRECT /end RECORD_LAYOUT
/begin RECORD_LAYOUT RTE_RL_UWORD FNC_VALUES 1 UWORD ROW_DIR DIRECT /end RECORD_LAYOUT
/begin RECORD_LAYOUT __UBYTE_Z FNC_VALUES 1 UBYTE ROW_DIR DIRECT /end RECORD_LAYOUT
/begin RECORD_LAYOUT __UWORD_Z FNC_VALUES 1 UWORD ROW_DIR DIRECT /end RECORD_LAYOUT
/begin RECORD_LAYOUT __ULONG_Z FNC_VALUES 1 ULONG ROW_DIR DIRECT /end RECORD_LAYOUT
/begin RECORD_LAYOUT __SBYTE_Z FNC_VALUES 1 SBYTE ROW_DIR DIRECT /end RECORD_LAYOUT
/begin RECORD_LAYOUT __SWORD_Z FNC_VALUES 1 SWORD ROW_DIR DIRECT /end RECORD_LAYOUT
/begin RECORD_LAYOUT __SLONG_Z FNC_VALUES 1 SLONG ROW_DIR DIRECT /end RECORD_LAYOUT
/begin RECORD_LAYOUT __FLOAT32_IEEE_Z FNC_VALUES 1 FLOAT32_IEEE ROW_DIR DIRECT /end RECORD_LAYOUT
/begin RECORD_LAYOUT __FLOAT64_IEEE_Z FNC_VALUES 1 FLOAT64_IEEE ROW_DIR DIRECT /end RECORD_LAYOUT
/begin RECORD_LAYOUT __UBYTE_S FNC_VALUES 1 UBYTE COLUMN_DIR DIRECT /end RECORD_LAYOUT
/begin RECORD_LAYOUT __UWORD_S FNC_VALUES 1 UWORD COLUMN_DIR DIRECT /end RECORD_LAYOUT
/begin RECORD_LAYOUT __ULONG_S FNC_VALUES 1 ULONG COLUMN_DIR DIRECT /end RECORD_LAYOUT
/begin RECORD_LAYOUT __SBYTE_S FNC_VALUES 1 SBYTE COLUMN_DIR DIRECT /end RECORD_LAYOUT
/begin RECORD_LAYOUT __SWORD_S FNC_VALUES 1 SWORD COLUMN_DIR DIRECT /end RECORD_LAYOUT
/begin RECORD_LAYOUT __SLONG_S FNC_VALUES 1 SLONG COLUMN_DIR DIRECT /end RECORD_LAYOUT
/begin RECORD_LAYOUT __FLOAT32_IEEE_S FNC_VALUES 1 FLOAT32_IEEE COLUMN_DIR DIRECT /end RECORD_LAYOUT
/begin RECORD_LAYOUT __FLOAT64_IEEE_S FNC_VALUES 1 FLOAT64_IEEE COLUMN_DIR DIRECT /end RECORD_LAYOUT
/begin RECORD_LAYOUT SSV__UBYTE_S AXIS_PTS_X 1 UBYTE INDEX_INCR DIRECT /end RECORD_LAYOUT
/begin RECORD_LAYOUT SSV__UWORD_S AXIS_PTS_X 1 UWORD INDEX_INCR DIRECT /end RECORD_LAYOUT
/begin RECORD_LAYOUT SSV__ULONG_S AXIS_PTS_X 1 ULONG INDEX_INCR DIRECT /end RECORD_LAYOUT
/begin RECORD_LAYOUT SSV__SBYTE_S AXIS_PTS_X 1 SBYTE INDEX_INCR DIRECT /end RECORD_LAYOUT
/begin RECORD_LAYOUT SSV__SWORD_S AXIS_PTS_X 1 SWORD INDEX_INCR DIRECT /end RECORD_LAYOUT
/begin RECORD_LAYOUT SSV__SLONG_S AXIS_PTS_X 1 SLONG INDEX_INCR DIRECT /end RECORD_LAYOUT
/begin RECORD_LAYOUT SSV__FLOAT32_IEEE_S AXIS_PTS_X 1 FLOAT32_IEEE INDEX_INCR DIRECT /end RECORD_LAYOUT
/begin RECORD_LAYOUT SSV__FLOAT64_IEEE_S AXIS_PTS_X 1 FLOAT64_IEEE INDEX_INCR DIRECT /end RECORD_LAYOUT
/begin RECORD_LAYOUT __A_UINT64_Z FNC_VALUES 1 A_UINT64 ROW_DIR DIRECT /end RECORD_LAYOUT
/begin RECORD_LAYOUT __A_INT64_Z FNC_VALUES 1 A_INT64 ROW_DIR DIRECT /end RECORD_LAYOUT
/begin RECORD_LAYOUT __A_UINT64_S FNC_VALUES 1 A_UINT64 COLUMN_DIR DIRECT /end RECORD_LAYOUT
/begin RECORD_LAYOUT __A_INT64_S FNC_VALUES 1 A_INT64 COLUMN_DIR DIRECT /end RECORD_LAYOUT
/begin RECORD_LAYOUT SSV__A_UINT64_S AXIS_PTS_X 1 A_UINT64 INDEX_INCR DIRECT /end RECORD_LAYOUT
/begin RECORD_LAYOUT SSV__A_INT64_S AXIS_PTS_X 1 A_INT64 INDEX_INCR DIRECT /end RECORD_LAYOUT
/end MODULE
/end PROJECT
