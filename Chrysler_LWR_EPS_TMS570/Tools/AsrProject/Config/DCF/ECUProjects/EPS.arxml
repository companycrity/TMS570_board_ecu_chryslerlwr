AUTOSAR XML (schema 314)
package /DaVinci
  ecu configuration EPS: ecu-extract=EPS, ecu-sw-composition=EcuSwComposition
package /DaVinci/PKG_ClusterEPSMod_GlobalA_CE
  can cluster EPSMod_GlobalA_CE: nm-node-detection-enabled=false, nm-node-id-enabled=false, nm-repeat-message-support=false, speed=0
    physical channel Channel
      frame PPEI_Steering_Wheel_Angle_CE: id 0x1E5, to EPS, frame-length=8, can-addressing-mode=STANDARD
        carries pdu PPEI_Steering_Wheel_Angle_CE: packing-byte-order=big-endian, start-position=7
        pdu PPEI_Steering_Wheel_Angle_CE: length=64
          signal Msg1E5_Sig_PPEI_Steering_Wheel_Angle_CE: start 7, 1 bit, big-endian, to EPS
package /DaVinci/PKG_ClusterEPSMod_GlobalA_HS
  can cluster EPSMod_GlobalA_HS: nm-node-detection-enabled=false, nm-node-id-enabled=false, nm-repeat-message-support=false, speed=0
    physical channel Channel
      frame Driving_Mode_Control_HS: id 0x232, to EPS, frame-length=7, can-addressing-mode=STANDARD
        carries pdu Driving_Mode_Control_HS: packing-byte-order=big-endian, start-position=7
        pdu Driving_Mode_Control_HS: length=56
          signal Msg232_Sig_Driving_Mode_Control_HS: start 7, 1 bit, big-endian, to EPS
      frame DTC_Triggered_778: id 0x778, from EPS, frame-length=7, can-addressing-mode=STANDARD
        carries pdu DTC_Triggered_778: packing-byte-order=big-endian, start-position=7
        pdu DTC_Triggered_778: length=56, cyclic-timing=repeating-time=0.1
          transmission-mode-conditions:
            signal-in-i-pdu=DTCI_CodeSupported_778_S
            signal-in-i-pdu=DTCI_CurrentStatus_778_S
            signal-in-i-pdu=DTCI_DTCFailType_778_S
            signal-in-i-pdu=DTCI_DTCFaultType_778_S
            signal-in-i-pdu=DTCI_DTCNumber_778_S
            signal-in-i-pdu=DTCI_DTCSource_778_S
            signal-in-i-pdu=DTCI_DTCTriggered_778_S
            signal-in-i-pdu=DTCI_HistStat_778_S
            signal-in-i-pdu=DTCI_TstFldCdClrdStat_778_S
            signal-in-i-pdu=DTCI_TstFldPwrUpSt_778_S
            signal-in-i-pdu=DTCI_TstNPsdCdClrdSt_778_S
            signal-in-i-pdu=DTCI_TstNPsdPwrUpSt_778_S
            signal-in-i-pdu=DTCI_WrnIndRqdSt_778_S
            signal-in-i-pdu=DTCIUnused{1..7}_778_S
          signal DTCI_CodeSupported_778_DTC_Triggered_778: start 40, 1 bit, big-endian
          signal DTCI_CurrentStatus_778_DTC_Triggered_778: start 41, 1 bit, big-endian
          signal DTCI_DTCFailType_778_DTC_Triggered_778: start 39, 8 bit, big-endian
          signal DTCI_DTCFaultType_778_DTC_Triggered_778: start 55, 8 bit, big-endian
          signal DTCI_DTCNumber_778_DTC_Triggered_778: start 23, 16 bit, big-endian
          signal DTCI_DTCSource_778_DTC_Triggered_778: start 15, 8 bit, big-endian
          signal DTCI_DTCTriggered_778_DTC_Triggered_778: start 0, 1 bit, big-endian
          signal DTCI_HistStat_778_DTC_Triggered_778: start 44, 1 bit, big-endian
          signal DTCI_TstFldCdClrdStat_778_DTC_Triggered_778: start 43, 1 bit, big-endian
          signal DTCI_TstFldPwrUpSt_778_DTC_Triggered_778: start 46, 1 bit, big-endian
          signal DTCI_TstNPsdCdClrdSt_778_DTC_Triggered_778: start 42, 1 bit, big-endian
          signal DTCI_TstNPsdPwrUpSt_778_DTC_Triggered_778: start 45, 1 bit, big-endian
          signal DTCI_WrnIndRqdSt_778_DTC_Triggered_778: start 47, 1 bit, big-endian
          signal DTCInfo_778_DTC_Triggered_778: system-signal=[DTCI_CodeSupported_778, DTCI_CurrentStatus_778, DTCI_DTCFailType_778, DTCI_DTCFaultType_778, DTCI_DTCNumber_778, DTCI_DTCSource_778, DTCI_DTCTriggered_778, DTCI_HistStat_778, DTCI_TstFldCdClrdStat_778, DTCI_TstFldPwrUpSt_778, DTCI_TstNPsdCdClrdSt_778, DTCI_TstNPsdPwrUpSt_778, DTCI_WrnIndRqdSt_778, DTCIUnused1_778, DTCIUnused2_778, DTCIUnused3_778, DTCIUnused4_778, DTCIUnused5_778, DTCIUnused6_778, DTCIUnused7_778], transfer-property=PENDING
          signal DTCIUnused1_778_DTC_Triggered_778: start 7, 1 bit, big-endian
          signal DTCIUnused2_778_DTC_Triggered_778: start 6, 1 bit, big-endian
          signal DTCIUnused3_778_DTC_Triggered_778: start 5, 1 bit, big-endian
          signal DTCIUnused4_778_DTC_Triggered_778: start 4, 1 bit, big-endian
          signal DTCIUnused5_778_DTC_Triggered_778: start 3, 1 bit, big-endian
          signal DTCIUnused6_778_DTC_Triggered_778: start 2, 1 bit, big-endian
          signal DTCIUnused7_778_DTC_Triggered_778: start 1, 1 bit, big-endian
      frame Power_Steering_Information_HS: id 0x148, from EPS, frame-length=1, can-addressing-mode=STANDARD
        carries pdu Power_Steering_Information_HS: packing-byte-order=big-endian, start-position=7
        pdu Power_Steering_Information_HS: length=8, cyclic-timing=repeating-time=0.1, transmission-mode-condition=signal-in-i-pdu=PwrStrIO_S
          signal PwrStrIO_Power_Steering_Information_HS: start 0, 1 bit, big-endian, transfer-property=PENDING
      frame PPEI_Engine_General_Status_1: id 0xC9, to EPS, frame-length=8, can-addressing-mode=STANDARD
        carries pdu PPEI_Engine_General_Status_1: packing-byte-order=big-endian, start-position=7
        pdu PPEI_Engine_General_Status_1: length=64
          signal MsgC9_Sig_PPEI_Engine_General_Status_1: start 39, 1 bit, big-endian, to EPS
      frame PPEI_NonDrivn_Whl_Rotationl_Stat: id 0xC5, to EPS, frame-length=8, can-addressing-mode=STANDARD
        carries pdu PPEI_NonDrivn_Whl_Rotationl_Stat: packing-byte-order=big-endian, start-position=7
        pdu PPEI_NonDrivn_Whl_Rotationl_Stat: length=64
          signal MsgC5_Sig_PPEI_NonDrivn_Whl_Rotationl_Stat: start 7, 1 bit, big-endian, to EPS
      frame PPEI_Platform_General_Status: id 0x1F1, to EPS, frame-length=8, can-addressing-mode=STANDARD
        carries pdu PPEI_Platform_General_Status: packing-byte-order=big-endian, start-position=7
        pdu PPEI_Platform_General_Status: length=64
          signal Msg1F1_Sig_PPEI_Platform_General_Status: start 7, 1 bit, big-endian, to EPS
      frame PPEI_Trans_General_Status_2: id 0x1F5, to EPS, frame-length=8, can-addressing-mode=STANDARD
        carries pdu PPEI_Trans_General_Status_2: packing-byte-order=big-endian, start-position=7
        pdu PPEI_Trans_General_Status_2: length=64
          signal Msg1F5_Sig_PPEI_Trans_General_Status_2: start 7, 1 bit, big-endian, to EPS
      frame PPEI_Vehicle_Speed_and_Distance: id 0x3E9, to EPS, frame-length=8, can-addressing-mode=STANDARD
        carries pdu PPEI_Vehicle_Speed_and_Distance: packing-byte-order=big-endian, start-position=7
        pdu PPEI_Vehicle_Speed_and_Distance: length=64
          signal Msg3E9_Sig_PPEI_Vehicle_Speed_and_Distance: start 7, 1 bit, big-endian, to EPS
      frame Wheel_Pulses_HS: id 0x500, to EPS, frame-length=4, can-addressing-mode=STANDARD
        carries pdu Wheel_Pulses_HS: packing-byte-order=big-endian, start-position=7
        pdu Wheel_Pulses_HS: length=32
          signal Msg500_Sig_Wheel_Pulses_HS: start 7, 1 bit, big-endian, to EPS
package /DaVinci/PKG_ECU
  ecu instance EPS: associated-i-pdu-group=[EPS_EPSMod_GlobalA_CE_Rx, EPS_EPSMod_GlobalA_CE_Tx, EPS_EPSMod_GlobalA_HS_Rx, EPS_EPSMod_GlobalA_HS_Tx], com-processing-period=0.005, diagnostic-address=0, sleep-mode-supported=false, wake-up-over-bus-supported=false
    can communication controller EPSMod_GlobalA_CE
    can communication controller EPSMod_GlobalA_HS
    communication connector EPSMod_GlobalA_CE_EPS: channel=EPSMod_GlobalA_CE/Channel, comm-controller=EPSMod_GlobalA_CE
    communication connector EPSMod_GlobalA_HS_EPS: channel=EPSMod_GlobalA_HS/Channel, comm-controller=EPSMod_GlobalA_HS
package /DaVinci/PKG_PDUGroup
  4 x i pdu group:
    EPS_EPSMod_GlobalA_CE_Rx: communication-direction=IN, i-pdu=PPEI_Steering_Wheel_Angle_CE
    EPS_EPSMod_GlobalA_CE_Tx: communication-direction=OUT
    EPS_EPSMod_GlobalA_HS_Rx: communication-direction=IN, i-pdu=[Driving_Mode_Control_HS, PPEI_Engine_General_Status_1, PPEI_NonDrivn_Whl_Rotationl_Stat, PPEI_Platform_General_Status, PPEI_Trans_General_Status_2, PPEI_Vehicle_Speed_and_Distance, Wheel_Pulses_HS]
    EPS_EPSMod_GlobalA_HS_Tx: communication-direction=OUT, i-pdu=[DTC_Triggered_778, Power_Steering_Information_HS]
package /ECUComposition
  ecu sw composition EcuSwComposition: ecu-extract=EPS
    7 x service component prototype:
      CDD: service-component=CDD
      Dem: service-component=Dem
      EcuM: service-component=EcuM
      NexteerLibs: service-component=NexteerLibs
      NvM: service-component=NvM
      NvMProxy: service-component=NvMProxy
      WdgM: service-component=WdgM
    service connector prototype NexteerLibs_SystemTime_Ap_AbsHwPosScom_SystemTime: application-port=ECU_Composition.Ap_AbsHwPosScom.SystemTime, service-port=NexteerLibs.SystemTime
    service connector prototype NexteerLibs_SystemTime_Ap_ActivePull_SystemTime: application-port=ECU_Composition.Ap_ActivePull.SystemTime, service-port=NexteerLibs.SystemTime
    service connector prototype WdgM_SE006_SE4ms_10_CP001_ArbLmt_Per1_CP1_Ap_ArbLmt_ArbLmt_Per1_CP1: application-port=ECU_Composition.Ap_ArbLmt.ArbLmt_Per1_CP1, service-port=WdgM.SE006_SE4ms_10_CP001_ArbLmt_Per1_CP1
    service connector prototype NvMProxy_PS_NvMP_NvmBlock_AstLmt_SteerAsstDefeat_Ap_AstLmt_SteeringAsstDefeat: application-port=ECU_Composition.Ap_AstLmt.SteeringAsstDefeat, service-port=NvMProxy.PS_NvMP_NvmBlock_AstLmt_SteerAsstDefeat
    service connector prototype NvM_PS_Rte_NvmBlock_Ap_AvgFricLrn_AvgFricLrnData_Ap_AvgFricLrn_AvgFricLrnData: application-port=ECU_Composition.Ap_AvgFricLrn.AvgFricLrnData, service-port=NvM.PS_Rte_NvmBlock_Ap_AvgFricLrn_AvgFricLrnData
    service connector prototype NexteerLibs_SystemTime_Ap_AvgFricLrn_SystemTime: application-port=ECU_Composition.Ap_AvgFricLrn.SystemTime, service-port=NexteerLibs.SystemTime
    service connector prototype WdgM_SE004_SE10ms_9_CP001_BVDiag_Per1_CP1_Ap_BVDiag_BVDiag_Per1_CP1: application-port=ECU_Composition.Ap_BVDiag.BVDiag_Per1_CP1, service-port=WdgM.SE004_SE10ms_9_CP001_BVDiag_Per1_CP1
    service connector prototype NexteerLibs_SystemTime_Ap_BVDiag_SystemTime: application-port=ECU_Composition.Ap_BVDiag.SystemTime, service-port=NexteerLibs.SystemTime
    service connector prototype NexteerLibs_SystemTime_Ap_HaLFTO_SystemTime: application-port=ECU_Composition.Ap_HaLFTO.SystemTime, service-port=NexteerLibs.SystemTime
    service connector prototype NvM_PS_Rte_NvmBlock_LrnEOT_LearnedEOT_Ap_LrnEOT_LearnedEOTData: application-port=ECU_Composition.Ap_LrnEOT.LearnedEOTData, service-port=NvM.PS_Rte_NvmBlock_LrnEOT_LearnedEOT
    service connector prototype NexteerLibs_SystemTime_Ap_LrnEOT_SystemTime: application-port=ECU_Composition.Ap_LrnEOT.SystemTime, service-port=NexteerLibs.SystemTime
    service connector prototype WdgM_SE003_SE10ms_10_CP001_PAwTO_Per2_CP1_Ap_PAwTO_PAwTO_Per2_CP1: application-port=ECU_Composition.Ap_PAwTO.PAwTO_Per2_CP1, service-port=WdgM.SE003_SE10ms_10_CP001_PAwTO_Per2_CP1
    service connector prototype NexteerLibs_SystemTime_Ap_PAwTO_SystemTime: application-port=ECU_Composition.Ap_PAwTO.SystemTime, service-port=NexteerLibs.SystemTime
    service connector prototype NexteerLibs_SystemTime_Ap_PwrLmtFuncCr_SystemTime: application-port=ECU_Composition.Ap_PwrLmtFuncCr.SystemTime, service-port=NexteerLibs.SystemTime
    service connector prototype NexteerLibs_SystemTime_Ap_StbCTO_SystemTime: application-port=ECU_Composition.Ap_StbCTO.SystemTime, service-port=NexteerLibs.SystemTime
    service connector prototype WdgM_SE000_SE100ms_9_CP001_ThrmlDutyCycle_Per1_CP1_Ap_ThrmlDutyCycle_ThrmlDutyCycle_Per1_CP1: application-port=ECU_Composition.Ap_ThrmlDutyCycle.ThrmlDutyCycle_Per1_CP1, service-port=WdgM.SE000_SE100ms_9_CP001_ThrmlDutyCycle_Per1_CP1
    service connector prototype NvMProxy_PS_NvMP_NvmBlock_CoggingTables_Ap_TrqCanc_EOLCogTrqCanc: application-port=ECU_Composition.Ap_TrqCanc.EOLCogTrqCanc, service-port=NvMProxy.PS_NvMP_NvmBlock_CoggingTables
    service connector prototype NvMProxy_PS_NvMP_NvmBlock_CogtrqRplComp_Ap_TrqCanc_EOLCogTrqRplComp: application-port=ECU_Composition.Ap_TrqCanc.EOLCogTrqRplComp, service-port=NvMProxy.PS_NvMP_NvmBlock_CogtrqRplComp
    service connector prototype WdgM_SE003_SE10ms_10_CP000_TuningSelAuth_Per1_CP0_Ap_TuningSelAuth_TuningSelAuth_Per1_CP0: application-port=ECU_Composition.Ap_TuningSelAuth.TuningSelAuth_Per1_CP0, service-port=WdgM.SE003_SE10ms_10_CP000_TuningSelAuth_Per1_CP0
    service connector prototype NexteerLibs_SystemTime_Ap_WhlImbRej_SystemTime: application-port=ECU_Composition.Ap_WhlImbRej.SystemTime, service-port=NexteerLibs.SystemTime
    service connector prototype NexteerLibs_SystemTime_Ap_WIRInputQual_SystemTime: application-port=ECU_Composition.Ap_WIRInputQual.SystemTime, service-port=NexteerLibs.SystemTime
    service connector prototype WdgM_SE008_SE2ms_9_CP000_BatterVoltage_Per1_CP0_BatteryVoltage_BatteryVoltage_Per1_CP0: application-port=ECU_Composition.BatteryVoltage.BatteryVoltage_Per1_CP0, service-port=WdgM.SE008_SE2ms_9_CP000_BatterVoltage_Per1_CP0
    service connector prototype NvMProxy_PS_NvMP_NvmBlock_OverVoltageData_BatteryVoltage_OvervoltageData: application-port=ECU_Composition.BatteryVoltage.OvervoltageData, service-port=NvMProxy.PS_NvMP_NvmBlock_OverVoltageData
    service connector prototype NexteerLibs_SystemTime_BatteryVoltage_SystemTime: application-port=ECU_Composition.BatteryVoltage.SystemTime, service-port=NexteerLibs.SystemTime
    service connector prototype WdgM_SE006_SE4ms_10_CP000_uDiagLossOfExec_per3_CP0_Cd_uDiag_uDiagLossOfExec_Per3_CP0: application-port=ECU_Composition.Cd_uDiag.uDiagLossOfExec_Per3_CP0, service-port=WdgM.SE006_SE4ms_10_CP000_uDiagLossOfExec_per3_CP0
    service connector prototype WdgM_SE001_SE100ms_10_CP001_uDiagStaticRegs_Per_CP1_Cd_uDiag_uDiagStaticRegs_Per_CP1: application-port=ECU_Composition.Cd_uDiag.uDiagStaticRegs_Per_CP1, service-port=WdgM.SE001_SE100ms_10_CP001_uDiagStaticRegs_Per_CP1
    service connector prototype CDD_CDDPorts_CDDInterface_CDDPorts: application-port=ECU_Composition.CDDInterface.CDDPorts, service-port=CDD.CDDPorts
    service connector prototype NvM_PS_Rte_NvmBlock_CmMtrCurr_CurrTempOffset_CmMtrCurr_EOLCurrTempOffset: application-port=ECU_Composition.CmMtrCurr.EOLCurrTempOffset, service-port=NvM.PS_Rte_NvmBlock_CmMtrCurr_CurrTempOffset
    service connector prototype NvMProxy_PS_NvMP_NvmBlock_ShCurrCal_CmMtrCurr_EOLShCurrCal: application-port=ECU_Composition.CmMtrCurr.EOLShCurrCal, service-port=NvMProxy.PS_NvMP_NvmBlock_ShCurrCal
    service connector prototype NexteerLibs_SystemTime_CtrldDisShtdn_SystemTime: application-port=ECU_Composition.CtrldDisShtdn.SystemTime, service-port=NexteerLibs.SystemTime
    service connector prototype WdgM_SE000_SE100ms_9_CP000_CtrlTemp_Per2_CP0_CtrlTemp_CtrlTemp_Per2_CP0: application-port=ECU_Composition.CtrlTemp.CtrlTemp_Per2_CP0, service-port=WdgM.SE000_SE100ms_9_CP000_CtrlTemp_Per2_CP0
    service connector prototype NvMProxy_PS_NvMP_NvmBlock_EOLNomMtrParam_CurrParamComp_EOLNomMtrParamBlk: application-port=ECU_Composition.CurrParamComp.EOLNomMtrParamBlk, service-port=NvMProxy.PS_NvMP_NvmBlock_EOLNomMtrParam
    service connector prototype Dem_OpCycle_DEM_IGNITION_DemIf_OperationCycle: application-port=ECU_Composition.DemIf.OperationCycle, service-port=Dem.OpCycle_DEM_IGNITION
    service connector prototype NvMProxy_PS_NvMP_NvmBlock_EOLTrqStepData_HwTrq_EOLTrqStep: application-port=ECU_Composition.HwTrq.EOLTrqStep, service-port=NvMProxy.PS_NvMP_NvmBlock_EOLTrqStepData
    service connector prototype WdgM_SE001_SE100ms_10_CP000_HwTrq_Per3_CP0_HwTrq_HwTrq_Per3_CP0: application-port=ECU_Composition.HwTrq.HwTrq_Per3_CP0, service-port=WdgM.SE001_SE100ms_10_CP000_HwTrq_Per3_CP0
    service connector prototype NvMProxy_PS_NvMP_NvmBlock_HwTrqScaleData_HwTrq_HwTrqScale: application-port=ECU_Composition.HwTrq.HwTrqScale, service-port=NvMProxy.PS_NvMP_NvmBlock_HwTrqScaleData
    service connector prototype NvMProxy_PS_NvMP_NvmBlock_HwTrqTrimData_HwTrq_HwTrqTrim: application-port=ECU_Composition.HwTrq.HwTrqTrim, service-port=NvMProxy.PS_NvMP_NvmBlock_HwTrqTrimData
    service connector prototype NexteerLibs_SystemTime_IoHwAbstractionUsr_SystemTime: application-port=ECU_Composition.IoHwAbstractionUsr.SystemTime, service-port=NexteerLibs.SystemTime
    service connector prototype NexteerLibs_SystemTime_MtrDrvDiag_SystemTime: application-port=ECU_Composition.MtrDrvDiag.SystemTime, service-port=NexteerLibs.SystemTime
    service connector prototype NvMProxy_PS_NvMP_NvmBlock_MtrPosSnsr_EOLData_MtrPos_EOLMtrCals: application-port=ECU_Composition.MtrPos.EOLMtrCals, service-port=NvMProxy.PS_NvMP_NvmBlock_MtrPosSnsr_EOLData
    service connector prototype WdgM_SE007_SE2ms_10_CP000_MtrVel_Per1_CP0_MtrVel_MtrVel_Per1_CP0: application-port=ECU_Composition.MtrVel.MtrVel_Per1_CP0, service-port=WdgM.SE007_SE2ms_10_CP000_MtrVel_Per1_CP0
    service connector prototype NvMProxy_PS_NvMP_NvmBlock_EOLCtrlPolarity_Polarity_Polarity: application-port=ECU_Composition.Polarity.Polarity, service-port=NvMProxy.PS_NvMP_NvmBlock_EOLCtrlPolarity
    service connector prototype NexteerLibs_SystemTime_Sa_BkCpPc_SystemTime: application-port=ECU_Composition.Sa_BkCpPc.SystemTime, service-port=NexteerLibs.SystemTime
    service connector prototype WdgM_SE002_SE100ms_8_CP000_HwTrq2_Per3_CP0_Sa_HwTrq2_HwTrq2_Per3_CP0: application-port=ECU_Composition.Sa_HwTrq2.HwTrq2_Per3_CP0, service-port=WdgM.SE002_SE100ms_8_CP000_HwTrq2_Per3_CP0
    service connector prototype WdgM_SE005_SE4ms_8_CP001_MtrPos3_Per2_CP1_Sa_MtrPos3_MtrPos3_Per2_CP1: application-port=ECU_Composition.Sa_MtrPos3.MtrPos3_Per2_CP1, service-port=WdgM.SE005_SE4ms_8_CP001_MtrPos3_Per2_CP1
    service connector prototype WdgM_SE009_SE2ms_8_CP000_MtrVel2_Per1_CP0_Sa_MtrVel2_MtrVel2_Per1_CP0: application-port=ECU_Composition.Sa_MtrVel2.MtrVel2_Per1_CP0, service-port=WdgM.SE009_SE2ms_8_CP000_MtrVel2_Per1_CP0
    service connector prototype WdgM_SE005_SE4ms_8_CP000_MtrVel2_Per2_CP0_Sa_MtrVel2_MtrVel2_Per2_CP0: application-port=ECU_Composition.Sa_MtrVel2.MtrVel2_Per2_CP0, service-port=WdgM.SE005_SE4ms_8_CP000_MtrVel2_Per2_CP0
    service connector prototype NexteerLibs_SystemTime_Sa_TmprlMon2_SystemTime: application-port=ECU_Composition.Sa_TmprlMon2.SystemTime, service-port=NexteerLibs.SystemTime
    service connector prototype WdgM_SE009_SE2ms_8_CP001_TmprlMon2_Per1_CP1_Sa_TmprlMon2_TmprlMon2_Per1_CP1: application-port=ECU_Composition.Sa_TmprlMon2.TmprlMon2_Per1_CP1, service-port=WdgM.SE009_SE2ms_8_CP001_TmprlMon2_Per1_CP1
    service connector prototype WdgM_SE004_SE10ms_9_CP000_SrlComInput_Per1_CP0_SrlComInput_SrlComInput_Per1_CP0: application-port=ECU_Composition.SrlComInput.SrlComInput_Per1_CP0, service-port=WdgM.SE004_SE10ms_9_CP000_SrlComInput_Per1_CP0
    service connector prototype NexteerLibs_SystemTime_SrlComInput_SystemTime: application-port=ECU_Composition.SrlComInput.SystemTime, service-port=NexteerLibs.SystemTime
    service connector prototype NexteerLibs_SystemTime_SrlComOutput_SystemTime: application-port=ECU_Composition.SrlComOutput.SystemTime, service-port=NexteerLibs.SystemTime
    service connector prototype NvMProxy_PS_NvMP_NvmBlock_CloseCheckData_StaMd_CloseCheckData: application-port=ECU_Composition.StaMd.CloseCheckData, service-port=NvMProxy.PS_NvMP_NvmBlock_CloseCheckData
    service connector prototype WdgM_SE007_SE2ms_10_CP001_StaMd_Per1_CP1_StaMd_StaMd_Per1_CP1: application-port=ECU_Composition.StaMd.StaMd_Per1_CP1, service-port=WdgM.SE007_SE2ms_10_CP001_StaMd_Per1_CP1
    service connector prototype NvMProxy_PS_NvMP_NvmBlock_TypeHRamBuffer_StaMd_TypeHData: application-port=ECU_Composition.StaMd.TypeHData, service-port=NvMProxy.PS_NvMP_NvmBlock_TypeHRamBuffer
    service connector prototype NexteerLibs_SystemTime_StOpCtrl_SystemTime: application-port=ECU_Composition.StOpCtrl.SystemTime, service-port=NexteerLibs.SystemTime
    service connector prototype NexteerLibs_SystemTime_TmprlMon_SystemTime: application-port=ECU_Composition.TmprlMon.SystemTime, service-port=NexteerLibs.SystemTime
    service connector prototype NvMProxy_PS_NvMP_NvmBlock_TorqueCmdSF_TrqCmdScl_TrqCmdScl: application-port=ECU_Composition.TrqCmdScl.TrqCmdScl, service-port=NvMProxy.PS_NvMP_NvmBlock_TorqueCmdSF
    service connector prototype EcuM_EcuMUsrCfg_EPS_VehPwrMd_EpsEcuMStRqst: application-port=ECU_Composition.VehPwrMd.EpsEcuMStRqst, service-port=EcuM.EcuMUsrCfg_EPS
    service connector prototype WdgM_SE008_SE2ms_9_CP001_VehPwrMd_Per1_CP1_VehPwrMd_VehPwrMd_Per1_CP1: application-port=ECU_Composition.VehPwrMd.VehPwrMd_Per1_CP1, service-port=WdgM.SE008_SE2ms_9_CP001_VehPwrMd_Per1_CP1
package /ECUCompositionType
  composition type ECU_Composition
    85 x component:
      Ap_AbsHwPosScom: type=Ap_AbsHwPosScom
      Ap_ActivePull: type=Ap_ActivePull
      Ap_ArbLmt: type=Ap_ArbLmt
      Ap_AssistFirewall: type=Ap_AssistFirewall
      Ap_AstLmt: type=Ap_AstLmt
      Ap_AvgFricLrn: type=Ap_AvgFricLrn
      Ap_BVDiag: type=Ap_BVDiag
      Ap_DampingFirewall: type=Ap_DampingFirewall
      Ap_DiagMgr8: type=Ap_DiagMgr8
      Ap_DiagMgr9: type=Ap_DiagMgr9
      Ap_ElePwr: type=Ap_ElePwr
      Ap_ePWM2: type=Ap_ePWM2
      Ap_Gsod: type=Ap_Gsod
      Ap_HaLFTO: type=Ap_HaLFTO
      Ap_HwPwUp: type=Ap_HwPwUp
      Ap_LmtCod: type=Ap_LmtCod
      Ap_LrnEOT: type=Ap_LrnEOT
      Ap_MtrTempEst: type=Ap_MtrTempEst
      Ap_PAwTO: type=Ap_PAwTO
      Ap_PICurrCntrl: type=Ap_PICurrCntrl
      Ap_PwrLmtFuncCr: type=Ap_PwrLmtFuncCr
      Ap_ReturnFirewall: type=Ap_ReturnFirewall
      Ap_SignlCondn: type=Ap_SignlCondn
      Ap_StabilityComp2: type=Ap_StabilityComp2
      Ap_StaMd8: type=Ap_StaMd8
      Ap_StaMd9: type=Ap_StaMd9
      Ap_StbCTO: type=Ap_StbCTO
      Ap_ThrmlDutyCycle: type=Ap_ThrmlDutyCycle
      Ap_TqRsDg: type=Ap_TqRsDg
      Ap_TrqCanc: type=Ap_TrqCanc
      Ap_TuningSelAuth: type=Ap_TuningSelAuth
      Ap_WhlImbRej: type=Ap_WhlImbRej
      Ap_WIRInputQual: type=Ap_WIRInputQual
      Assist: type=Ap_Assist
      BatteryVoltage: type=Ap_BatteryVoltage
      Ccl: type=Ccl
      Cd_uDiag: type=Cd_uDiag
      CDDInterface: type=Sa_CDDInterface
      CmMtrCurr: type=Sa_CmMtrCurr
      CtrldDisShtdn: type=Ap_CtrldDisShtdn
      CtrlTemp: type=Sa_CtrlTemp
      CurrCmd: type=Ap_CurrCmd
      CurrParamComp: type=Ap_CurrParamComp
      Damping: type=Ap_Damping
      DemIf: type=Ap_DemIf
      DiagMgr: type=Ap_DiagMgr10
      DigPhsReasDiag: type=Ap_DigPhsReasDiag
      EOTActuatorMng: type=Ap_EOTActuatorMng
      FrqDepDmpnInrtCmp: type=Ap_FrqDepDmpnInrtCmp
      HighFreqAssist: type=Ap_HighFreqAssist
      HiLoadStall: type=Ap_HiLoadStall
      HwTrq: type=Sa_HwTrq
      HystComp: type=Ap_HystComp
      IoHwAbsDigSig: type=IoHwAbstraction
      IoHwAbstractionUsr: type=IoHwAbstractionUsr
      MtrDrvDiag: type=Sa_MtrDrvDiag
      MtrPos: type=Sa_MtrPos
      MtrVel: type=Sa_MtrVel
      NtWrap: type=NtWrap
      PeakCurrEst: type=Ap_PeakCurrEst
      Polarity: type=Ap_Polarity
      QuadDet: type=Ap_QuadDet
      Return: type=Ap_Return
      RteErrata: type=RteErrata10
      RteErrata8: type=RteErrata8
      RteErrata9: type=RteErrata9
      Sa_BkCpPc: type=Sa_BkCpPc
      Sa_HwTrq2: type=Sa_HwTrq2
      Sa_MtrPos2: type=Sa_MtrPos2
      Sa_MtrPos3: type=Sa_MtrPos3
      Sa_MtrVel2: type=Sa_MtrVel2
      Sa_MtrVel3: type=Sa_MtrVel3
      Sa_OvrVoltMon: type=Sa_OvrVoltMon
      Sa_ShtdnMech: type=Sa_ShtdnMech
      Sa_TmprlMon2: type=Sa_TmprlMon2
      SrlComInput: type=Ap_SrlComInput
      SrlComOutput: type=Ap_SrlComOutput
      StabilityComp: type=Ap_StabilityComp
      StaMd: type=Ap_StaMd
      StOpCtrl: type=Ap_StOpCtrl
      TmprlMon: type=Sa_TmprlMon
      TrqCmdScl: type=Ap_TrqCmdScl
      VehPwrMd: type=Ap_VehPwrMd
      VehSpdLmt: type=Ap_VehSpdLmt
      Xcp: type=Ap_ApXcp
    connect Ap_AbsHwPosScom.AbsHwPosScom_Scom -> NtWrap.C_AbsHwPosScom_Scom
    connect Ap_AbsHwPosScom.HwPos -> Ap_ActivePull.HandwheelPosition
    connect Ap_AbsHwPosScom.HwPos -> Ap_AvgFricLrn.HwAng
    connect Ap_AbsHwPosScom.HwPos -> Ap_LrnEOT.HandwheelPosition
    connect Ap_AbsHwPosScom.HwPos -> Ap_ReturnFirewall.HandwheelPosition
    connect Ap_AbsHwPosScom.HwPos -> EOTActuatorMng.HandWheelPos
    connect Ap_AbsHwPosScom.HwPos -> Return.HandwheelPosition
    connect Ap_AbsHwPosScom.HwPos -> VehSpdLmt.HwPos
    connect Ap_AbsHwPosScom.HwPosAuthority -> Ap_ActivePull.HandwheelAuthority
    connect Ap_AbsHwPosScom.HwPosAuthority -> Ap_AvgFricLrn.HwPosAuthority
    connect Ap_AbsHwPosScom.HwPosAuthority -> Ap_LrnEOT.HandwheelAuthority
    connect Ap_AbsHwPosScom.HwPosAuthority -> EOTActuatorMng.HandWheelAuth
    connect Ap_AbsHwPosScom.HwPosAuthority -> Return.HandwheelAuthority
    connect Ap_AbsHwPosScom.HwPosAuthority -> VehSpdLmt.HwPosAuth
    connect Ap_ActivePull.PullCompCmd -> Ap_AstLmt.PullCompCmd
    connect Ap_ArbLmt.ActiveFunctionBits -> SrlComOutput.ActiveFunctionBits
    connect Ap_ArbLmt.DSTSlewComplete -> Ap_StbCTO.DSTSlewComplete
    connect Ap_ArbLmt.HaLFSlewComplete -> Ap_HaLFTO.HaLFSlewComplete
    connect Ap_ArbLmt.IpTrqOvr -> Assist.IpTrqOvr
    connect Ap_ArbLmt.OpTrqOvr -> Ap_AstLmt.OpTrqOvr
    connect Ap_ArbLmt.PAReturnSclFct -> Return.PAReturnSclFct
    connect Ap_ArbLmt.PICmpDisableLearning -> Ap_ActivePull.DisableLearning
    connect Ap_ArbLmt.PrkAsstSlewComplete -> Ap_PAwTO.PrkAsstSlewComplete
    connect Ap_AssistFirewall.AsstFirewallActive -> Ap_DampingFirewall.AsstFirewallActive
    connect Ap_AssistFirewall.AsstFirewallActive -> Ap_StabilityComp2.AsstFWActive
    connect Ap_AssistFirewall.AsstFirewallActive -> StabilityComp.AsstFWActive
    connect Ap_AssistFirewall.CombinedAssist -> Ap_StabilityComp2.CombinedAssist
    connect Ap_AssistFirewall.CombinedAssist -> StabilityComp.CombinedAssist
    connect Ap_AstLmt.AstLmt_Scom -> NtWrap.C_AstLmt_Scom
    connect Ap_AstLmt.LimitPercentFiltered -> Ap_HaLFTO.LimitPercentFiltered
    connect Ap_AstLmt.LimitPercentFiltered -> Ap_PAwTO.LimitPercentFiltered
    connect Ap_AstLmt.LimitPercentFiltered -> Ap_StbCTO.LimitPercentFiltered
    connect Ap_AstLmt.PreLimitForStall -> HiLoadStall.PreLimitForStall
    connect Ap_AstLmt.PreLimitTorque -> EOTActuatorMng.PreLimitTorque
    connect Ap_AstLmt.SumLimTrqCmd -> Ap_LrnEOT.PostLimitTorque
    connect Ap_AstLmt.SumLimTrqCmd -> CtrldDisShtdn.SumLimTrqCmd
    connect Ap_AstLmt.SumLimTrqCmd -> SrlComOutput.SumLmtTrqCmd
    connect Ap_AstLmt.TrqLimitMin -> Ap_TqRsDg.TrqLimitMin
    connect Ap_AvgFricLrn.EstFric -> SrlComInput.EstFric
    connect Ap_AvgFricLrn.FricOffset -> HystComp.FricOffset
    connect Ap_DampingFirewall.CombinedDamping -> Ap_AstLmt.CombinedDamping
    connect Ap_DiagMgr8.NxtrDiagMgr8 -> Ap_Gsod.NxtrDiagMgr
    connect Ap_DiagMgr8.NxtrDiagMgr8 -> Sa_HwTrq2.NxtrDiagMgr
    connect Ap_DiagMgr8.NxtrDiagMgr8 -> Sa_MtrPos3.NxtrDiagMgr
    connect Ap_DiagMgr8.NxtrDiagMgr8 -> Sa_MtrVel2.NxtrDiagMgr
    connect Ap_DiagMgr9.DiagMgr_StaCtrl -> Ap_StaMd9.DiagMgr_StaCtrl
    connect Ap_DiagMgr9.NxtrDiagMgr9 -> Ap_AvgFricLrn.NxtrDiagMgr
    connect Ap_DiagMgr9.NxtrDiagMgr9 -> Ap_BVDiag.NxtrDiagMgr
    connect Ap_DiagMgr9.NxtrDiagMgr9 -> Ap_LrnEOT.NxtrDiagMgr
    connect Ap_DiagMgr9.NxtrDiagMgr9 -> Ap_ThrmlDutyCycle.NxtrDiagMgr
    connect Ap_DiagMgr9.NxtrDiagMgr9 -> BatteryVoltage.NxtrDiagMgr
    connect Ap_DiagMgr9.NxtrDiagMgr9 -> CtrlTemp.NxtrDiagMgr
    connect Ap_DiagMgr9.NxtrDiagMgr9 -> DemIf.NxtrDiagMgr
    connect Ap_DiagMgr9.NxtrDiagMgr9 -> Sa_BkCpPc.NxtrDiagMgr
    connect Ap_DiagMgr9.NxtrDiagMgr9 -> SrlComInput.NxtrDiagMgr
    connect Ap_DiagMgr9.NxtrDiagMgr9 -> SrlComOutput.NxtrDiagMgr
    connect Ap_ElePwr.SupplyCurrent -> SrlComOutput.SupplyCurrent
    connect Ap_HaLFTO.HaLFActive -> Ap_ArbLmt.HaLFActive
    connect Ap_HaLFTO.HaLFState -> Ap_ArbLmt.HaLFTOState
    connect Ap_HaLFTO.HaLFState -> SrlComInput.HaLFState
    connect Ap_HaLFTO.HaLFState -> SrlComOutput.HaLFState
    connect Ap_HaLFTO.HaLFSuspend -> SrlComInput.HaLFSuspend
    connect Ap_HaLFTO.HaLFSuspend -> SrlComOutput.HaLFSuspend
    connect Ap_HwPwUp.MtrDrvrInitStart -> MtrDrvDiag.MtrDrvrInitStart
    connect Ap_HwPwUp.PwrDiscATestStart -> Sa_BkCpPc.PwrDiscATestStart
    connect Ap_HwPwUp.PwrDiscBTestStart -> Sa_BkCpPc.PwrDiscBTestStart
    connect Ap_HwPwUp.PwrDiscBTestStart -> Sa_OvrVoltMon.PwrDiscBTestStart
    connect Ap_HwPwUp.TMFTestStart -> TmprlMon.TMFTestStart
    connect Ap_LmtCod.EOTGainLtd -> Ap_AstLmt.AssistEOTGain
    connect Ap_LmtCod.EOTLimitLtd -> Ap_AstLmt.AssistEOTLimit
    connect Ap_LmtCod.OutputRampMultLtd -> Ap_AstLmt.OutputRampMult
    connect Ap_LmtCod.StallLimitLtd -> Ap_AstLmt.AssistStallLimit
    connect Ap_LmtCod.ThermalLimitLtd -> Ap_AstLmt.ThermalLimit
    connect Ap_LmtCod.VehSpdLimitLtd -> Ap_AstLmt.AssistVehSpdLimit
    connect Ap_LrnEOT.CCWFound -> EOTActuatorMng.CcwFound
    connect Ap_LrnEOT.CCWPosition -> EOTActuatorMng.CcwEOT
    connect Ap_LrnEOT.CCWPosition -> VehSpdLmt.CCWPosition
    connect Ap_LrnEOT.CWFound -> EOTActuatorMng.CwFound
    connect Ap_LrnEOT.CWPosition -> EOTActuatorMng.CwEOT
    connect Ap_LrnEOT.CWPosition -> VehSpdLmt.CWPosition
    connect Ap_MtrTempEst.AssistMechTempEst -> Ap_AvgFricLrn.Temperature
    connect Ap_MtrTempEst.AssistMechTempEst -> Damping.AssistMechTempEst
    connect Ap_MtrTempEst.AssistMechTempEst -> HystComp.AssistMechTempEst
    connect Ap_MtrTempEst.AssistMechTempEst -> Return.AssistMechTempEst
    connect Ap_MtrTempEst.CuTempEst -> Ap_ThrmlDutyCycle.CuTempEst
    connect Ap_MtrTempEst.CuTempEst -> CurrParamComp.CuTempEst
    connect Ap_MtrTempEst.MagTempEst -> Ap_ThrmlDutyCycle.MagTempEst
    connect Ap_MtrTempEst.MagTempEst -> CurrParamComp.MagTempEst
    connect Ap_MtrTempEst.SiTempEst -> Ap_ThrmlDutyCycle.SiTempEst
    connect Ap_MtrTempEst.SiTempEst -> CurrParamComp.SiTempEst
    connect Ap_PAwTO.HandsOnDetect -> SrlComInput.HandsOnDetect
    connect Ap_PAwTO.HandsOnDetect -> SrlComOutput.HandsOnDetect
    connect Ap_PAwTO.PABoostCurveSwitch -> SrlComInput.PABoostCurveSwitch
    connect Ap_PAwTO.PrkAssistState -> Ap_ArbLmt.PrkAssistState
    connect Ap_PAwTO.PrkAssistState -> SrlComInput.PrkAssistState
    connect Ap_PAwTO.PrkAssistState -> SrlComOutput.PrkAssistState
    connect Ap_PAwTO.PrkAssistSuspend -> SrlComInput.PrkAssistSuspend
    connect Ap_PAwTO.PrkAssistSuspend -> SrlComOutput.PrkAssistSuspend
    connect Ap_PICurrCntrl.DervLambdaAlphaDiag -> Ap_TqRsDg.DervLambdaAlphaDiag
    connect Ap_PICurrCntrl.DervLambdaBetaDiag -> Ap_TqRsDg.DervLambdaBetaDiag
    connect Ap_PwrLmtFuncCr.FltTrqLmt -> Ap_AstLmt.PowerLimitPerc
    connect Ap_PwrLmtFuncCr.MRFMtrTrqCmd -> Ap_DiagMgr8.MtrTrq
    connect Ap_PwrLmtFuncCr.MRFMtrTrqCmd -> Ap_DiagMgr9.MtrTrq
    connect Ap_PwrLmtFuncCr.MRFMtrTrqCmd -> TrqCmdScl.MRFMtrTrqCmd
    connect Ap_ReturnFirewall.LimitedReturn -> Ap_AstLmt.LimitedReturn
    connect Ap_SignlCondn.Vehicle_LonAccel -> Ap_DampingFirewall.VehicleLonAccel
    connect Ap_SignlCondn.Vehicle_LonAccel -> FrqDepDmpnInrtCmp.VehicleLonAccel
    connect Ap_SignlCondn.VehicleSpeed -> Ap_AbsHwPosScom.VehicleSpeed
    connect Ap_SignlCondn.VehicleSpeed -> Ap_ActivePull.VehicleSpeed
    connect Ap_SignlCondn.VehicleSpeed -> Ap_ArbLmt.VehicleSpeed
    connect Ap_SignlCondn.VehicleSpeed -> Ap_AssistFirewall.VehicleSpeed
    connect Ap_SignlCondn.VehicleSpeed -> Ap_AstLmt.VehSpd
    connect Ap_SignlCondn.VehicleSpeed -> Ap_AvgFricLrn.VehSpd
    connect Ap_SignlCondn.VehicleSpeed -> Ap_DampingFirewall.VehicleSpeed
    connect Ap_SignlCondn.VehicleSpeed -> Ap_DiagMgr8.VehSpd
    connect Ap_SignlCondn.VehicleSpeed -> Ap_DiagMgr9.VehSpd
    connect Ap_SignlCondn.VehicleSpeed -> Ap_HaLFTO.VehicleSpeed
    connect Ap_SignlCondn.VehicleSpeed -> Ap_LmtCod.VehicleSpeed
    connect Ap_SignlCondn.VehicleSpeed -> Ap_PAwTO.VehicleSpeed
    connect Ap_SignlCondn.VehicleSpeed -> Ap_ReturnFirewall.VehicleSpeed
    connect Ap_SignlCondn.VehicleSpeed -> Ap_StabilityComp2.VehicleSpeed
    connect Ap_SignlCondn.VehicleSpeed -> Ap_StbCTO.VehicleSpeed
    connect Ap_SignlCondn.VehicleSpeed -> Ap_TuningSelAuth.VehicleSpeed
    connect Ap_SignlCondn.VehicleSpeed -> Ap_WhlImbRej.VehSpd
    connect Ap_SignlCondn.VehicleSpeed -> Assist.VehSpd
    connect Ap_SignlCondn.VehicleSpeed -> CmMtrCurr.VehSpd
    connect Ap_SignlCondn.VehicleSpeed -> CurrCmd.VehSpd
    connect Ap_SignlCondn.VehicleSpeed -> Damping.VehicleSpeed
    connect Ap_SignlCondn.VehicleSpeed -> DiagMgr.VehSpd
    connect Ap_SignlCondn.VehicleSpeed -> EOTActuatorMng.VehicleSpeed
    connect Ap_SignlCondn.VehicleSpeed -> FrqDepDmpnInrtCmp.VehicleSpeed
    connect Ap_SignlCondn.VehicleSpeed -> HighFreqAssist.VehicleSpeed
    connect Ap_SignlCondn.VehicleSpeed -> HystComp.VehicleSpeed
    connect Ap_SignlCondn.VehicleSpeed -> MtrVel.VehicleSpeed
    connect Ap_SignlCondn.VehicleSpeed -> Return.VehicleSpeed
    connect Ap_SignlCondn.VehicleSpeed -> SrlComOutput.VehicleSpeed
    connect Ap_SignlCondn.VehicleSpeed -> StabilityComp.VehicleSpeed
    connect Ap_SignlCondn.VehicleSpeed -> VehSpdLmt.VehSpd
    connect Ap_StabilityComp2.SysAssistCmd -> StabilityComp.SysAssistCmd_MtrNm
    connect Ap_StaMd8.SystemState8 -> Ap_DiagMgr8.SystemState
    connect Ap_StaMd8.SystemState8 -> Ap_Gsod.SystemState
    connect Ap_StaMd8.SystemState8 -> RteErrata8.SystemState
    connect Ap_StaMd9.StaMd_SCom -> NtWrap.C_StaMd_SCom
    connect Ap_StaMd9.SystemState9 -> Ap_ActivePull.SystemState
    connect Ap_StaMd9.SystemState9 -> Ap_AvgFricLrn.SystemState
    connect Ap_StaMd9.SystemState9 -> Ap_DiagMgr9.SystemState
    connect Ap_StaMd9.SystemState9 -> BatteryVoltage.SystemState
    connect Ap_StaMd9.SystemState9 -> RteErrata9.SystemState
    connect Ap_StaMd9.SystemState9 -> Sa_BkCpPc.SystemState
    connect Ap_StaMd9.SystemState9 -> SrlComInput.SystemState
    connect Ap_StaMd9.SystemState9 -> SrlComOutput.SystemState
    connect Ap_StbCTO.DSTActive -> Ap_ArbLmt.DSTActive
    connect Ap_StbCTO.DSTSlewStart -> SrlComInput.DSTSlewStart
    connect Ap_StbCTO.DSTState -> Ap_ArbLmt.DSTState
    connect Ap_StbCTO.DSTState -> Ap_HaLFTO.DSTState
    connect Ap_StbCTO.DSTState -> SrlComInput.DSTState
    connect Ap_StbCTO.DSTState -> SrlComOutput.DSTState
    connect Ap_ThrmlDutyCycle.DutyCycleLevel -> Assist.DutyCycleLevel
    connect Ap_ThrmlDutyCycle.ThermalLimit -> Ap_LmtCod.ThermalLimit
    connect Ap_ThrmlDutyCycle.ThermLimitPerc -> Ap_AstLmt.ThermalLimitPerc
    connect Ap_TrqCanc.TrqCanc_Scom -> NtWrap.C_TrqCanc_Scom
    connect Ap_TuningSelAuth.ActiveTunSet -> SrlComOutput.ActiveTunSet
    connect Ap_WhlImbRej.WhlImbRejCmd -> Ap_AstLmt.WheelImbalanceCmd
    connect Ap_WhlImbRej.WIRCmdAmpBlnd -> Ap_DampingFirewall.WIRCmdAmpBlnd
    connect Ap_WhlImbRej.WIRCmdAmpBlnd -> Assist.WIRCmdAmpBlnd
    connect Ap_WhlImbRej.WIRCmdAmpBlnd -> FrqDepDmpnInrtCmp.WIRCmdAmpBlnd
    connect Ap_WhlImbRej.WIRCmdAmpBlnd -> HighFreqAssist.WIRCmdAmpBlnd
    connect Ap_WhlImbRej.WIRCmdAmpBlnd -> HystComp.WIRCmdAmpBlnd
    connect Ap_WIRInputQual.QualWhlFreqL -> Ap_WhlImbRej.QualWhlFreqL
    connect Ap_WIRInputQual.QualWhlFreqR -> Ap_WhlImbRej.QualWhlFreqR
    connect Ap_WIRInputQual.WhlFreqQualified -> Ap_WhlImbRej.WhlFreqQualified
    connect Assist.BaseAssistCmd -> Ap_AssistFirewall.BaseAssistCmd
    connect Assist.BaseAssistCmd -> Ap_DampingFirewall.BaseAssistCmd
    connect Assist.BaseAssistCmd -> FrqDepDmpnInrtCmp.BaseAssistCmd
    connect Assist.BaseAssistCmd -> HystComp.BaseAssistCmd
    connect BatteryVoltage.SysC_Vecu -> Ap_Gsod.SysC_Vecu
    connect BatteryVoltage.Vecu -> Ap_ElePwr.Vecu
    connect BatteryVoltage.Vecu -> Ap_Gsod.Vecu
    connect BatteryVoltage.Vecu -> Ap_PwrLmtFuncCr.Vecu
    connect BatteryVoltage.Vecu -> CDDInterface.Vecu
    connect BatteryVoltage.Vecu -> CmMtrCurr.Vecu
    connect BatteryVoltage.Vecu -> CurrCmd.Vecu
    connect BatteryVoltage.Vecu -> DemIf.DemLocalVoltage
    connect BatteryVoltage.Vecu -> DemIf.DemSystemVoltage
    connect BatteryVoltage.VswitchClosed -> MtrDrvDiag.VswitchClosed
    connect CDDInterface.ADCMtrCurr1 -> CmMtrCurr.ADCMtrCurr1
    connect CDDInterface.ADCMtrCurr2 -> CmMtrCurr.ADCMtrCurr2
    connect CDDInterface.CorrMtrCurrPosition -> Ap_PICurrCntrl.CorrMtrPosElec
    connect CDDInterface.CorrMtrCurrPosition -> CmMtrCurr.CorrMtrCurrPosition
    connect CDDInterface.DampingSrlComSvcDft -> Ap_DampingFirewall.Defeat_Damping_Svc
    connect CDDInterface.DampingSrlComSvcDft -> Damping.DefeatDampingSvc
    connect CDDInterface.DftAsstTbl -> Ap_AssistFirewall.Defeat_AsstTbl_Service
    connect CDDInterface.DftAsstTbl -> Assist.DftAsstTbl
    connect CDDInterface.DwnldAsstGain -> Assist.DwnldAsstGain
    connect CDDInterface.EngONSrlComSvcDft -> VehPwrMd.EngONSrlComSvcDft
    connect CDDInterface.EOTImpactSrlComSvcDft -> EOTActuatorMng.EOTDisable
    connect CDDInterface.EOTThermalSrlComSvcDft -> HiLoadStall.DftStallLimit
    connect CDDInterface.ExpectedOnTimeA -> DigPhsReasDiag.ExpectedOnTimeA
    connect CDDInterface.ExpectedOnTimeB -> DigPhsReasDiag.ExpectedOnTimeB
    connect CDDInterface.ExpectedOnTimeC -> DigPhsReasDiag.ExpectedOnTimeC
    connect CDDInterface.FreqDepDmpSrlComSvcDft -> Ap_DampingFirewall.FreqDepDmpSrlComSvcDft
    connect CDDInterface.FreqDepDmpSrlComSvcDft -> FrqDepDmpnInrtCmp.FreqDepDmpSrlComSvcDft
    connect CDDInterface.FricLrnSrlComSvcDft -> Ap_AvgFricLrn.DefeatFricLearning
    connect CDDInterface.HystCompSrlComSvcDft -> HystComp.DefeatHystService
    connect CDDInterface.IgnCnt -> Ap_DiagMgr8.IgnCnt
    connect CDDInterface.IgnCnt -> Ap_DiagMgr9.IgnCnt
    connect CDDInterface.IgnCnt -> DiagMgr.IgnCnt
    connect CDDInterface.KinIntDiagSrlComSvcDft -> Ap_AbsHwPosScom.KinIntDiagSrlComSvcDft
    connect CDDInterface.LimitSrlComSvcDft -> Ap_AstLmt.DefeatLimitService
    connect CDDInterface.LRPRPhaseadvanceCaptured -> DigPhsReasDiag.LRPRPhaseadvanceCaptured
    connect CDDInterface.MeasuredOnTimeA -> DigPhsReasDiag.MeasuredOnTimeA
    connect CDDInterface.MeasuredOnTimeB -> DigPhsReasDiag.MeasuredOnTimeB
    connect CDDInterface.MeasuredOnTimeC -> DigPhsReasDiag.MeasuredOnTimeC
    connect CDDInterface.MEC -> Ap_AssistFirewall.MEC_Counter
    connect CDDInterface.MEC -> Ap_DampingFirewall.MEC_Counter
    connect CDDInterface.MEC -> Ap_DiagMgr8.MEC
    connect CDDInterface.MEC -> Ap_DiagMgr9.MEC
    connect CDDInterface.MEC -> Ap_ReturnFirewall.MEC_Counter
    connect CDDInterface.MEC -> CmMtrCurr.MEC
    connect CDDInterface.MEC -> DiagMgr.MEC
    connect CDDInterface.MEC -> HwTrq.MECCounter
    connect CDDInterface.MEC -> SrlComInput.MEC
    connect CDDInterface.MfgDiagInhibit -> Ap_DiagMgr8.MfgDiagInhibit
    connect CDDInterface.MfgDiagInhibit -> Ap_DiagMgr9.MfgDiagInhibit
    connect CDDInterface.MfgDiagInhibit -> DiagMgr.MfgDiagInhibit
    connect CDDInterface.ModIdxFinal -> DigPhsReasDiag.LRPRModulationIndexCaptured
    connect CDDInterface.MtrCurrDax -> Ap_ElePwr.MtrCurrDax
    connect CDDInterface.MtrCurrDax -> PeakCurrEst.MtrCurrDax
    connect CDDInterface.MtrCurrK1 -> CmMtrCurr.MtrCurrK1
    connect CDDInterface.MtrCurrK2 -> CmMtrCurr.MtrCurrK2
    connect CDDInterface.MtrCurrQax -> Ap_ElePwr.MtrCurrQax
    connect CDDInterface.MtrCurrQax -> PeakCurrEst.MtrCurrQax
    connect CDDInterface.MtrVoltDax -> Ap_ElePwr.MtrVoltDax
    connect CDDInterface.MtrVoltQax -> Ap_ElePwr.MtrVoltQax
    connect CDDInterface.PullCompSrlComSvcDft -> Ap_ActivePull.DisableOutput
    connect CDDInterface.ReturnSrlComSvcDft -> Ap_ReturnFirewall.Defeat_Return_Svc
    connect CDDInterface.ReturnSrlComSvcDft -> Return.DefeatReturnSvc
    connect CDDInterface.RxMsgsSrlComSvcDft -> SrlComInput.RxMsgsSrlComSvcDft
    connect CDDInterface.SrlComSvcDft -> CmMtrCurr.SrlComSvcDft
    connect CDDInterface.ThermalDCSrlComSvcDft -> Ap_ThrmlDutyCycle.DefeatDutySvc
    connect CDDInterface.TOEOLDisable -> Ap_HaLFTO.TOEOLDisable
    connect CDDInterface.TOEOLDisable -> Ap_PAwTO.TOEOLDisable
    connect CDDInterface.TOEOLDisable -> Ap_StbCTO.TOEOLDisable
    connect CDDInterface.TrqRmpSrlComSvcDft -> StOpCtrl.RampSrlComSvcDft
    connect CDDInterface.WIREnabled -> Ap_WhlImbRej.WIRMfgEnable
    connect CmMtrCurr.CmMtrCurr_SCom -> NtWrap.C_CmMtrCurr_SCom
    connect CmMtrCurr.ComOffset -> CDDInterface.CommOffset
    connect CmMtrCurr.CurrentGainSvc -> CurrCmd.CurrentGainSvc
    connect CmMtrCurr.MtrCurr1TempOffset -> CDDInterface.MtrCurr1TempOffset
    connect CmMtrCurr.MtrCurr2TempOffset -> CDDInterface.MtrCurr2TempOffset
    connect CtrldDisShtdn.CntDisMtrTrqCmdCRF -> Ap_AbsHwPosScom.CRFMtrTrqCmd
    connect CtrldDisShtdn.CntDisMtrTrqCmdCRF -> Ap_AvgFricLrn.CRFMtrTrq
    connect CtrldDisShtdn.CntDisMtrTrqCmdCRF -> Ap_Gsod.Torque_Cmd_CRF
    connect CtrldDisShtdn.CntDisMtrTrqCmdCRF -> Ap_Gsod.Torque_Cmd_MRF
    connect CtrldDisShtdn.CntDisMtrTrqCmdCRF -> SrlComOutput.CRFMtrTrqCmd
    connect CtrldDisShtdn.CntDisMtrTrqCmdMRF -> Ap_PwrLmtFuncCr.CntDisMtrTrqCmdMRF
    connect CtrldDisShtdn.CntDisMtrTrqCmdMRF -> DiagMgr.MtrTrq
    connect CtrldDisShtdn.CtrldDmpStsCmp -> HwTrq.CntrlDisRampComplete
    connect CtrldDisShtdn.CtrldDmpStsCmp -> StaMd.ControlledDampStatusComplete
    connect CtrldDisShtdn.SysC_CRFMtrTrqCmd -> Ap_Gsod.SysC_Torque_Cmd_CRF
    connect CtrldDisShtdn.SysC_MRFMtrTrqCmd -> Ap_Gsod.SysC_Torque_Cmd_MRF
    connect CtrlTemp.FiltMeasTemp -> Ap_MtrTempEst.CtrlTempFinal
    connect CtrlTemp.FiltMeasTemp -> Ap_ThrmlDutyCycle.FiltMeasTemp
    connect CtrlTemp.FiltMeasTemp -> CmMtrCurr.FiltCntrlTemp
    connect CurrCmd.MtrCurrAngle -> CmMtrCurr.MtrCurrAngle
    connect CurrCmd.MtrCurrDaxRef -> Ap_PICurrCntrl.MtrCurrDaxRef
    connect CurrCmd.MtrCurrDaxRef -> Ap_TrqCanc.MtrCurrDaxRef
    connect CurrCmd.MtrCurrDaxRef -> CDDInterface.MtrCurrDaxRef_SPM
    connect CurrCmd.MtrCurrDaxRef -> CurrParamComp.MtrCurrDaxRef
    connect CurrCmd.MtrCurrQaxRef -> Ap_TrqCanc.MtrCurrQaxRef
    connect CurrCmd.MtrCurrQaxRef -> CDDInterface.MtrCurrQaxRef_SPM
    connect CurrCmd.MtrCurrQaxRef -> CurrParamComp.MtrCurrQaxRef
    connect CurrCmd.MtrTrqCmdSign -> CDDInterface.MtrTrqCmdSign_SPM
    connect CurrCmd.MtrVoltDaxFF -> CDDInterface.MtrVoltDaxFF_SPM
    connect CurrCmd.MtrVoltQaxFF -> CDDInterface.MtrVoltQaxFF_SPM
    connect CurrParamComp.EstKe -> Ap_PICurrCntrl.EstKe
    connect CurrParamComp.EstKe -> Ap_PwrLmtFuncCr.EstKe
    connect CurrParamComp.EstKe -> Ap_TrqCanc.EstKe
    connect CurrParamComp.EstKe -> CDDInterface.EstKe
    connect CurrParamComp.EstKe -> CurrCmd.EstKe
    connect CurrParamComp.EstLd -> CurrCmd.EstLd
    connect CurrParamComp.EstLq -> CurrCmd.EstLq
    connect CurrParamComp.EstR -> Ap_PICurrCntrl.EstR
    connect CurrParamComp.EstR -> CurrCmd.EstR
    connect CurrParamComp.SCom_EOLNomMtrParam -> NtWrap.C_SCom_EOLNomMtrParam
    connect Damping.DampingCmd -> Ap_DampingFirewall.DampingCmd
    connect DemIf.DemIf -> Ap_DiagMgr9.DemIf
    connect DiagMgr.DiagRampRate -> StOpCtrl.DiagRampRate
    connect DiagMgr.DiagRampValue -> StOpCtrl.DiagRampValue
    connect DiagMgr.DiagRmpToZeroActive -> StaMd.FTerm
    connect DiagMgr.DiagRmpToZeroActive -> StOpCtrl.DiagStsDiagRmpActive
    connect DiagMgr.DiagStsCtrldDisRmpPres -> CtrldDisShtdn.DiagStsF2Active
    connect DiagMgr.DiagStsDefTemp -> CtrlTemp.DiagStsTempRdPrf
    connect DiagMgr.DiagStsDefVehSpd -> SrlComInput.DefaultVehSpd
    connect DiagMgr.DiagStsDefVehSpd -> VehPwrMd.DefaultVehSpd
    connect DiagMgr.DiagStsHWASbSystmFltPres -> Ap_AbsHwPosScom.DiagStsHwPosDis
    connect DiagMgr.DiagStsHWASbSystmFltPres -> Ap_LrnEOT.DiagStsHwPosDis
    connect DiagMgr.DiagStsHWASbSystmFltPres -> Return.DiagStsHwPosDis
    connect DiagMgr.DiagStsNonRecRmpToZeroFltPres -> Ap_HaLFTO.DiagStsNonRecRmpToZeroFltPres
    connect DiagMgr.DiagStsNonRecRmpToZeroFltPres -> Ap_PAwTO.DiagStsNonRecRmpToZeroFltPres
    connect DiagMgr.DiagStsNonRecRmpToZeroFltPres -> Ap_StbCTO.DiagStsNonRecRmpToZeroFltPres
    connect DiagMgr.DiagStsNonRecRmpToZeroFltPres -> SrlComOutput.DiagStsNonRecRmpToZeroFltPres
    connect DiagMgr.DiagStsRecRmpToZeroFltPres -> Ap_HaLFTO.DiagStsRecRmpToZeroFltPres
    connect DiagMgr.DiagStsRecRmpToZeroFltPres -> Ap_PAwTO.DiagStsRecRmpToZeroFltPres
    connect DiagMgr.DiagStsRecRmpToZeroFltPres -> Ap_StbCTO.DiagStsRecRmpToZeroFltPres
    connect DiagMgr.DiagStsRecRmpToZeroFltPres -> SrlComOutput.DiagStsRecRmpToZeroFltPres
    connect DiagMgr.DiagStsWIRDisable -> Ap_WhlImbRej.DiagStsWIRDisable
    connect DiagMgr.NxtrDiagMgr10 -> Ap_AbsHwPosScom.NxtrDiagMgr
    connect DiagMgr.NxtrDiagMgr10 -> Ap_AssistFirewall.NxtrDiagMgr
    connect DiagMgr.NxtrDiagMgr10 -> Ap_DampingFirewall.NxtrDiagMgr
    connect DiagMgr.NxtrDiagMgr10 -> Ap_HaLFTO.NxtrDiagMgr
    connect DiagMgr.NxtrDiagMgr10 -> Ap_PAwTO.NxtrDiagMgr
    connect DiagMgr.NxtrDiagMgr10 -> Ap_PwrLmtFuncCr.NxtrDiagMgr
    connect DiagMgr.NxtrDiagMgr10 -> Ap_ReturnFirewall.NxtrDiagMgr
    connect DiagMgr.NxtrDiagMgr10 -> Ap_StbCTO.NxtrDiagMgr
    connect DiagMgr.NxtrDiagMgr10 -> Ap_TqRsDg.NxtrDiagMgr
    connect DiagMgr.NxtrDiagMgr10 -> Ap_WhlImbRej.NxtrDiagMgr
    connect DiagMgr.NxtrDiagMgr10 -> Cd_uDiag.NxtrDiagMgr
    connect DiagMgr.NxtrDiagMgr10 -> CmMtrCurr.NxtrDiagMgr
    connect DiagMgr.NxtrDiagMgr10 -> DigPhsReasDiag.NxtrDiagMgr
    connect DiagMgr.NxtrDiagMgr10 -> HwTrq.NxtrDiagMgr
    connect DiagMgr.NxtrDiagMgr10 -> IoHwAbstractionUsr.NxtrDiagMgr
    connect DiagMgr.NxtrDiagMgr10 -> MtrDrvDiag.NxtrDiagMgr
    connect DiagMgr.NxtrDiagMgr10 -> MtrVel.NxtrDiagMgr
    connect DiagMgr.NxtrDiagMgr10 -> Polarity.NxtrDiagMgr
    connect DiagMgr.NxtrDiagMgr10 -> Sa_MtrPos2.NxtrDiagMgr
    connect DiagMgr.NxtrDiagMgr10 -> Sa_OvrVoltMon.NxtrDiagMgr
    connect DiagMgr.NxtrDiagMgr10 -> StabilityComp.NxtrDiagMgr
    connect DiagMgr.NxtrDiagMgr10 -> StaMd.NxtrDiagMgr
    connect DiagMgr.NxtrDiagMgr10 -> TmprlMon.NxtrDiagMgr
    connect EOTActuatorMng.AssistEOTDamping -> Ap_AstLmt.AssistEOTDamping
    connect EOTActuatorMng.AssistEOTGain -> Ap_LmtCod.AssistEOTGain
    connect EOTActuatorMng.AssistEOTLimit -> Ap_LmtCod.AssistEOTLimit
    connect FrqDepDmpnInrtCmp.FrqDepDmpnInrtCmp -> Ap_DampingFirewall.InertiaComp
    connect HighFreqAssist.HighFreqAssist -> Ap_AssistFirewall.HighFreqAssist
    connect HiLoadStall.AssistStallLimit -> Ap_LmtCod.AssistStallLimit
    connect HwTrq.AnaDiffHwTrq -> Sa_HwTrq2.AnaDiffHwTrq
    connect HwTrq.AnaHwTorque -> Ap_AbsHwPosScom.HwTrq
    connect HwTrq.AnaHwTorque -> Ap_ActivePull.HwTorque
    connect HwTrq.AnaHwTorque -> Ap_AssistFirewall.HwTorque
    connect HwTrq.AnaHwTorque -> Ap_AvgFricLrn.HwTrq
    connect HwTrq.AnaHwTorque -> Ap_DampingFirewall.HwTorque
    connect HwTrq.AnaHwTorque -> Ap_DiagMgr8.HwTrq
    connect HwTrq.AnaHwTorque -> Ap_DiagMgr9.HwTrq
    connect HwTrq.AnaHwTorque -> Ap_Gsod.Ana_Hw_Torque
    connect HwTrq.AnaHwTorque -> Ap_HaLFTO.HwTorque
    connect HwTrq.AnaHwTorque -> Ap_LrnEOT.HwTorque
    connect HwTrq.AnaHwTorque -> Ap_PAwTO.HwTorque
    connect HwTrq.AnaHwTorque -> Ap_StabilityComp2.HwTorque
    connect HwTrq.AnaHwTorque -> Ap_TuningSelAuth.HwTorque
    connect HwTrq.AnaHwTorque -> Ap_WhlImbRej.HwTrq
    connect HwTrq.AnaHwTorque -> Assist.HwTrq
    connect HwTrq.AnaHwTorque -> Damping.HwTorque
    connect HwTrq.AnaHwTorque -> DiagMgr.HwTrq
    connect HwTrq.AnaHwTorque -> EOTActuatorMng.HwTorque
    connect HwTrq.AnaHwTorque -> FrqDepDmpnInrtCmp.HwTorque
    connect HwTrq.AnaHwTorque -> HighFreqAssist.HwTorque
    connect HwTrq.AnaHwTorque -> HystComp.HwTorque
    connect HwTrq.AnaHwTorque -> Return.HwTorque
    connect HwTrq.AnaHwTorque -> Sa_HwTrq2.AnaHwTorque
    connect HwTrq.AnaHwTorque -> SrlComInput.AnaHwTorque
    connect HwTrq.AnaHwTorque -> SrlComInput.StrClmTrq
    connect HwTrq.AnaHwTorque -> SrlComOutput.HwTrq
    connect HwTrq.AnaHwTorque -> StabilityComp.HwTorque
    connect HwTrq.HwTrq_SCom -> NtWrap.C_HwTrq_SCom
    connect HwTrq.HwTrqScaleVal -> Sa_HwTrq2.HwTrqScaleVal
    connect HwTrq.SrlComHwTrqValid -> SrlComOutput.SrlComHwTrqValid
    connect HwTrq.SysCAnaHwTorque -> Ap_Gsod.SysC_Ana_Hw_Torque
    connect HwTrq.T1TrimVal -> Sa_HwTrq2.T1TrimVal
    connect HwTrq.T2TrimVal -> Sa_HwTrq2.T2TrimVal
    connect HystComp.HysteresisComp -> Ap_AssistFirewall.HysteresisComp
    connect IoHwAbsDigSig.EpsEn -> VehPwrMd.EpsEn
    connect IoHwAbsDigSig.FetDrvCntl -> TmprlMon.FetDrvCntl
    connect IoHwAbsDigSig.FetDrvReset -> MtrDrvDiag.FetDrvReset
    connect IoHwAbsDigSig.FetDrvReset -> Sa_ShtdnMech.FetDrvReset
    connect IoHwAbsDigSig.FetFlt1Data -> MtrDrvDiag.FetFlt1Data
    connect IoHwAbsDigSig.FetFlt2Clk -> MtrDrvDiag.FetFlt2Clk
    connect IoHwAbsDigSig.IoHwAbPortConfig -> MtrDrvDiag.IoHwAbPortConfig
    connect IoHwAbsDigSig.OvrVoltFdbk -> Sa_OvrVoltMon.phyOvrVoltFdbk
    connect IoHwAbsDigSig.PwrSwitchEn -> TmprlMon.PwrSwitchEn
    connect IoHwAbsDigSig.SysFault2 -> Sa_ShtdnMech.SysFault2
    connect IoHwAbsDigSig.SysFault2 -> TmprlMon.SysFault2
    connect IoHwAbsDigSig.SysFault3 -> Sa_ShtdnMech.SysFault3
    connect IoHwAbsDigSig.SysFault3 -> TmprlMon.SysFault3
    connect IoHwAbsDigSig.TODReset -> StaMd.TOD
    connect IoHwAbsDigSig.WdMonitor -> Sa_TmprlMon2.WdMonitor
    connect IoHwAbsDigSig.WdMonitor -> TmprlMon.WdMonitor
    connect IoHwAbsDigSig.WdReset -> TmprlMon.WdReset
    connect IoHwAbstractionUsr.Batt -> Ap_BVDiag.Batt
    connect IoHwAbstractionUsr.Batt -> BatteryVoltage.Batt
    connect IoHwAbstractionUsr.Batt -> Sa_BkCpPc.Batt
    connect IoHwAbstractionUsr.BattSwitched -> BatteryVoltage.BattSwitched
    connect IoHwAbstractionUsr.BattSwitched -> Sa_BkCpPc.BattSwitched
    connect IoHwAbstractionUsr.InvCos2Scaled -> Sa_MtrPos3.InvCos2Scaled
    connect IoHwAbstractionUsr.InvSin2Scaled -> Sa_MtrPos3.InvSin2Scaled
    connect IoHwAbstractionUsr.SysCT1ADC -> Sa_HwTrq2.SysCT1ADC
    connect IoHwAbstractionUsr.SysCT2ADC -> Sa_HwTrq2.SysCT2ADC
    connect IoHwAbstractionUsr.SysCVSwitch -> BatteryVoltage.SysCVSwitch
    connect IoHwAbstractionUsr.T1ADC -> HwTrq.T1ADC
    connect IoHwAbstractionUsr.T2ADC -> HwTrq.T2ADC
    connect IoHwAbstractionUsr.TemperatureADC -> CtrlTemp.TemperatureADC
    connect MtrDrvDiag.FETFaultPhase -> CDDInterface.FETFaultPhase
    connect MtrDrvDiag.FETFaultType -> CDDInterface.FETFaultType
    connect MtrDrvDiag.MtrDrvrInitComplete -> Ap_HwPwUp.MtrDrvrInitComplete
    connect MtrPos.CumMtrPosCRF -> Ap_AbsHwPosScom.CRFCumMtrPos
    connect MtrPos.CumMtrPosCRF -> Ap_Gsod.Cum_Mtr_Pos_CRF
    connect MtrPos.CumMtrPosMRF -> QuadDet.MRFCumMtrPos
    connect MtrPos.CumMtrPosMRF -> Sa_MtrVel2.CumMtrPosMRF
    connect MtrPos.MtrPos_SCom -> NtWrap.C_MtrPos_SCom
    connect MtrPos.SysCCumMtrPosCRF -> Ap_Gsod.SysC_Cum_Mtr_Pos_CRF
    connect MtrVel.CRFMotorVel -> Ap_AbsHwPosScom.CRFMtrVel
    connect MtrVel.CRFMotorVel -> Ap_DampingFirewall.MtrVelCRF
    connect MtrVel.CRFMotorVel -> Ap_LrnEOT.MtrVelCRF
    connect MtrVel.CRFMotorVel -> Ap_ThrmlDutyCycle.MotorVelCRF
    connect MtrVel.CRFMotorVel -> CtrldDisShtdn.CRFMtrVel
    connect MtrVel.CRFMotorVel -> Damping.MotorVelCRF
    connect MtrVel.CRFMotorVel -> EOTActuatorMng.MotorVel
    connect MtrVel.CRFMotorVel -> FrqDepDmpnInrtCmp.CRFMotorVel
    connect MtrVel.CRFMotorVel -> HiLoadStall.MtrVelCRF
    connect MtrVel.HandwheelVel -> Ap_ActivePull.HandwheelVelocity
    connect MtrVel.HandwheelVel -> Ap_AvgFricLrn.HwVel
    connect MtrVel.HandwheelVel -> Ap_MtrTempEst.HwVel
    connect MtrVel.HandwheelVel -> Return.HandwheelVel
    connect MtrVel.HandwheelVel -> Sa_MtrVel2.HandWheelVel
    connect MtrVel.MRFMotorVel -> Ap_PICurrCntrl.MRFMtrVel
    connect MtrVel.MRFMotorVel -> Ap_PwrLmtFuncCr.MotorVelMRF
    connect MtrVel.MRFMotorVel -> Ap_TrqCanc.MRFMtrVel
    connect MtrVel.MRFMotorVel -> CDDInterface.MRFMtrVel
    connect MtrVel.MRFMotorVel -> CmMtrCurr.MtrVel
    connect MtrVel.MRFMotorVel -> CurrCmd.MRFMtrVel
    connect MtrVel.MRFMotorVel -> Sa_MtrPos2.MotorVelMRF
    connect MtrVel.MRFMotorVel -> Sa_MtrVel2.MRFMotorVel
    connect MtrVel.MRFMotorVelUnfiltered -> DigPhsReasDiag.MotorVelMRFUnfiltered
    connect MtrVel.MRFMotorVelUnfiltered -> Sa_BkCpPc.MotorVelocityMRFUnfiltered
    connect PeakCurrEst.EstPkCurr -> Ap_MtrTempEst.EstPkCurr
    connect PeakCurrEst.EstPkCurr -> Ap_ThrmlDutyCycle.MtrPkCurr
    connect PeakCurrEst.FiltEstPkCurr -> Ap_ThrmlDutyCycle.FilteredPkCurr
    connect Polarity.AssistAssyPolarity -> CtrldDisShtdn.AssistAssyPolarity
    connect Polarity.AssistAssyPolarity -> MtrPos.AssistAssemblyPolarity
    connect Polarity.AssistAssyPolarity -> MtrVel.AsstAssemPol
    connect Polarity.AssistAssyPolarity -> Polarity.DiagAssistAssyPolarity
    connect Polarity.AssistAssyPolarity -> Sa_MtrVel2.AsstAssemPol
    connect Polarity.HwPosPolarity -> Polarity.DiagHwPosPolarity
    connect Polarity.HwTrqPolarity -> Polarity.DiagHwTrqPolarity
    connect Polarity.MtrElecMechPolarity -> Ap_Gsod.MtrElecMech_Polarity
    connect Polarity.MtrElecMechPolarity -> CDDInterface.MtrElecMechPolarity
    connect Polarity.MtrElecMechPolarity -> DigPhsReasDiag.MtrElecMechPolarity
    connect Polarity.MtrElecMechPolarity -> Polarity.DiagMtrElecMechPolarity
    connect Polarity.MtrPosPolarity -> Polarity.DiagMtrPosPolarity
    connect Polarity.MtrVelPolarity -> Polarity.DiagMtrVelPolarity
    connect Polarity.Polarity_SCom -> NtWrap.C_Polarity_SCom
    connect Polarity.SysC_MtrElecMechPolarity -> Ap_Gsod.SysC_MtrElecMech_Polarity
    connect QuadDet.MtrQuad -> CurrCmd.MtrQuad
    connect Return.ReturnCmd -> Ap_ReturnFirewall.ReturnCmd
    connect Sa_BkCpPc.CapPcDcStub -> Sa_BkCpPc.PhyCapDischarge
    connect Sa_BkCpPc.CapPcDcStub -> Sa_BkCpPc.PhyCapPrecharge
    connect Sa_BkCpPc.PwrDiscATestComplete -> Ap_HwPwUp.PwrDiscATestComplete
    connect Sa_BkCpPc.PwrDiscBTestComplete -> Ap_HwPwUp.PwrDiscBTestComplete
    connect Sa_HwTrq2.SysCHwTorqueSqd -> HwTrq.SysCHwTorqueSqd
    connect Sa_MtrPos2.CorrectedMtrPos -> Ap_Gsod.Corrected_MtrPos
    connect Sa_MtrPos2.CorrectedMtrPos -> DigPhsReasDiag.LRPRCorrectedMtrPosCaptured
    connect Sa_MtrPos2.CorrectedMtrPos -> Sa_MtrPos3.CorrectedMtrPos
    connect Sa_MtrPos2.SysCCorrectedMtrPos -> Ap_Gsod.SysC_Corrected_MtrPos
    connect Sa_MtrVel2.SysCDiagHandWheelVel -> MtrVel.SysCDiagHandWheelVel
    connect Sa_MtrVel2.SysCDiagMtrVelMRF -> MtrVel.SysCDiagMtrVelMRF
    connect SrlComInput.AmbTempAvg -> Ap_MtrTempEst.AmbTemp
    connect SrlComInput.AmbTempAvg -> CtrlTemp.AmbTemp
    connect SrlComInput.CanMsgReceived -> Ap_MtrTempEst.ScomTempDataRcvd
    connect SrlComInput.CanMsgReceived -> SrlComOutput.CanMsgReceived
    connect SrlComInput.CfgStatRQ -> SrlComOutput.CFG_STAT_RQ
    connect SrlComInput.CMDIgnStat -> DemIf.CMDIgnStat
    connect SrlComInput.DesiredTunPers -> Ap_TuningSelAuth.DesiredTunPers
    connect SrlComInput.DesiredTunPers -> SrlComOutput.DesiredTunPers
    connect SrlComInput.DesiredTunPersTypH -> SrlComOutput.DesiredTunPersTypH
    connect SrlComInput.DesiredTunSet -> Ap_TuningSelAuth.DesiredTunSet
    connect SrlComInput.DSTEnableRqst -> Ap_StbCTO.DSTEnableRqst
    connect SrlComInput.DSTEOLDisable -> SrlComOutput.DSTEOLDisable
    connect SrlComInput.DSTErrCntrRecvLevel -> Ap_StbCTO.DSTErrCntrRecvLevel
    connect SrlComInput.DSTExtSystemFltActive -> Ap_StbCTO.DSTExtSystemFltActive
    connect SrlComInput.DSTExtSystemFltActive -> SrlComOutput.DSTExtSystemFltActive
    connect SrlComInput.DSTFuncPresent -> Ap_StbCTO.DSTFuncPresent
    connect SrlComInput.DSTRevGearValid -> Ap_StbCTO.DSTRevGearValid
    connect SrlComInput.DSTTOCState -> Ap_StbCTO.DSTTOCState
    connect SrlComInput.DSTTrqOvCmdRqst -> Ap_ArbLmt.DSTTrqOvCmdRqst
    connect SrlComInput.DSTTrqOvCmdRqst -> Ap_StbCTO.DSTTrqOvCmdRqst
    connect SrlComInput.DSTTrqOvRqstValid -> Ap_StbCTO.DSTTrqOvRqstValid
    connect SrlComInput.EngOilTemp -> Ap_MtrTempEst.EngTemp
    connect SrlComInput.EngRPM -> SrlComOutput.EngRPM
    connect SrlComInput.EngRPM -> VehPwrMd.EngRPM
    connect SrlComInput.EPS_Mode_Req -> SrlComOutput.EPS_MODE_REQ
    connect SrlComInput.EssEngStop -> VehPwrMd.EssEngStop
    connect SrlComInput.FltInjection -> Ap_AvgFricLrn.FltInjection_SCom
    connect SrlComInput.FltInjection -> Ap_LmtCod.FltInjection_SCom
    connect SrlComInput.FltInjection -> Ap_SignlCondn.FaultInjection_SCom
    connect SrlComInput.FltInjection -> Assist.FltInjection_SCom
    connect SrlComInput.FltInjection -> BatteryVoltage.FltInjection_SCom
    connect SrlComInput.FltInjection -> Damping.FltInjection_SCom
    connect SrlComInput.FltInjection -> FrqDepDmpnInrtCmp.FltInjection_SCom
    connect SrlComInput.FltInjection -> HystComp.FltInjection_SCom
    connect SrlComInput.FltInjection -> Return.FltInjection_SCom
    connect SrlComInput.FltInjection -> StabilityComp.FaultInjection_SCom
    connect SrlComInput.HaLFEnableRqst -> Ap_HaLFTO.HaLFEnableRqst
    connect SrlComInput.HaLFErrInterfaceActive -> Ap_HaLFTO.HaLFErrInterfaceActive
    connect SrlComInput.HaLFExtSystemFltActive -> Ap_HaLFTO.HaLFExtSystemFltActive
    connect SrlComInput.HaLFFuncPresent -> Ap_HaLFTO.HaLFFuncPresent
    connect SrlComInput.HaLFIntSystemFltActive -> Ap_HaLFTO.HaLFIntSystemFltActive
    connect SrlComInput.HaLFState_SCom -> Ap_HaLFTO.HaLFState_SCom
    connect SrlComInput.HaLFSWATrqFail -> Ap_HaLFTO.HaLFSWATrqFail
    connect SrlComInput.HaLFTrqOvCmdRqst -> Ap_ArbLmt.HaLFTrqOvCmdRqst
    connect SrlComInput.HalfTrqOvRvrsGearEngage -> Ap_HaLFTO.HaLFTrqOvReverseGearEngage
    connect SrlComInput.IWSSCalcVspd -> Ap_PAwTO.IWSSCalcVspd
    connect SrlComInput.NET_CFG_STAT_PT -> DemIf.NET_CFG_STAT_PT
    connect SrlComInput.PAEnableRqst -> Ap_PAwTO.PAEnableRqst
    connect SrlComInput.PAErrInterfaceActive -> Ap_PAwTO.PAErrInterfaceActive
    connect SrlComInput.PAExtSystemFltActive -> Ap_PAwTO.PAExtSystemFltActive
    connect SrlComInput.PAIntSystemFltActive -> Ap_PAwTO.PAIntSystemFltActive
    connect SrlComInput.PAManoeuvrePhase -> Ap_PAwTO.PAManoeuvrePhase
    connect SrlComInput.PATrqOvCmdRqst -> Ap_ArbLmt.PATrqOvCmdRqst
    connect SrlComInput.PATrqOvCmdRqst -> Ap_PAwTO.PATrqOvCmdRqst
    connect SrlComInput.PAWheelCriteriaMet -> Ap_PAwTO.PAWheelCriteriaMet
    connect SrlComInput.PAWhlDirRLStat -> Ap_PAwTO.PAWhlDirRLStat
    connect SrlComInput.PAWhlDirRRStat -> Ap_PAwTO.PAWhlDirRRStat
    connect SrlComInput.PAWhlPlsCntRLValid -> Ap_PAwTO.PAWhlPlsCntRLValid
    connect SrlComInput.PAWhlPlsCntRRValid -> Ap_PAwTO.PAWhlPlsCntRRValid
    connect SrlComInput.PrevHaLFEnableRqst -> Ap_HaLFTO.PrevHaLFEnableRqst
    connect SrlComInput.PrevHaLFTrqOvCmdRqst -> Ap_HaLFTO.PrevHaLFTrqOvCmdRqst
    connect SrlComInput.PrkAssistState_SCom -> Ap_PAwTO.PrkAssistState_SCom
    connect SrlComInput.PrkAsstFuncPresent -> Ap_PAwTO.PrkAsstFuncPresent
    connect SrlComInput.SpStPrsnt -> SrlComOutput.SpStPrsnt
    connect SrlComInput.SpStPrsnt -> VehPwrMd.SpStPrsnt
    connect SrlComInput.SrlComLWhlSpd -> Ap_WIRInputQual.SrlComLWhlSpd
    connect SrlComInput.SrlComLWhlSpdVld -> Ap_WIRInputQual.SrlComLWhlSpdVld
    connect SrlComInput.SrlComRWhlSpd -> Ap_WIRInputQual.SrlComRWhlSpd
    connect SrlComInput.SrlComRWhlSpdVld -> Ap_WIRInputQual.SrlComRWhlSpdVld
    connect SrlComInput.SrlComVehSpd -> Ap_SignlCondn.SrlComVehSpeed
    connect SrlComInput.SrlComVehSpd -> VehPwrMd.VehSpd
    connect SrlComInput.SrlComVehSpdValid -> Ap_AbsHwPosScom.VehicleSpeedValid
    connect SrlComInput.SrlComVehSpdValid -> Ap_ActivePull.VehicleSpeedValid
    connect SrlComInput.SrlComVehSpdValid -> Ap_AvgFricLrn.VehicleSpeedValid
    connect SrlComInput.SrlComVehSpdValid -> Ap_StbCTO.VehicleSpeedValid
    connect SrlComInput.SrlComVehSpdValid -> Ap_WhlImbRej.VehSpdValid
    connect SrlComInput.SrlComVehSpdValid -> CmMtrCurr.VhSpdValid
    connect SrlComInput.SrlComVehSpdValid -> SrlComOutput.SrlComVehSpdValid
    connect SrlComInput.SrlComVehSpdValid -> VehPwrMd.VehSpdValid
    connect SrlComInput.StrgWhlAngl -> Ap_AbsHwPosScom.SComInpHwA
    connect SrlComInput.StrgWhlAnglValid -> Ap_AbsHwPosScom.SComInpHwAValid
    connect SrlComInput.TrqOvReverseGearEngage -> Ap_PAwTO.TrqOvReverseGearEngage
    connect SrlComInput.TrqOvReverseGearEngage -> Ap_StbCTO.TrqOvReverseGearEngage
    connect SrlComInput.VehAccelX -> Ap_SignlCondn.SrlCom_VehicleLonAccel
    connect StabilityComp.AssistCmd -> Ap_AstLmt.AssistCmd
    connect StabilityComp.AssistCmd -> Damping.AssistCmd
    connect StaMd.MilestoneRqst -> Ap_HwPwUp.MilestoneRqst
    connect StaMd.SystemState -> Ap_ePWM2.SystemState
    connect StaMd.SystemState -> Ap_HaLFTO.SystemState
    connect StaMd.SystemState -> Ap_HwPwUp.SystemState
    connect StaMd.SystemState -> Ap_PAwTO.SystemState
    connect StaMd.SystemState -> Ap_PICurrCntrl.SystemState
    connect StaMd.SystemState -> Ap_PwrLmtFuncCr.SystemState
    connect StaMd.SystemState -> Ap_StbCTO.SystemState
    connect StaMd.SystemState -> Ap_TqRsDg.SystemState
    connect StaMd.SystemState -> Ap_WhlImbRej.SystemState
    connect StaMd.SystemState -> CDDInterface.SystemState
    connect StaMd.SystemState -> CmMtrCurr.SystemState
    connect StaMd.SystemState -> CtrldDisShtdn.SystemState
    connect StaMd.SystemState -> DiagMgr.SystemState
    connect StaMd.SystemState -> DigPhsReasDiag.SystemState
    connect StaMd.SystemState -> FrqDepDmpnInrtCmp.SystemState
    connect StaMd.SystemState -> MtrDrvDiag.SystemState
    connect StaMd.SystemState -> PeakCurrEst.SystemState
    connect StaMd.SystemState -> RteErrata.SystemState
    connect StaMd.SystemState -> Sa_OvrVoltMon.SystemState
    connect StaMd.SystemState -> StaMd.CurrentSystemState
    connect StaMd.SystemState -> TmprlMon.SystemState
    connect StOpCtrl.OutputRampMult -> Ap_LmtCod.OutputRampMult
    connect StOpCtrl.OutputRampMult -> Ap_TqRsDg.OutputRampMult
    connect StOpCtrl.OutputRampMult -> SrlComOutput.OutputRampMult
    connect StOpCtrl.RampDwnStatusComplete -> SrlComOutput.RampDwnStatusComplete
    connect StOpCtrl.RampDwnStatusComplete -> StaMd.RampStatusComplete
    connect TmprlMon.TMFTestComplete -> Ap_HwPwUp.TMFTestComplete
    connect TmprlMon.TMFTestComplete -> StaMd.TMFTestComplete
    connect TrqCmdScl.MRFMtrTrqCmdScl -> CurrCmd.MRFTrqCmdScl
    connect TrqCmdScl.MRFMtrTrqCmdScl -> QuadDet.MRFMtrTrqCmdScl
    connect TrqCmdScl.TrqCmdScl_SCom -> NtWrap.C_TrqCmdScl_SCom
    connect VehPwrMd.ATermActive -> SrlComOutput.ATermActive
    connect VehPwrMd.ATermActive -> StaMd.ATerm
    connect VehPwrMd.CTermActive -> SrlComOutput.CTermActive
    connect VehPwrMd.CTermActive -> StaMd.CTerm
    connect VehPwrMd.OperRampRate -> StOpCtrl.OperRampRate
    connect VehPwrMd.OperRampValue -> StOpCtrl.OperRampValue
    connect VehSpdLmt.AstVehSpdLimit -> Ap_LmtCod.AssistVehSpdLimit
package /VehicleProject
  system EPS: fibex-element=[EPSMod_GlobalA_CE, EPSMod_GlobalA_HS, EPS, PPEI_Steering_Wheel_Angle_CE, Driving_Mode_Control_HS, DTC_Triggered_778, Power_Steering_Information_HS, PPEI_Engine_General_Status_1, PPEI_NonDrivn_Whl_Rotationl_Stat, PPEI_Platform_General_Status, PPEI_Trans_General_Status_2, PPEI_Vehicle_Speed_and_Distance, Wheel_Pulses_HS, Msg1E5_Sig_PPEI_Steering_Wheel_Angle_CE, DTCI_CodeSupported_778_DTC_Triggered_778, DTCI_CurrentStatus_778_DTC_Triggered_778, DTCI_DTCFailType_778_DTC_Triggered_778, DTCI_DTCFaultType_778_DTC_Triggered_778, DTCI_DTCNumber_778_DTC_Triggered_778, DTCI_DTCSource_778_DTC_Triggered_778, DTCI_DTCTriggered_778_DTC_Triggered_778, DTCI_HistStat_778_DTC_Triggered_778, DTCI_TstFldCdClrdStat_778_DTC_Triggered_778, DTCI_TstFldPwrUpSt_778_DTC_Triggered_778, DTCI_TstNPsdCdClrdSt_778_DTC_Triggered_778, DTCI_TstNPsdPwrUpSt_778_DTC_Triggered_778, DTCI_WrnIndRqdSt_778_DTC_Triggered_778, DTCIUnused1_778_DTC_Triggered_778, DTCIUnused2_778_DTC_Triggered_778, DTCIUnused3_778_DTC_Triggered_778, DTCIUnused4_778_DTC_Triggered_778, DTCIUnused5_778_DTC_Triggered_778, DTCIUnused6_778_DTC_Triggered_778, DTCIUnused7_778_DTC_Triggered_778, Msg1F1_Sig_PPEI_Platform_General_Status, Msg1F5_Sig_PPEI_Trans_General_Status_2, Msg232_Sig_Driving_Mode_Control_HS, Msg3E9_Sig_PPEI_Vehicle_Speed_and_Distance, Msg500_Sig_Wheel_Pulses_HS, MsgC5_Sig_PPEI_NonDrivn_Whl_Rotationl_Stat, MsgC9_Sig_PPEI_Engine_General_Status_1, PwrStrIO_Power_Steering_Information_HS, DTCInfo_778_DTC_Triggered_778, PPEI_Steering_Wheel_Angle_CE, Driving_Mode_Control_HS, DTC_Triggered_778, Power_Steering_Information_HS, PPEI_Engine_General_Status_1, PPEI_NonDrivn_Whl_Rotationl_Stat, PPEI_Platform_General_Status, PPEI_Trans_General_Status_2, PPEI_Vehicle_Speed_and_Distance, Wheel_Pulses_HS]
    mapping EPS_MPPNG
      sw-impl-mappings:
        85 x swc to impl mapping:
          D_483629DB_0BD6_4E7A_BF17_C1DE42A8B722_IMPL: component-implementation=Ap_AbsHwPosScom_Implementation, component=ECU_Composition.Ap_AbsHwPosScom
          D_3E95CD4A_62A6_47DD_9710_869943CDA138_IMPL: component-implementation=Ap_ActivePull_Implementation, component=ECU_Composition.Ap_ActivePull
          D_742C0EFD_291B_47AA_B5F8_F9186EE0CF8C_IMPL: component-implementation=Ap_ArbLmt_Implementation, component=ECU_Composition.Ap_ArbLmt
          D_6634710C_21F5_4C70_AFF6_1D4E768E6F0A_IMPL: component-implementation=Ap_AssistFirewall_Implementation, component=ECU_Composition.Ap_AssistFirewall
          D_644E5C24_2583_4682_87D3_3810E69A93D9_IMPL: component-implementation=Ap_AstLmt_Implementation, component=ECU_Composition.Ap_AstLmt
          D_D4BC4E43_FAD1_4648_8222_2C3238E3C16B_IMPL: component-implementation=Ap_AvgFricLrn_Implementation, component=ECU_Composition.Ap_AvgFricLrn
          D_DB995EF9_2955_4C8B_8156_988FEFE7EF55_IMPL: component-implementation=Ap_BVDiag_Implementation, component=ECU_Composition.Ap_BVDiag
          D_E1B0D327_DB2F_4CDB_8940_8A5DC253642D_IMPL: component-implementation=Ap_DampingFirewall_Implementation, component=ECU_Composition.Ap_DampingFirewall
          D_7F951344_8321_4634_AD16_42533A973EA9_IMPL: component-implementation=Ap_DiagMgr8_Implementation, component=ECU_Composition.Ap_DiagMgr8
          D_631C0FA7_569A_42AD_ADCF_160BB16E1C1B_IMPL: component-implementation=Ap_DiagMgr9_Implementation, component=ECU_Composition.Ap_DiagMgr9
          D_558FB49E_3509_49E8_BF3A_1F0576C92745_IMPL: component-implementation=Ap_ElePwr_Implementation, component=ECU_Composition.Ap_ElePwr
          D_7894B1B9_1EE1_4ACC_B3BB_C5F3717EC1CA_IMPL: component-implementation=Ap_ePWM2_Implementation, component=ECU_Composition.Ap_ePWM2
          D_41A2E3BD_AE93_4ED3_842D_ABD14511432C_IMPL: component-implementation=Ap_Gsod_Implementation, component=ECU_Composition.Ap_Gsod
          D_D3F2A924_E12F_4BA2_B6DA_652B8A70C056_IMPL: component-implementation=Ap_HaLFTO_Implementation, component=ECU_Composition.Ap_HaLFTO
          D_01E74F73_85D8_45E3_8BFD_CDE9E52E91B0_IMPL: component-implementation=Ap_HwPwUp_Implementation, component=ECU_Composition.Ap_HwPwUp
          D_0B5AE6E0_0EED_41F0_9ADC_1DA2981A50A0_IMPL: component-implementation=Ap_LmtCod_Implementation, component=ECU_Composition.Ap_LmtCod
          D_AF5BBD7A_CB7F_454D_9638_5E6806DE9E17_IMPL: component-implementation=Ap_LrnEOT_Implementation, component=ECU_Composition.Ap_LrnEOT
          D_A1ACB4A5_0D47_46B6_8091_95EDB6EA30FA_IMPL: component-implementation=Ap_MtrTempEst_Implementation, component=ECU_Composition.Ap_MtrTempEst
          D_F958CD6A_B062_4F70_8B39_12E5B9496A70_IMPL: component-implementation=Ap_PAwTO_Implementation, component=ECU_Composition.Ap_PAwTO
          D_E5378223_CEC4_4B27_89D7_782F4E1C922E_IMPL: component-implementation=Ap_PICurrCntrl_Implementation, component=ECU_Composition.Ap_PICurrCntrl
          D_7D2B1B9C_9E2A_4310_9F7F_03DE39E2798D_IMPL: component-implementation=Ap_PwrLmtFuncCr_Implementation, component=ECU_Composition.Ap_PwrLmtFuncCr
          D_661FE4E2_2F3D_4AE2_A9E5_7A00B4187001_IMPL: component-implementation=Ap_ReturnFirewall_Implementation, component=ECU_Composition.Ap_ReturnFirewall
          D_9A8E8530_2BA1_41A8_BB34_AEA187DBEA98_IMPL: component-implementation=Ap_SignlCondn_Implementation, component=ECU_Composition.Ap_SignlCondn
          D_8B2AD477_BA43_40F0_AE2E_ABBF4BED0C67_IMPL: component-implementation=Ap_StabilityComp2_Implementation, component=ECU_Composition.Ap_StabilityComp2
          D_6B1117FE_7E35_4867_9383_B8AFB2A652B6_IMPL: component-implementation=Ap_StaMd8_Implementation, component=ECU_Composition.Ap_StaMd8
          D_2FFA823B_47D1_4297_9D28_85E0CD4BF3D0_IMPL: component-implementation=Ap_StaMd9_Implementation, component=ECU_Composition.Ap_StaMd9
          D_C1D2C3B1_A17E_4633_90F1_7947F1C46CB6_IMPL: component-implementation=Ap_StbCTO_Implementation, component=ECU_Composition.Ap_StbCTO
          D_002957CE_08FA_480B_B96C_F2FC77CB6736_IMPL: component-implementation=Ap_ThrmlDutyCycle_Implementation, component=ECU_Composition.Ap_ThrmlDutyCycle
          D_B33E0F53_207A_4DBC_ACB5_AEC2D8757A2C_IMPL: component-implementation=Ap_TqRsDg_Implementation, component=ECU_Composition.Ap_TqRsDg
          D_98AF4334_0D24_41A7_8063_A93062BB8829_IMPL: component-implementation=Ap_TrqCanc_Implementation, component=ECU_Composition.Ap_TrqCanc
          D_1013B787_08BF_431B_9D3A_70B9110151DC_IMPL: component-implementation=Ap_TuningSelAuth_Implementation, component=ECU_Composition.Ap_TuningSelAuth
          D_A25DA4C6_247B_4D11_960A_35808A496C19_IMPL: component-implementation=Ap_WhlImbRej_Implementation, component=ECU_Composition.Ap_WhlImbRej
          D_2BF66902_63EE_4823_969C_85071232B83E_IMPL: component-implementation=Ap_WIRInputQual_Implementation, component=ECU_Composition.Ap_WIRInputQual
          D_52F6E7BF_01DE_44F5_A33D_D788FEC04FC9_IMPL: component-implementation=Ap_Assist_Implementation, component=ECU_Composition.Assist
          D_70D04EF2_F95B_42DB_9827_CDD11D7742A9_IMPL: component-implementation=Ap_BatteryVoltage_Implementation, component=ECU_Composition.BatteryVoltage
          D_8F3228AD_B3F2_4D14_B706_A50960BE6541_IMPL: component-implementation=Ccl_Implementation, component=ECU_Composition.Ccl
          D_8A565CB9_E4E9_413D_B153_D4D012E7C10D_IMPL: component-implementation=Cd_uDiag_Implementation, component=ECU_Composition.Cd_uDiag
          D_DCC05E83_778E_4CF4_B0B6_D1057748D08A_IMPL: component-implementation=Sa_CDDInterface_Implementation, component=ECU_Composition.CDDInterface
          D_498D6F26_2048_4C63_9FDF_277673E70114_IMPL: component-implementation=Sa_CmMtrCurr_Implementation, component=ECU_Composition.CmMtrCurr
          D_E8DABC29_256D_459F_B546_396888A1D2AB_IMPL: component-implementation=Ap_CtrldDisShtdn_Implementation, component=ECU_Composition.CtrldDisShtdn
          D_CD101668_CF48_411B_AD19_E8BD97ECAF1A_IMPL: component-implementation=Sa_CtrlTemp_Implementation, component=ECU_Composition.CtrlTemp
          D_121BBF8A_AEAF_4771_80AF_7C76E3957B2A_IMPL: component-implementation=Ap_CurrCmd_Implementation, component=ECU_Composition.CurrCmd
          D_2D733B54_6B35_45A5_9B0A_67BADEA44553_IMPL: component-implementation=Ap_CurrParamComp_Implementation, component=ECU_Composition.CurrParamComp
          D_8B084635_747F_4367_9C6A_B7E54287B285_IMPL: component-implementation=Ap_Damping_Implementation, component=ECU_Composition.Damping
          D_24288A7A_E53C_4291_8BDD_75F07DADCB23_IMPL: component-implementation=Ap_DemIf_Implementation, component=ECU_Composition.DemIf
          D_1A985ED8_1EC2_4E5F_9349_5645D4C81806_IMPL: component-implementation=Ap_DiagMgr10_Implementation, component=ECU_Composition.DiagMgr
          D_2679CE9B_F60F_486C_AF2E_BFBAF27B57AD_IMPL: component-implementation=Ap_DigPhsReasDiag_Implementation, component=ECU_Composition.DigPhsReasDiag
          D_44165ADB_D423_4676_B177_71DB6AAB5306_IMPL: component-implementation=Ap_EOTActuatorMng_Implementation, component=ECU_Composition.EOTActuatorMng
          D_4E1E7887_52FD_4B58_9613_8542811FC3BD_IMPL: component-implementation=Ap_FrqDepDmpnInrtCmp_Implementation, component=ECU_Composition.FrqDepDmpnInrtCmp
          D_9077E48C_CD1B_4DA0_BDFF_8AD145D46760_IMPL: component-implementation=Ap_HighFreqAssist_Implementation, component=ECU_Composition.HighFreqAssist
          D_516DAB28_484F_46E4_96AF_82C276B4DDA1_IMPL: component-implementation=Ap_HiLoadStall_Implementation, component=ECU_Composition.HiLoadStall
          D_8CED7C9E_B99C_4E3A_9240_A6A8734EB6C9_IMPL: component-implementation=Sa_HwTrq_Implementation, component=ECU_Composition.HwTrq
          D_F042F1D7_C1FB_4DE7_8A04_12A0C8631C3B_IMPL: component-implementation=Ap_HystComp_Implementation, component=ECU_Composition.HystComp
          D_C68C2729_6286_4F7D_8FA1_23194338E27B_IMPL: component-implementation=IoHwAbstraction_Implementation, component=ECU_Composition.IoHwAbsDigSig
          D_CACCBE2B_5B27_4735_B69D_16311D846B8E_IMPL: component-implementation=IoHwAbstractionUsr_Implementation, component=ECU_Composition.IoHwAbstractionUsr
          D_53D786AF_2B45_4C87_8307_0CEDC9D05685_IMPL: component-implementation=Sa_MtrDrvDiag_Implementation, component=ECU_Composition.MtrDrvDiag
          D_2BD716ED_135B_4926_A71A_D99D858E5326_IMPL: component-implementation=Sa_MtrPos_Implementation, component=ECU_Composition.MtrPos
          D_80CF6973_39D7_4CB8_A646_942C839AE2AA_IMPL: component-implementation=Sa_MtrVel_Implementation, component=ECU_Composition.MtrVel
          D_A58C28C0_29D7_4D5F_9FE0_8A9CC9ED0E46_IMPL: component-implementation=NtWrap_Implementation, component=ECU_Composition.NtWrap
          D_7DB0D38B_EEDB_45FF_9AFC_7E1FD36A9EFF_IMPL: component-implementation=Ap_PeakCurrEst_Implementation, component=ECU_Composition.PeakCurrEst
          D_0913E3BD_FF43_40B2_B8B3_B2B96D85EDF8_IMPL: component-implementation=Ap_Polarity_Implementation, component=ECU_Composition.Polarity
          D_759D145F_F207_4036_BC92_6D418D2397AF_IMPL: component-implementation=Ap_QuadDet_Implementation, component=ECU_Composition.QuadDet
          D_AA87BD45_4C2D_443C_9E66_90F8EE82A8F6_IMPL: component-implementation=Ap_Return_Implementation, component=ECU_Composition.Return
          D_ED2A1C34_5B76_4507_B361_0BAC98D1614D_IMPL: component-implementation=RteErrata10_Implementation, component=ECU_Composition.RteErrata
          D_E55BDA95_E12C_4A3F_9821_0FBFD279AF78_IMPL: component-implementation=RteErrata8_Implementation, component=ECU_Composition.RteErrata8
          D_26B0915C_1587_47EC_AB72_D033C2723B46_IMPL: component-implementation=RteErrata9_Implementation, component=ECU_Composition.RteErrata9
          D_EAF982A5_57CF_4EDA_84B9_6DEE400FE4D6_IMPL: component-implementation=Sa_BkCpPc_Implementation, component=ECU_Composition.Sa_BkCpPc
          D_76CD035F_B9A9_4331_A9AD_9C253E6A5665_IMPL: component-implementation=Sa_HwTrq2_Implementation, component=ECU_Composition.Sa_HwTrq2
          D_499ACE9F_A125_4117_AED2_9F4D618BF28B_IMPL: component-implementation=Sa_MtrPos2_Implementation, component=ECU_Composition.Sa_MtrPos2
          D_22FDA62F_F79C_42E4_B625_9CC00D6F0DF3_IMPL: component-implementation=Sa_MtrPos3_Implementation, component=ECU_Composition.Sa_MtrPos3
          D_FAFE9271_DA75_40BD_85AD_B375F4A9136B_IMPL: component-implementation=Sa_MtrVel2_Implementation, component=ECU_Composition.Sa_MtrVel2
          D_BAFA98FD_3A52_4286_A1AA_92E3D4A013B5_IMPL: component-implementation=Sa_MtrVel3_Implementation, component=ECU_Composition.Sa_MtrVel3
          D_4FDB644A_F8E7_4E1F_9225_508D7E7A87E6_IMPL: component-implementation=Sa_OvrVoltMon_Implementation, component=ECU_Composition.Sa_OvrVoltMon
          D_8387C399_3142_4147_84F4_DED1C840D5E6_IMPL: component-implementation=Sa_ShtdnMech_Implementation, component=ECU_Composition.Sa_ShtdnMech
          D_7E54EDDF_25BE_40A2_8DEC_BA202FE609DB_IMPL: component-implementation=Sa_TmprlMon2_Implementation, component=ECU_Composition.Sa_TmprlMon2
          D_BDDD80C3_B323_49E8_855B_26D865A7C53E_IMPL: component-implementation=Ap_SrlComInput_Implementation, component=ECU_Composition.SrlComInput
          D_75C846B0_FE50_4E59_AF46_BCE4D1F28767_IMPL: component-implementation=Ap_SrlComOutput_Implementation, component=ECU_Composition.SrlComOutput
          D_5B7B2AB0_C387_4856_8B17_BC48FFC820D3_IMPL: component-implementation=Ap_StabilityComp_Implementation, component=ECU_Composition.StabilityComp
          D_801570C8_2EEE_4066_A34C_F7A2100A1EBC_IMPL: component-implementation=Ap_StaMd_Implementation, component=ECU_Composition.StaMd
          D_BC26EAF6_C4A7_4EEA_B240_DD7903DE40A3_IMPL: component-implementation=Ap_StOpCtrl_Implementation, component=ECU_Composition.StOpCtrl
          D_7A1DEEEB_2444_4FC8_B823_61358B342DAE_IMPL: component-implementation=Sa_TmprlMon_Implementation, component=ECU_Composition.TmprlMon
          D_EC2850D3_9FE3_460B_8D8D_3558DB44DAD9_IMPL: component-implementation=Ap_TrqCmdScl_Implementation, component=ECU_Composition.TrqCmdScl
          D_39AE3C89_6507_42E7_9B21_27B5757E04DD_IMPL: component-implementation=Ap_VehPwrMd_Implementation, component=ECU_Composition.VehPwrMd
          D_87B4DFBD_DC55_456A_823A_3C193B60D5CB_IMPL: component-implementation=Ap_VehSpdLmt_Implementation, component=ECU_Composition.VehSpdLmt
          D_93C005AE_B3CD_4544_972F_3A210C04629D_IMPL: component-implementation=Ap_ApXcp_Implementation, component=ECU_Composition.Xcp
      sw-mappings:
        85 x swc to ecu mapping, all with ecu-instance=EPS:
          D_483629DB_0BD6_4E7A_BF17_C1DE42A8B722_: component=ECU_Composition.Ap_AbsHwPosScom
          D_3E95CD4A_62A6_47DD_9710_869943CDA138_: component=ECU_Composition.Ap_ActivePull
          D_742C0EFD_291B_47AA_B5F8_F9186EE0CF8C_: component=ECU_Composition.Ap_ArbLmt
          D_6634710C_21F5_4C70_AFF6_1D4E768E6F0A_: component=ECU_Composition.Ap_AssistFirewall
          D_644E5C24_2583_4682_87D3_3810E69A93D9_: component=ECU_Composition.Ap_AstLmt
          D_D4BC4E43_FAD1_4648_8222_2C3238E3C16B_: component=ECU_Composition.Ap_AvgFricLrn
          D_DB995EF9_2955_4C8B_8156_988FEFE7EF55_: component=ECU_Composition.Ap_BVDiag
          D_E1B0D327_DB2F_4CDB_8940_8A5DC253642D_: component=ECU_Composition.Ap_DampingFirewall
          D_7F951344_8321_4634_AD16_42533A973EA9_: component=ECU_Composition.Ap_DiagMgr8
          D_631C0FA7_569A_42AD_ADCF_160BB16E1C1B_: component=ECU_Composition.Ap_DiagMgr9
          D_558FB49E_3509_49E8_BF3A_1F0576C92745_: component=ECU_Composition.Ap_ElePwr
          D_7894B1B9_1EE1_4ACC_B3BB_C5F3717EC1CA_: component=ECU_Composition.Ap_ePWM2
          D_41A2E3BD_AE93_4ED3_842D_ABD14511432C_: component=ECU_Composition.Ap_Gsod
          D_D3F2A924_E12F_4BA2_B6DA_652B8A70C056_: component=ECU_Composition.Ap_HaLFTO
          D_01E74F73_85D8_45E3_8BFD_CDE9E52E91B0_: component=ECU_Composition.Ap_HwPwUp
          D_0B5AE6E0_0EED_41F0_9ADC_1DA2981A50A0_: component=ECU_Composition.Ap_LmtCod
          D_AF5BBD7A_CB7F_454D_9638_5E6806DE9E17_: component=ECU_Composition.Ap_LrnEOT
          D_A1ACB4A5_0D47_46B6_8091_95EDB6EA30FA_: component=ECU_Composition.Ap_MtrTempEst
          D_F958CD6A_B062_4F70_8B39_12E5B9496A70_: component=ECU_Composition.Ap_PAwTO
          D_E5378223_CEC4_4B27_89D7_782F4E1C922E_: component=ECU_Composition.Ap_PICurrCntrl
          D_7D2B1B9C_9E2A_4310_9F7F_03DE39E2798D_: component=ECU_Composition.Ap_PwrLmtFuncCr
          D_661FE4E2_2F3D_4AE2_A9E5_7A00B4187001_: component=ECU_Composition.Ap_ReturnFirewall
          D_9A8E8530_2BA1_41A8_BB34_AEA187DBEA98_: component=ECU_Composition.Ap_SignlCondn
          D_8B2AD477_BA43_40F0_AE2E_ABBF4BED0C67_: component=ECU_Composition.Ap_StabilityComp2
          D_6B1117FE_7E35_4867_9383_B8AFB2A652B6_: component=ECU_Composition.Ap_StaMd8
          D_2FFA823B_47D1_4297_9D28_85E0CD4BF3D0_: component=ECU_Composition.Ap_StaMd9
          D_C1D2C3B1_A17E_4633_90F1_7947F1C46CB6_: component=ECU_Composition.Ap_StbCTO
          D_002957CE_08FA_480B_B96C_F2FC77CB6736_: component=ECU_Composition.Ap_ThrmlDutyCycle
          D_B33E0F53_207A_4DBC_ACB5_AEC2D8757A2C_: component=ECU_Composition.Ap_TqRsDg
          D_98AF4334_0D24_41A7_8063_A93062BB8829_: component=ECU_Composition.Ap_TrqCanc
          D_1013B787_08BF_431B_9D3A_70B9110151DC_: component=ECU_Composition.Ap_TuningSelAuth
          D_A25DA4C6_247B_4D11_960A_35808A496C19_: component=ECU_Composition.Ap_WhlImbRej
          D_2BF66902_63EE_4823_969C_85071232B83E_: component=ECU_Composition.Ap_WIRInputQual
          D_52F6E7BF_01DE_44F5_A33D_D788FEC04FC9_: component=ECU_Composition.Assist
          D_70D04EF2_F95B_42DB_9827_CDD11D7742A9_: component=ECU_Composition.BatteryVoltage
          D_8F3228AD_B3F2_4D14_B706_A50960BE6541_: component=ECU_Composition.Ccl
          D_8A565CB9_E4E9_413D_B153_D4D012E7C10D_: component=ECU_Composition.Cd_uDiag
          D_DCC05E83_778E_4CF4_B0B6_D1057748D08A_: component=ECU_Composition.CDDInterface
          D_498D6F26_2048_4C63_9FDF_277673E70114_: component=ECU_Composition.CmMtrCurr
          D_E8DABC29_256D_459F_B546_396888A1D2AB_: component=ECU_Composition.CtrldDisShtdn
          D_CD101668_CF48_411B_AD19_E8BD97ECAF1A_: component=ECU_Composition.CtrlTemp
          D_121BBF8A_AEAF_4771_80AF_7C76E3957B2A_: component=ECU_Composition.CurrCmd
          D_2D733B54_6B35_45A5_9B0A_67BADEA44553_: component=ECU_Composition.CurrParamComp
          D_8B084635_747F_4367_9C6A_B7E54287B285_: component=ECU_Composition.Damping
          D_24288A7A_E53C_4291_8BDD_75F07DADCB23_: component=ECU_Composition.DemIf
          D_1A985ED8_1EC2_4E5F_9349_5645D4C81806_: component=ECU_Composition.DiagMgr
          D_2679CE9B_F60F_486C_AF2E_BFBAF27B57AD_: component=ECU_Composition.DigPhsReasDiag
          D_44165ADB_D423_4676_B177_71DB6AAB5306_: component=ECU_Composition.EOTActuatorMng
          D_4E1E7887_52FD_4B58_9613_8542811FC3BD_: component=ECU_Composition.FrqDepDmpnInrtCmp
          D_9077E48C_CD1B_4DA0_BDFF_8AD145D46760_: component=ECU_Composition.HighFreqAssist
          D_516DAB28_484F_46E4_96AF_82C276B4DDA1_: component=ECU_Composition.HiLoadStall
          D_8CED7C9E_B99C_4E3A_9240_A6A8734EB6C9_: component=ECU_Composition.HwTrq
          D_F042F1D7_C1FB_4DE7_8A04_12A0C8631C3B_: component=ECU_Composition.HystComp
          D_C68C2729_6286_4F7D_8FA1_23194338E27B_: component=ECU_Composition.IoHwAbsDigSig
          D_CACCBE2B_5B27_4735_B69D_16311D846B8E_: component=ECU_Composition.IoHwAbstractionUsr
          D_53D786AF_2B45_4C87_8307_0CEDC9D05685_: component=ECU_Composition.MtrDrvDiag
          D_2BD716ED_135B_4926_A71A_D99D858E5326_: component=ECU_Composition.MtrPos
          D_80CF6973_39D7_4CB8_A646_942C839AE2AA_: component=ECU_Composition.MtrVel
          D_A58C28C0_29D7_4D5F_9FE0_8A9CC9ED0E46_: component=ECU_Composition.NtWrap
          D_7DB0D38B_EEDB_45FF_9AFC_7E1FD36A9EFF_: component=ECU_Composition.PeakCurrEst
          D_0913E3BD_FF43_40B2_B8B3_B2B96D85EDF8_: component=ECU_Composition.Polarity
          D_759D145F_F207_4036_BC92_6D418D2397AF_: component=ECU_Composition.QuadDet
          D_AA87BD45_4C2D_443C_9E66_90F8EE82A8F6_: component=ECU_Composition.Return
          D_ED2A1C34_5B76_4507_B361_0BAC98D1614D_: component=ECU_Composition.RteErrata
          D_E55BDA95_E12C_4A3F_9821_0FBFD279AF78_: component=ECU_Composition.RteErrata8
          D_26B0915C_1587_47EC_AB72_D033C2723B46_: component=ECU_Composition.RteErrata9
          D_EAF982A5_57CF_4EDA_84B9_6DEE400FE4D6_: component=ECU_Composition.Sa_BkCpPc
          D_76CD035F_B9A9_4331_A9AD_9C253E6A5665_: component=ECU_Composition.Sa_HwTrq2
          D_499ACE9F_A125_4117_AED2_9F4D618BF28B_: component=ECU_Composition.Sa_MtrPos2
          D_22FDA62F_F79C_42E4_B625_9CC00D6F0DF3_: component=ECU_Composition.Sa_MtrPos3
          D_FAFE9271_DA75_40BD_85AD_B375F4A9136B_: component=ECU_Composition.Sa_MtrVel2
          D_BAFA98FD_3A52_4286_A1AA_92E3D4A013B5_: component=ECU_Composition.Sa_MtrVel3
          D_4FDB644A_F8E7_4E1F_9225_508D7E7A87E6_: component=ECU_Composition.Sa_OvrVoltMon
          D_8387C399_3142_4147_84F4_DED1C840D5E6_: component=ECU_Composition.Sa_ShtdnMech
          D_7E54EDDF_25BE_40A2_8DEC_BA202FE609DB_: component=ECU_Composition.Sa_TmprlMon2
          D_BDDD80C3_B323_49E8_855B_26D865A7C53E_: component=ECU_Composition.SrlComInput
          D_75C846B0_FE50_4E59_AF46_BCE4D1F28767_: component=ECU_Composition.SrlComOutput
          D_5B7B2AB0_C387_4856_8B17_BC48FFC820D3_: component=ECU_Composition.StabilityComp
          D_801570C8_2EEE_4066_A34C_F7A2100A1EBC_: component=ECU_Composition.StaMd
          D_BC26EAF6_C4A7_4EEA_B240_DD7903DE40A3_: component=ECU_Composition.StOpCtrl
          D_7A1DEEEB_2444_4FC8_B823_61358B342DAE_: component=ECU_Composition.TmprlMon
          D_EC2850D3_9FE3_460B_8D8D_3558DB44DAD9_: component=ECU_Composition.TrqCmdScl
          D_39AE3C89_6507_42E7_9B21_27B5757E04DD_: component=ECU_Composition.VehPwrMd
          D_87B4DFBD_DC55_456A_823A_3C193B60D5CB_: component=ECU_Composition.VehSpdLmt
          D_93C005AE_B3CD_4544_972F_3A210C04629D_: component=ECU_Composition.Xcp
    software composition ECU_Composition: software-composition=ECU_Composition
