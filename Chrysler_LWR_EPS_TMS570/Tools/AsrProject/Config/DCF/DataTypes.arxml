AUTOSAR XML (schema 314)
standard types defined: Boolean, SInt16, SInt32, SInt8, UInt16, UInt32, UInt8, Double, Float
package /DataType
  17 x array type:
    AvgFricLrnRangeCounterSubType
      element AvgFricLrnRangeCounterSubType: type=UInt16, max-number-of-elements=3
    AvgFricLrnRangeCounterType
      element AvgFricLrnRangeCounterType: type=AvgFricLrnRangeCounterSubType, max-number-of-elements=8
    AvgFricLrnThetaSubType
      element AvgFricLrnThetaSubType: type=Float, max-number-of-elements=4
    AvgFricLrnThetaType
      element AvgFricLrnThetaType: type=AvgFricLrnThetaSubType, max-number-of-elements=8
    AvgFricLrnVehLearnedFricType
      element AvgFricLrnVehLearnedFricType: type=Float, max-number-of-elements=4
    CoggingCancTrq
      element CoggingCancTrq: type=UInt16, max-number-of-elements=512
    CoggingCancTrqRplComp
      element CoggingCancTrqRplComp: type=UInt16, max-number-of-elements=9
    CurrTempOffsetTblType
      element CurrTempOffsetTblType: type=SInt16, max-number-of-elements=16
    DT_Array144_s8
      element DT_Array144_s8: type=SInt8, max-number-of-elements=144
    DT_Array2_u16
      element DT_Array2_u16: type=UInt16, max-number-of-elements=2
    DT_Array3_u32
      element DT_Array3_u32: type=UInt32, max-number-of-elements=3
    DT_SinTanLkpTbl_f32
      element DT_SinTanLkpTbl_f32: type=Float, max-number-of-elements=193
    EOLTrqStepType
      element EOLTrqStepType: type=Float, max-number-of-elements=10
    IPMCoggingCancTrq
      element IPMCoggingCancTrq: type=UInt16, max-number-of-elements=512
    NvM_DestPtr  # DataPtr Type to be used by WriteBlock, ReadBlock and RestoreBlockDefaults operations. This type is used for all NVRAM blocks
      element NvM_DestPtr: type=UInt8, max-number-of-elements=65535
    Spi_DataPtr  # DataPtr Type to be used by WriteBlock, ReadBlock and RestoreBlockDefaults operations. This type is used for all NVRAM blocks
      element Spi_DataPtr: type=Spi_DataType, max-number-of-elements=65535
    TypeHRamBufferType
      element TypeHRamBufferType: type=UInt8, max-number-of-elements=100
  12 x boolean type:
    DTCCodeSupported
    DTCCurrentStatus
    DTCHistStat
    DTCTriggered
    DTCTstFldCdClrdStat
    DTCTstFldPwrUpSt
    DTCTstNPsdCdClrdSt
    DTCTstNPsdPwrUpSt
    DTCWrnIndRqdSt
    EngRunAtv
    PwrStrIO
    SysBkupPwrMdEn
  106 x integer type:
    APA_State_enum: compu {0=APA_TempInhibit, 1=APA_AvailCntrl, 2=APA_Active, 3=APA_PermanentlyFailed, 4=APA_ManufacturingDisable}, lower-limit=0, upper-limit=4
    BkupPwrModeMstrVDA: compu {0=VirtualDeviceUnavailable, 1=VirtualDeviceAvailable}, lower-limit=0, upper-limit=1
    CMDIgnStatType: compu {0=IgnLock, 1=IgnOff, 2=IgnAcc, 3=IgnOffAcc, 4=IgnRun, 5=IgnStart, 6=StatNotUsed, 7=SignalNotAvailable}, lower-limit=0, upper-limit=7
    ComM_InhibitionStatusType: lower-limit=0, upper-limit=0
    ComM_ModeType: compu {0=COMM_NO_COMMUNICATION, 1=COMM_SILENT_COMMUNICATION, 2=COMM_FULL_COMMUNICATION}, lower-limit=0, upper-limit=2
    ComM_NetworkHandleType: lower-limit=0, upper-limit=255
    ComM_UserHandleType: lower-limit=0, upper-limit=255
    CrossCheckOpModeType: compu {0=LimitMode, 1=TimedLimitMode, 2=DiagnosticMode}, lower-limit=0, upper-limit=2
    Dem_DTCKindType: compu {1=DEM_DTC_KIND_ALL_DTCS, 2=DEM_DTC_KIND_EMISSION_REL_DTCS}, lower-limit=1, upper-limit=2
    Dem_DTCType: lower-limit=1, upper-limit=16777215
    Dem_EventIdType: lower-limit=0, upper-limit=255
    Dem_EventStatusExtendedType: lower-limit=0, upper-limit=255
    Dem_EventStatusType: compu {0=DEM_EVENT_STATUS_PASSED, 1=DEM_EVENT_STATUS_FAILED, 2=DEM_EVENT_STATUS_PREPASSED, 3=DEM_EVENT_STATUS_PREFAILED}, lower-limit=0, upper-limit=255
    Dem_FaultDetectionCounterType: lower-limit=-128, upper-limit=127
    Dem_IndicatorStatusType: compu {0=DEM_INDICATOR_OFF, 1=DEM_INDICATOR_CONTINUOUS, 2=DEM_INDICATOR_BLINKING, 3=DEM_INDICATOR_BLINK_CONT}, lower-limit=0, upper-limit=3
    Dem_InitMonitorKindType: compu {1=DEM_INIT_MONITOR_CLEAR, 2=DEM_INIT_MONITOR_RESTART, 3=DEM_INIT_MONITOR_END}, lower-limit=1, upper-limit=3
    Dem_OperationCycleIdType: compu {0=DEM_OPCYCLE_DEFAULT, 1=DEM_OPCYCLE_VSM_OPMODE, 2=BUS_ACTIVE}, lower-limit=0, upper-limit=255
    Dem_OperationCycleStateType: compu {1=DEM_CYCLE_STATE_START, 2=DEM_CYCLE_STATE_END}, lower-limit=1, upper-limit=2
    Dem_ReturnGetDTCOfEventType: compu {0=DEM_GET_DTCOFEVENT_OK, 1=DEM_GET_DTCOFEVENT_WRONG_EVENTID, 2=DEM_GET_DTCOFEVENT_WRONG_DTCKIND}, lower-limit=0, upper-limit=2
    DistRollCntAvgDrvnSrc: compu {phys=raw}, lower-limit=0, upper-limit=1
    DrvMdCntrlState: lower-limit=0, upper-limit=255
    DTCFailType: lower-limit=0, upper-limit=255
    DTCFaultType: lower-limit=0, upper-limit=255
    DTCNumber: lower-limit=0, upper-limit=65535
    DTCSource: lower-limit=0, upper-limit=255
    DummyRxSignal: lower-limit=0, upper-limit=1
    EcuM_StateType:
      compu {16=ECUM_STATE_STARTUP, 17=ECUM_STATE_STARTUP_ONE, 18=ECUM_STATE_STARTUP_TWO, 32=ECUM_STATE_WAKEUP, 33=ECUM_STATE_WAKEUP_ONE, 34=ECUM_STATE_WAKEUP_VALIDATION, 35=ECUM_STATE_WAKEUP_REACTION, 36=ECUM_STATE_WAKEUP_TWO, 37=ECUM_STATE_WAKEUP_WAKESLEEP, 38=ECUM_STATE_WAKEUP_TTII, 48=ECUM_STATE_RUN, 50=ECUM_STATE_APP_RUN, 51=ECUM_STATE_APP_POST_RUN, 64=ECUM_STATE_SHUTDOWN, 68=ECUM_STATE_PREP_SHUTDOWN, 73=ECUM_STATE_GO_SLEEP, 77=ECUM_STATE_GO_OFF_ONE, 78=ECUM_STATE_GO_OFF_TWO, 80=ECUM_STATE_SLEEP, 128=ECUM_STATE_OFF, 144=ECUM_STATE_RESET, 255=ECUM_STATE_ERROR}
      lower-limit=16
      upper-limit=255
    EcuM_UserType: lower-limit=0, upper-limit=255
    ElPwDStatStrtStopType: compu {0=Not_Supported, 1=Supported_All, 2=Not_Supported_Imminent, 3=LV_Event_In_Progress, 4=Fault_Limited, 5=Limited_Support, 6..9=Supported_Level_1..Supported_Level_4, 10..15=NotUsed1..NotUsed6}, lower-limit=0, upper-limit=15
    EnergyModeStateType: compu {0=NORMAL, 1=PRODUCTION, 2=TRANSPORTATION, 3=FLASH}, lower-limit=0, upper-limit=3
    ENUM_ResetCause: compu {0=NORMAL_RESET, 4294901760=RAM_ECC_MULTIBIT, 4294836225=DATA_ABORT, 4294770690=PREFETCH_ABORT, 4294705155=UND_INSTR, 4294639620=STACK_OVERWRITE, 4294574085=UNUSED_INTERRUPT, 4294508550=UND_INSTR_TEST, 4294443016=VIM_RAM_PARITY, 4294377481=ADC2_RAM_PARITY, 4294311946=ADC1_RAM_PARITY, 4294246411=NHET1_RAM_PARITY, 4294180876=NHET2_RAM_PARITY}, lower-limit=0, upper-limit=4294967295
    FETFAULTTYPE_ENUM: compu {0=NOFAULT, 1=LOWER, 2=UPPER}, lower-limit=0, upper-limit=255
    FETPHASETYPE_ENUM: compu {0=NOPHASE, 1=PHASEA, 2=PHASEB, 3=PHASEC}, lower-limit=0, upper-limit=255
    FltInjectionLocType:
      compu {1=FLTINJ_ASSIST, 2=FLTINJ_RETURN, 3=FLTINJ_DAMPING, 4=FLTINJ_ASSTSUMNLMT, 7=FLTINJ_AVGFRICLRN, 12=FLTINJ_HYSTCOMP, 14=FLTINJ_INERTIACOMP, 30=FLTINJ_TRQBASEDINRTCOMP, 29=FLTINJ_STABILITYCOMP, 33=FLTINJ_SRLCOMVEHSPD_SGNLCOND, 34=FLTINJ_ASSTFIREWALL, 150=FLTINJ_DDASTFACTRQST_DRVDYNCTRL, 151=FLTINJ_DDDMPFACTRQST_DRVDYNCTRL, 152=FLTINJ_DDRTNFACTRQST_DRVDYNCTRL, 38=FLTINJ_ASSTEOTGAIN_LMTCOD, 153=FLTINJ_OUTPUTRAMPMULT_LMTCOD, 154=FLTINJ_ASSTEOTLIMIT_LMTCOD, 8=FLTINJ_VECU_BATTERYVOLTAGE, 27=FLTINJ_EOTDAMPING_ETDMPFW, 155=FLTINJ_SRLCOMVEHLONACCEL_SGNLCOND, 156=FLTINJ_ANAHWTORQUE, 160=FLTINJ_MTRVEL, 101=FLTINJ_TRQARBLIM_LKACMD, 91=FLTINJ_TRQOVLSTA_LKAFAULT, 200=FLTINJ_PRKASTMFGSERVCH2_PRKASSISTCMD, 201=FLTINJ_PRKASTMFGSERVCH2_LRNPNCNTR}
      lower-limit=0
      upper-limit=255
    Haptic_State_enum: compu {0=Haptic_Inactive, 1=Haptic_Active, 2=Haptic_Waiting}, lower-limit=0, upper-limit=2
    HwTrqStatusType: compu {0=HWTRQSTATUS_NONE, 1=HWTRQSTATUS_ACTIVE, 2=HWTRQSTATUS_FAULT}, lower-limit=0, upper-limit=2
    IoHwAb_BoolType: lower-limit=0, upper-limit=1
    IoHwAb_CurrentType: lower-limit=0, upper-limit=65535
    IoHwAb_DiscreteGroupType: lower-limit=0, upper-limit=255
    IoHwAb_PwxDutyCycleType: lower-limit=0, upper-limit=65535
    IoHwAb_PwxPeriodType: lower-limit=0, upper-limit=65535
    IoHwAb_ResistanceType: lower-limit=0, upper-limit=65535
    IoHwAb_SignalDiagnosisType: lower-limit=0, upper-limit=65535
    IoHwAb_VoltageType: lower-limit=0, upper-limit=65535
    LKA_State_enum: compu {0=LKA_Inactive, 1=LKA_Active, 2=LKA_TemporarilyLimited, 3=LKA_PermanentlyFailed, 4=LKA_ManufacturingDisable}, lower-limit=0, upper-limit=4
    LktoLkStrStateType: compu {0=HOLD, 1=POSANGVEL, 2=POSMTRTRQ, 3=NEGANGVEL, 4=NEGMTRTRQ, 5=MOVETO, 6=DONE, 7=TIMEOUT}, lower-limit=0, upper-limit=7
    ManufModeType: compu {0=ProductionMode, 1=ManufacturingMode, 2=EngineeringMode}, lower-limit=0, upper-limit=2
    MtrCurrOffProcessFlag: compu {0=CURROFF_INIT, 1=CURROFF_PROCESSING, 2=CURROFF_PASS, 3=CURROFF_FAIL}, lower-limit=0, upper-limit=4
    NTCNumber:
      compu {1=NTC_Num_FlashWrapperLgcFlt, 2=NTC_Num_FlashECCCorr, 3=NTC_Num_FlashECCMemFlt, 4=NTC_Num_FlashCRCMemFault, 6=NTC_Num_NvMBlkDftActA, 7=NTC_Num_NvMBlkDftActB, 8=NTC_Num_NvMBlkDftActC, 9=NTC_Num_CurrentSensorCalOutOfRange, 10=NTC_Num_EEPROMDiag, 11=NTC_Num_EEPROMDiagMtrStr, 12=NTC_Num_PriSnsrTrqStorFlt, 13=NTC_Num_EEPROMDiagPosTrimStr, 14=NTC_Num_SecSnsrTrqStorFlt, 15=NTC_Num_EEPROMDiagPolarityStr, 16=NTC_Num_RAMDiag_GeneralFlt, 17=NTC_Num_RAMDiag_WrprLgcFlt, 18=NTC_Num_RAMDiag_ECCCorrIndFlt, 19=NTC_Num_RAMDiag_ECCMemFlt, 20=NTC_Num_RAMDiag_CRCMemFlt, 23=NTC_Num_RAMDiag_VIMRamFlt, 24=NTC_Num_RAMDiag_NHET1RamFlt, 25=NTC_Num_RAMDiag_NHET2RamFlt, 26=NTC_Num_RAMDiag_ADC1RamFlt, 27=NTC_Num_RAMDiag_DCANRamFault, 28=NTC_Num_RAMDiag_ADC2RamFlt, 29=NTC_Num_RAMDiag_HETTU1RamFlt, 30=NTC_Num_RAMDiag_HETTU2RamFlt, 32=NTC_Num_CPU_RegVer, 33=NTC_Num_CPU_CoreInitFlt, 34=NTC_Num_CPU_CoreRunTimeFlt, 35=NTC_Num_CPU_ClockMon, 36=NTC_Num_CPU_eFuseFlt, 37=NTC_Num_CPU_MPUViolation, 40=NTC_Num_CPU_FactPrcsErr, 41=NTC_Num_PropExeDiag_InitDiag, 42=NTC_Num_PrgFlwDeadlnFlt, 43=NTC_Num_PropExeDiag_RunTimeDiag, 44=NTC_Num_PropExeDiag_COPTimeout, 48=NTC_Num_PropExeDiag_PrefetchAbort, 49=NTC_Num_PropExeDiag_DataAbort, 50=NTC_Num_PerDiag_ADC1Flt, 51=NTC_Num_PerDiag_ADC2Flt, 52=NTC_Num_PerDiag_ADCCrossChkFlt, 53=NTC_Num_PerDiag_IllegalAccess, 54=NTC_Num_PerDiag_DMAFlt, 63=NTC_Num_PerDiag_CPUWarning, 64=NTC_Num_TmpMonFunc, 65=NTC_Num_TmpMonRunTimeFlt, 66=NTC_Num_PowerRelayInitFlt, 67=NTC_Num_PrechargeFailure, 68=NTC_Num_PowerRelayRunFlt, 69=NTC_Num_Thermistor, 70=NTC_Num_RefSupplyVltg, 71=NTC_Num_TrcvrInterfaceFlt, 72=NTC_Num_CPUSupplyOvervoltage, 77=NTC_Num_GateDrvFlt, 78=NTC_Num_OnStateSingleFET, 79=NTC_Num_OnStateMultiFET, 80=NTC_Num_PhaseVoltageVerf, 81=NTC_Num_PhaseDscnt, 82=NTC_Num_DigPhaseVoltageVerf, 83=NTC_Num_PhaseDscntFailedDisable, 84=NTC_Num_CurrentMeas1, 85=NTC_Num_CurrentMeas2, 86=NTC_Num_CurrentMeasCrossChk, 87=NTC_Num_PDSupplyOverVoltage, 88=NTC_Num_ChargePumpUnderVoltage, 96=NTC_Num_HwTrqSensor, 97=NTC_Num_AnaVsDigHwTrq, 98=NTC_Num_TrqSensorRecoveryFlt, 100=NTC_Num_TrqSensorScaleInvalid, 101=NTC_Num_T1vsT2, 102=NTC_Num_T1OutofRange, 103=NTC_Num_T2OutofRange, 104=NTC_Num_DigT1vsT2, 105=NTC_Num_DigT1OutofRange, 106=NTC_Num_DigT2OutofRange, 107=NTC_Num_RedT1vsT2, 108=NTC_Num_HWACrossChecks, 109=NTC_Num_HWASnsrCommFault, 110=NTC_Num_HWASensorRel, 111=NTC_Num_HWASensorAbs, 112=NTC_Num_PriMSB_SinCosCorr, 113=NTC_Num_SecMSB_SinCosCorr, 114=NTC_Num_PriVsSec_SinCosCorr, 115=NTC_Num_DigMSBFlt, 116=NTC_Num_MtrVelFlt, 117=NTC_Num_HWAtoMtrAngleCorr, 118=NTC_Num_RedPriVsSec_SinCosCorr, 128=NTC_Num_TurnCntr_PosLoss, 129=NTC_Num_TurnCntr_MicroProcFlt, 130=NTC_Num_TurnCntr_SensorPosFlt, 131=NTC_Num_TurnCntr_SpiComFlt, 132=NTC_Num_TurnCntr_HighQuiescCur, 133=NTC_Num_TurnCntr_MainResets, 134=NTC_Num_TurnCntr_PosLossNotSpdDep, 144=NTC_Num_KinematicIntDiag, 145=NTC_Num_HighFriction, 148=NTC_Num_DutyCycleExceeded, 149=NTC_Num_AbsTempThermLimit, 160=NTC_Num_LatchActive, 168=NTC_Num_OpTrqVsHwTrq, 169=NTC_Num_CurrentReas, 176=NTC_Num_OpVoltage, 177=NTC_Num_ExVoltageLow, 178=NTC_Num_ReducedAsstLowVoltage, 180=NTC_Num_ExVoltageHigh, 181=NTC_Num_OpVoltageOvrMax, 182=NTC_Num_BattTransOverVolt, 184=NTC_Num_IgnConfDiag, 185=NTC_Num_TurnCntr_LowBattery, 191=NTC_Num_EEPROMCloseFailed, 192=NTC_Num_SigPath1CrossChk, 193=NTC_Num_SigPath2CrossChk, 194=NTC_Num_SigPath3CrossChk, 195=NTC_Num_SigPath4CrossChk, 196=NTC_Num_SigPath5CrossChk, 197=NTC_Num_DampingFWReached, 198=NTC_Num_AssistFWReached, 199=NTC_Num_ReturnFWReached, 200=NTC_Num_DampingFWFltMode, 201=NTC_Num_AssistFWFltMode, 202=NTC_Num_VBICFltMode, 203=NTC_Num_StaMdsSysC, 204=NTC_NUM_SysFailureForRotVel, 205=NTC_NUM_SysFailForRedntRotVel, 206=NTC_Num_SysFailureForTrqSnsr, 207=NTC_Num_SysFailureForRedTrqSnsr, 209=NTC_NUM_SysFailureForCtrlVolt, 223=NTC_Num_GlblSgnlOvrwrtDet, 224..255=NTC_Num_VLF_00..NTC_Num_VLF_31, 256=NTC_Num_BusOffCh1, 257=NTC_Num_BusOffCh1NodeMute, 258=NTC_Num_Node1AAbsent, 259=NTC_Num_Node1AFaulty, 260=NTC_Num_Node1BAbsent, 261=NTC_Num_Node1BFaulty, 262=NTC_Num_Node1CAbsent, 263=NTC_Num_Node1CFaulty, 264=NTC_Num_Node1DAbsent, 265=NTC_Num_Node1DFaulty, 266=NTC_Num_Node1EAbsent, 267=NTC_Num_Node1EFaulty, 268=NTC_Num_Node1FAbsent, 269=NTC_Num_Node1FFaulty, 270=NTC_Num_Node1GAbsent, 271=NTC_Num_Node1GFaulty, 272=NTC_Num_BusOffCh2, 273=NTC_Num_Node2AAbsent, 274=NTC_Num_Node2AFaulty, 275=NTC_Num_Node2BAbsent, 276=NTC_Num_Node2BFaulty, 277=NTC_Num_Node2CAbsent, 278=NTC_Num_Node2CFaulty, 279=NTC_Num_Node2DAbsent, 280=NTC_Num_Node2DFaulty, 281=NTC_Num_Node2EAbsent, 282=NTC_Num_Node2EFaulty, 283=NTC_Num_Node2FAbsent, 284=NTC_Num_Node2FFaulty, 285=NTC_Num_Node2GAbsent, 286=NTC_Num_Node2GFaulty, 288=NTC_Num_InvalidMsg_M, 289=NTC_Num_MissingMsg_M, 290=NTC_Num_CRCFltMsg_M, 291=NTC_Num_PgrsCntFltMsg_M, 292=NTC_Num_DataRngFltMsg_M, 293=NTC_Num_DataRateFltMsg_M, 294=NTC_Num_DataOtherFltMsg_M, 295=NTC_Num_DataOther2FltMsg_M, 296=NTC_Num_InvalidMsg_N, 297=NTC_Num_MissingMsg_N, 298=NTC_Num_CRCFltMsg_N, 299=NTC_Num_PgrsCntFltMsg_N, 300=NTC_Num_DataRngFltMsg_N, 301=NTC_Num_DataRateFltMsg_N, 302=NTC_Num_DataOtherFltMsg_N, 303=NTC_Num_DataOtherFlt2Msg_N, 304=NTC_Num_InvalidMsg_O, 305=NTC_Num_MissingMsg_O, 306=NTC_Num_CRCFltMsg_O, 307=NTC_Num_PgrsCntFltMsg_O, 308=NTC_Num_DataRngFltMsg_O, 309=NTC_Num_DataRateFltMsg_O, 310=NTC_Num_DataOtherFltMsg_O, 312=NTC_Num_InvalidMsg_P, 313=NTC_Num_MissingMsg_P, 314=NTC_Num_CRCFltMsg_P, 315=NTC_Num_PgrsCntFltMsg_P, 316=NTC_Num_DataRngFltMsg_P, 317=NTC_Num_DataRateFltMsg_P, 318=NTC_Num_DataOtherFltMsg_P, 320=NTC_Num_InvalidMsg_Q, 321=NTC_Num_MissingMsg_Q, 322=NTC_Num_CRCFltMsg_Q, 323=NTC_Num_PgrsCntFltMsg_Q, 324=NTC_Num_DataRngFltMsg_Q, 325=NTC_Num_DataRateFltMsg_Q, 326=NTC_Num_DataOtherFltMsg_Q, 328=NTC_Num_InvalidMsg_R, 329=NTC_Num_MissingMsg_R, 330=NTC_Num_CRCFltMsg_R, 331=NTC_Num_PgrsCntFltMsg_R, 332=NTC_Num_DataRngFltMsg_R, 333=NTC_Num_DataRateFltMsg_R, 334=NTC_Num_DataOtherFltMsg_R, 335=NTC_Num_DataOtherFlt2Msg_R, 336=NTC_Num_InvalidMsg_S, 337=NTC_Num_MissingMsg_S, 338=NTC_Num_CRCFltMsg_S, 339=NTC_Num_PgrsCntFltMsg_S, 340=NTC_Num_DataRngFltMsg_S, 341=NTC_Num_DataRateFltMsg_S, 342=NTC_Num_DataOtherFltMsg_S, 344=NTC_Num_InvalidMsg_T, 345=NTC_Num_MissingMsg_T, 346=NTC_Num_CRCFltMsg_T, 347=NTC_Num_PgrsCntFltMsg_T, 348=NTC_Num_DataRngFltMsg_T, 349=NTC_Num_DataRateFltMsg_T, 350=NTC_Num_DataOtherFltMsg_T, 352=NTC_Num_InvalidMsg_U, 353=NTC_Num_MissingMsg_U, 354=NTC_Num_CRCFltMsg_U, 355=NTC_Num_PgrsCntFltMsg_U, 356=NTC_Num_DataRngFltMsg_U, 357=NTC_Num_DataRateFltMsg_U, 358=NTC_Num_DataOtherFltMsg_U, 360=NTC_Num_InvalidMsg_V, 361=NTC_Num_MissingMsg_V, 362=NTC_Num_CRCFltMsg_V, 363=NTC_Num_PgrsCntFltMsg_V, 364=NTC_Num_DataRngFltMsg_V, 365=NTC_Num_DataRateFltMsg_V, 366=NTC_Num_DataOtherFltMsg_V, 368=NTC_Num_InvalidMsg_W, 369=NTC_Num_MissingMsg_W, 370=NTC_Num_CRCFltMsg_W, 371=NTC_Num_PgrsCntFltMsg_W, 372=NTC_Num_DataRngFltMsg_W, 373=NTC_Num_DataRateFltMsg_W, 374=NTC_Num_DataOtherFltMsg_W, 376=NTC_Num_InvalidMsg_X, 377=NTC_Num_MissingMsg_X, 378=NTC_Num_CRCFltMsg_X, 379=NTC_Num_PgrsCntFltMsg_X, 380=NTC_Num_DataRngFltMsg_X, 381=NTC_Num_DataRateFltMsg_X, 382=NTC_Num_DataOtherFltMsg_X, 384=NTC_Num_InvalidMsg_Y, 385=NTC_Num_MissingMsg_Y, 386=NTC_Num_CRCFltMsg_Y, 387=NTC_Num_PgrsCntFltMsg_Y, 388=NTC_Num_DataRngFltMsg_Y, 389=NTC_Num_DataRateFltMsg_Y, 390=NTC_Num_DataOtherFltMsg_Y, 392=NTC_Num_InvalidMsg_Z, 393=NTC_Num_MissingMsg_Z, 394=NTC_Num_CRCFltMsg_Z, 395=NTC_Num_PgrsCntFltMsg_Z, 396=NTC_Num_DataRngFltMsg_Z, 397=NTC_Num_DataRateFltMsg_Z, 398=NTC_Num_DataOtherFltMsg_Z, 399=NTC_Num_DSTXORActive, 400=NTC_Num_InvalidMsg_AA, 401=NTC_Num_MissingMsg_AA, 402=NTC_Num_CRCFltMsg_AA, 403=NTC_Num_PgrsCntFltMsg_AA, 404=NTC_Num_DataRngFltMsg_AA, 405=NTC_Num_DataRateFltMsg_AA, 406=NTC_Num_DataOtherFltMsg_AA, 408=NTC_Num_InvalidMsg_AB, 409=NTC_Num_MissingMsg_AB, 410=NTC_Num_CRCFltMsg_AB, 411=NTC_Num_PgrsCntFltMsg_AB, 412=NTC_Num_DataRngFltMsg_AB, 413=NTC_Num_DataRateFltMsg_AB, 414=NTC_Num_DataOtherFltMsg_AB, 416=NTC_Num_InvalidMsg_AC, 417=NTC_Num_MissingMsg_AC, 418=NTC_Num_CRCFltMsg_AC, 419=NTC_Num_PgrsCntFltMsg_AC, 420=NTC_Num_DataRngFltMsg_AC, 421=NTC_Num_DataRateFltMsg_AC, 422=NTC_Num_DataOtherFltMsg_AC, 424=NTC_Num_InvalidMsg_AD, 425=NTC_Num_MissingMsg_AD, 426=NTC_Num_CRCFltMsg_AD, 427=NTC_Num_PgrsCntFltMsg_AD, 428=NTC_Num_DataRngFltMsg_AD, 429=NTC_Num_DataRateFltMsg_AD, 430=NTC_Num_DataOtherFltMsg_AD, 432=NTC_Num_InvalidMsg_AE, 433=NTC_Num_MissingMsg_AE, 434=NTC_Num_CRCFltMsg_AE, 435=NTC_Num_PgrsCntFltMsg_AE, 436=NTC_Num_DataRngFltMsg_AE, 437=NTC_Num_DataRateFltMsg_AE, 438=NTC_Num_DataOtherFltMsg_AE, 440=NTC_Num_InvalidMsg_AF, 441=NTC_Num_MissingMsg_AF, 442=NTC_Num_CRCFltMsg_AF, 443=NTC_Num_PgrsCntFltMsg_AF, 444=NTC_Num_DataRngFltMsg_AF, 445=NTC_Num_DataRateFltMsg_AF, 446=NTC_Num_DataOtherFltMsg_AF, 448=NTC_Num_InvalidMsg_AG, 449=NTC_Num_MissingMsg_AG, 450=NTC_Num_CRCFltMsg_AG, 451=NTC_Num_PgrsCntFltMsg_AG, 452=NTC_Num_DataRngFltMsg_AG, 453=NTC_Num_DataRateFltMsg_AG, 454=NTC_Num_DataOtherFltMsg_AG, 456=NTC_Num_InvalidMsg_AH, 457=NTC_Num_MissingMsg_AH, 458=NTC_Num_CRCFltMsg_AH, 459=NTC_Num_PgrsCntFltMsg_AH, 460=NTC_Num_DataRngFltMsg_AH, 461=NTC_Num_DataRateFltMsg_AH, 462=NTC_Num_DataOtherFltMsg_AH, 464=NTC_Num_InvalidMsg_ESP_A6, 465=NTC_Num_MissingMsg_ESP_A6, 466=NTC_Num_InvalidMsg_Wheel_Speed_2, 467=NTC_Num_MissingMsg_Wheel_Speed_2, 468=NTC_Num_InvalidMsg_GW_LIN_I_C2, 469=NTC_Num_MissingMsg_GW_LIN_I_C2, 470=NTC_Num_InvalidMsg_EcuCfg6, 471=NTC_Num_MissingMsg_EcuCfg6, 472=NTC_Num_InvalidMsg_VehCfg7, 473=NTC_Num_MissingMsg_VehCfg7, 474=NTC_Num_MissingMsg_CFG_RQ, 475=NTC_Num_MissingMsg_CFG_RQ_C, 476=NTC_Num_MissingMsg_ORC_YRS_DATA, 477=NTC_Num_InvalidMsg_ORC_YRS_DATA, 481=NTC_Num_MissingMsg_AK, 489=NTC_Num_MissingMsg_AL, 496=NTC_Num_SysConsistencyVerf, 497=NTC_Num_ConfigMisMatch, 498=NTC_Num_CalNotPrgmd, 499=NTC_Num_TunSetNotPrgmd, 501=NTC_Num_EOLVehTunNtPerf, 502=NTC_Num_MtrSensorNotTrimmed, 504=NTC_Num_HWASensorNotTrimmed, 505=NTC_Num_HWASensorTrimNoAttempt, 506=NTC_Num_TrqSensorScaleNotSet, 507=NTC_Num_TrqSensorNotTrimmed, 509=NTC_Num_DigTrqSensorScaleNotSet, 510=NTC_Num_DigTrqSensorNotTrimmed}
      lower-limit=0
      upper-limit=511
    NvM_BlockIdType: lower-limit=1, upper-limit=32767  # It is the type to be used in the "Port Defined Arguments". According to the NVM API it must result in an uint16 data type; thus the upper limit does not correspond to the number of configured blocks. Therefore the this type is common to all NVM SWC Descriptions. The upper limit is the theoretical maximum number of NVRAM blocks, if NVM_DATASET_SELECTION_BITS equals to 1. (It cannot be 0 since block Id 1 is fixed to be a REDUNDANT NVRAM Block - it consists of two NV blocks)
    NvM_RequestResultType: compu {0=NVM_REQ_OK, 1=NVM_REQ_NOT_OK, 2=NVM_REQ_PENDING, 3=NVM_REQ_INTEGRITY_FAILED, 4=NVM_REQ_BLOCK_SKIPPED, 5=NVM_REQ_NV_INVALIDATED}, lower-limit=0, upper-limit=5
    NvM_ServiceIdType: compu {6=NVM_READ_BLOCK, 7=NVM_WRITE_BLOCK, 8=NVM_RESTORE_BLOCK_DEFAULTS, 9=NVM_ERASE_BLOCK, 11=NVM_INVALIDATE_NV_BLOCK, 12=NVM_READ_ALL}, lower-limit=6, upper-limit=12
    NxtrDiagMgr_NTCStatusType: compu {0=NTC_STATUS_PASSED, 1=NTC_STATUS_FAILED, 2=NTC_STATUS_PREPASSED, 3=NTC_STATUS_PREFAILED}, lower-limit=0, upper-limit=255
    NxtrDiagMgrStatus: compu {0=NTC_STATUS_PASSED, 1=NTC_STATUS_FAILED, 2=NTC_STATUS_PREPASSED, 3=NTC_STATUS_PREFAILED}, lower-limit=0, upper-limit=255
    NxtrOpCycle: compu {0=NxtrDefaultOpCycle}, lower-limit=0, upper-limit=0
    NxtrOpCycleState: compu {1=NXTR_CYCLE_STATE_START, 2=NXTR_CYCLE_STATE_END}, lower-limit=1, upper-limit=2
    OFFS_GRD_MID_EPS: lower-limit=0, upper-limit=4095
    OscTrajCmdStateType: compu {0=CMD_STATE0, 1=CMD_STATE1, 2=CMD_STATE2}, lower-limit=0, upper-limit=2
    PersonalityType: compu {0=PERSONALIZATION_NOTUSED, 1=PERSONALIZATION_COMFORT, 2=PERSONALIZATION_NORMAL, 3=PERSONALIZATION_SPORT}, lower-limit=0, upper-limit=3
    PersonalizationType: compu {0=PERSONALIZATION_NOTUSED, 1=PERSONALIZATION_COMFORT, 2=PERSONALIZATION_NORMAL, 3=PERSONALIZATION_SPORT}, lower-limit=0, upper-limit=3
    PinionCtrStateType: compu {0=HOLD, 1=POSANGVEL, 2=POSMTRTRQ, 3=NEGANGVEL, 4=NEGMTRTRQ, 5=MOVETO, 6=DONE, 7=TIMEOUT}, lower-limit=0, upper-limit=7
    PwPckTqDStatType: compu {0=PwPckOff_TqNotAvailable, 1=PwPckOn_TqNotAvailable, 2=StartInPrgrss_TqNotAvail, 3=PwPckOn_TqAvailable}, lower-limit=0, upper-limit=3
    RoutineStatus: compu {0=RTN_INACTIVE, 1=RTN_ACTIVE, 2=RTN_COMPLETE, 3=RTN_CANCELLED}, lower-limit=0, upper-limit=3
    SInt4: lower-limit=-8, upper-limit=7  # SInt4 represents integers with a minimum value of -8 and a maximum value of 7. The order-relation on SInt4 is: x < y if y - x is positive. SInt4 has a lexical representation consisting of an optional sign followed by a finite-length sequence of decimal digits (#x30-#x39). If the sign is omitted, "+" is assumed. For example: -1, 0, 2, +4.
    Spi_ChannelType: lower-limit=0, upper-limit=255
    Spi_DataType: lower-limit=0, upper-limit=255
    Spi_NumberOfDataType: lower-limit=0, upper-limit=65535
    Spi_SequenceType: lower-limit=0, upper-limit=255
    ST_OFFS_QUAD_EPS: compu {0=STOFFSQUADEPS_SLEEP, 1=STOFFSQUADEPS_CALCULATED, 2=STOFFSQUADEPS_INDEX, 3=STOFFSQUADEPS_MODELCOMP, 4=STOFFSQUADEPS_LOCKTOLOCK, 5=STOFFSQUADEPS_SUMSTEERINGANGLE, 6=STOFFSQUADEPS_CHECK, 7=STOFFSQUADEPS_CORRECTION, 8=STOFFSQUADEPS_INITIALIZATION, 9=STOFFSQUADEPS_DETERMINED, 11=STOFFSQUADEPS_APPROXIMATED, 15=STOFFSQUADEPS_INVALID}, lower-limit=0, upper-limit=15
    StaMd_Users: compu {0=STAMD_STOPCTRL, 1=STAMD_VEHPWRMD, 2=STAMD_DIAGMGR, 3=STAMD_PHSDSCNCT, 4=STAMD_MTRDRVR, 5=STAMD_TMPRLMON, 6=STAMD_HWPWUP, 7=STAMD_MTRPOSDIAG}, lower-limit=0, upper-limit=15
    StOpRamp_User: compu {0=SOR_VEHPWRMD, 1..13=SOR_DIAGMGR0..SOR_DIAGMGR12, 14=SOR_DIAGMGR_F2, 15=SOR_DIAGMGR_F1, 16=SOR_NUMUSERS}, lower-limit=0, upper-limit=16
    StrAngSnsChksm: lower-limit=0, upper-limit=2047
    StrWhAng: compu {phys=raw*0.0625; unit deg}, lower-limit=-32768, upper-limit=32767
    StrWhAngGrd: compu {phys=raw; unit deg/sec}, lower-limit=-2048, upper-limit=2047
    StrWhAngGrdMsk: compu {0=StrWhAngGrd_DontUseData, 1=StrWhAngGrd_UseData}, lower-limit=0, upper-limit=1
    StrWhAngGrdV: compu {0=StrWhAngGrd_Valid, 1=StrWhAngGrd_Invalid}, lower-limit=0, upper-limit=1
    StrWhAngMsk: compu {0=StrWhAng_DontUseData, 1=StrWhAng_UseData}, lower-limit=0, upper-limit=1
    StrWhAngV: compu {0=StrWhAng_Valid, 1=StrWhAng_Invalid}, lower-limit=0, upper-limit=1
    StrWhlAngMsgUnused1: lower-limit=0, upper-limit=3
    StrWhlAngMsgUnused2: lower-limit=0, upper-limit=255
    StrWhlAngMsgUnused3: lower-limit=0, upper-limit=31
    StrWhlAngSenCalStat: compu {0=CalStatus_Unknown, 1=CalStatus_Estimated, 2=CalStatus_Calibrated}, lower-limit=0, upper-limit=3
    StrWhlAngSenTyp: compu {0..3=SenTyp_Type1..SenTyp_Type4}, lower-limit=0, upper-limit=3
    StWhlAngAliveRollCnt: compu {phys=raw}, lower-limit=0, upper-limit=3
    SysPwrMd: compu {0=Off, 1=Accessory, 2=Run, 3=CrankRequest}, lower-limit=0, upper-limit=3
    TOC_STATE: compu {0=TOCSTATE_OFF, 1=TOCSTATE_TNA, 2=TOCSTATE_PNA, 3=TOCSTATE_READY, 4=TOCSTATE_REQUESTDENIED, 5=TOCSTATE_ACTIVEMODE05, 6=TOCSTATE_ACTIVEMODE06, 7=TOCSTATE_ACTIVEMODE07, 8=TOCSTATE_NOTAVAILABLE}, lower-limit=0, upper-limit=255
      invalid-value:
        integer literal TOC_STATE: type=TOC_STATE, value=255
    TrnShftPtrnActStat: lower-limit=0, upper-limit=7
    TrStLgMdAtv: compu {phys=raw}, lower-limit=0, upper-limit=1
    TuningSessionAddrPtrEnum: compu {0=TUN_SESSION_PTR_PERS, 1=TUN_SESSION_PTR_SETS, 2=TUN_SESSION_PTR_COMMON, 255=TUN_SESSION_PTR_DISABLED}, lower-limit=0, upper-limit=255
    TurnsCntrValStateType: compu {0=TCV_COMPUTING, 100=TCV_VALID, 255=TCV_INVALID}, lower-limit=0, upper-limit=255
    UInt4: lower-limit=0, upper-limit=15  # UInt4 represents integers with a minimum value of 0 and a maximum value of 15. The order-relation on UInt4 is: x < y if y - x is positive. UInt4 has a lexical representation consisting of a finite-length sequence of decimal digits (#x30-#x39). For example: 1, 0, 12, +10.
    VehSpdAvgNDrvn: compu {phys=raw/64; unit km / h}, lower-limit=0, upper-limit=32767
    VehSpdAvgNDrvnV: compu {0=VehSpd_Valid, 1=VehSpd_Invalid}, lower-limit=0, upper-limit=1
    WdgM_CheckpointIdType: lower-limit=0, upper-limit=65535
    WdgM_GlobalStatusType: compu {0=WDGM_GLOBAL_STATUS_OK, 1=WDGM_GLOBAL_STATUS_FAILED, 2=WDGM_GLOBAL_STATUS_EXPIRED, 3=WDGM_GLOBAL_STATUS_STOPPED, 4=WDGM_GLOBAL_STATUS_DEACTIVATED}, lower-limit=0, upper-limit=255
    WdgM_LocalStatusType: compu {0=WDGM_LOCAL_STATUS_OK, 1=WDGM_LOCAL_STATUS_FAILED, 2=WDGM_LOCAL_STATUS_EXPIRED, 4=WDGM_LOCAL_STATUS_DEACTIVATED}, lower-limit=0, upper-limit=255
    WdgM_ModeType: lower-limit=0, upper-limit=255
    WdgM_SupervisedEntityIdType: lower-limit=0, upper-limit=65535
    WhlPlsPerRevNonDrvn: lower-limit=0, upper-limit=127
    WhlRotStatTmstmpRes: compu {phys=raw*0.002 for raw 0..2048; unit uSec}, lower-limit=0, upper-limit=2048
    WRSSeqNum: compu {phys=raw; unit counts}, lower-limit=0, upper-limit=3
    WRSWhlDistPCntr: compu {phys=raw; unit counts}, lower-limit=0, upper-limit=1023
    WRSWhlDisTpRC: compu {phys=raw; unit counts}, lower-limit=0, upper-limit=3
    WRSWhlDistTstm: compu {phys=raw; unit counts}, lower-limit=0, upper-limit=65535
    WRSWhlDistVal: compu {phys=raw}, lower-limit=0, upper-limit=1
    WRSWhlRotStatRst: compu {phys=raw}, lower-limit=0, upper-limit=1
  31 x record type:
    AvgFricLrnType
      8 x record element:
        FricOffset_HwNm_f32: type=Float
        EOLFric_HwNm_f32: type=Float
        EnableFricOffsetOutput_Cnt_lgc: type=Boolean
        EnableFricLearning_Cnt_lgc: type=Boolean
        OpMode_Cnt_enum: type=UInt8
        RangeCounter_Cnt_u16: type=AvgFricLrnRangeCounterType
        Theta_HwNm_f32: type=AvgFricLrnThetaType
        VehLearnedFric_HwNm_f32: type=AvgFricLrnVehLearnedFricType
    CurrTempOffsetType
      record element CurrTempOffsetX_DegC_s10p5: type=CurrTempOffsetTblType
      record element CurrOffsetY1_Volts_s4p11: type=CurrTempOffsetTblType
      record element CurrOffsetY2_Volts_s4p11: type=CurrTempOffsetTblType
    DiagSettings_Str
      record element Threshold: type=UInt16
      record element PStep: type=UInt16
      record element NStep: type=UInt16
    EOLNomMtrParamType
      record element NomKe_VpRadpS_f32: type=Float
      record element NomRmtr_Ohm_f32: type=Float
    EOTLearned_DataType
      4 x record element:
        CWEOTPosition_HwDeg_f32: type=Float
        CCWEOTPosition_HwDeg_f32: type=Float
        CWEOTFound_Cnt_lgc: type=Boolean
        CCWEOTFound_Cnt_lgc: type=Boolean
    HwTrqScale_Datatype
      record element HwTrqScale_VoltsPerDeg_f32: type=Float
      record element HwTrqScalePerf_Cnt_lgc: type=Boolean
    HwTrqTrim_Datatype
      4 x record element:
        HwTrqTrim_Volts_f32: type=Float
        T1Trim_Volts_f32: type=Float
        T2Trim_Volts_f32: type=Float
        HwTrqTrimPerf_Cnt_lgc: type=Boolean
    MtrParamCal_DataType
      record element EOLNomKe_VpRadpS_f32: type=Float
      record element EOLNomL_Henry_f32: type=Float
      record element EOLNomRmtr_Ohm_f32: type=Float
    MtrParmLearned_DataType
      record element KeFBckTyH_VpRadpS_f32: type=Float
      record element RFBckTyH_Ohm_f32: type=Float
    MtrPosCal_DataType
      14 x record element:
        BEMFCal_Rev_u0p16: type=UInt16
        R_BEMFCal_Rev_u0p16: type=UInt16
        Sin1Offset_Volts_u3p13: type=UInt16
        Sin1AmpRec_Uls_u3p13: type=UInt16
        Cos1Offset_Volts_u3p13: type=UInt16
        Cos1AmpRec_Uls_u3p13: type=UInt16
        SinDelta1_Uls_s2p13: type=SInt16
        CosDelta1Rec_Uls_u3p13: type=UInt16
        Sin1OffCorr_Volts_s2p13: type=SInt16
        Sin1GainCorr_Uls_u1p15: type=UInt16
        Cos1OffCorr_Volts_s2p13: type=SInt16
        Cos1GainCorr_Uls_u1p15: type=UInt16
        SinHarTbl_Cnt_sm6p13: type=DT_Array144_s8
        CosHarTbl_Cnt_sm6p13: type=DT_Array144_s8
    MtrSnsrLearned_DataType
      8 x record element, all with type=Float:
        Cos1MaxTyH_Volts_f32
        Cos1MinTyH_Volts_f32
        Sin1MaxTyH_Volts_f32
        Sin1MinTyH_Volts_f32
        Cos2MaxTyH_Volts_f32
        Cos2MinTyH_Volts_f32
        Sin2MaxTyH_Volts_f32
        Sin2MinTyH_Volts_f32
    OvervoltageDataType
      record element OvervoltageCounter_Cnt_u16: type=UInt16
      record element MaxBattVoltage_Volts_f32: type=Float
    PhaseCurrCal_DataType
      7 x record element, all with type=Float:
        EOLMtrCurrVcalCmd_VoltCnts_f32
        EOLMtrCurr1OffsetLo_Volts_f32
        EOLPhscurr1Gain_AmpspVolt_f32
        EOLPhscurr2Gain_AmpspVolt_f32
        EOLMtrCurr2OffsetLo_Volts_f32
        EOLMtrCurr1OffsetDiff_Volts_f32
        EOLMtrCurr2OffsetDiff_Volts_f32
    Polarity_DataType
      record element Polarity_Cnt_b08: type=UInt8
      record element R_Polarity_Cnt_b08: type=UInt8
    RackCenterType
      record element RackCntrOffset_HwDeg_f32: type=Float
      record element RackCntrComplete_Cnt_lgc: type=Boolean
    RT_Driving_Mode_Control_HS
      record element DrvMdCntrlState: type=DrvMdCntrlState
    RT_DTC_Triggered_778
      13 x record element:
        DTCTriggered: type=DTCTriggered
        DTCSource: type=DTCSource
        DTCNumber: type=DTCNumber
        DTCFailType: type=DTCFailType
        DTCWrnIndRqdSt: type=DTCWrnIndRqdSt
        DTCTstFldPwrUpSt: type=DTCTstFldPwrUpSt
        DTCTstNPsdPwrupSt: type=DTCTstNPsdPwrUpSt
        DTCHistStat: type=DTCHistStat
        DTCTstFldCdClrdStat: type=DTCTstFldCdClrdStat
        DTCTstNPsdCdClrdSt: type=DTCTstNPsdCdClrdSt
        DTCCurrentStatus: type=DTCCurrentStatus
        DTCCodeSupported: type=DTCCodeSupported
        DTCFaulttype: type=DTCFaultType
    RT_Engine_General_Status_1
      record element EngRunAtv: type=EngRunAtv
    RT_Power_Steering_Information_HS
      record element PwrStrIO: type=PwrStrIO
    RT_PPEI_NonDrivn_Whl_Rotationl_Stat
      record element WhlRotStatLft: type=WhlRotStat
      record element WhlRotStatRght: type=WhlRotStat
    RT_PPEI_Platform_General_Status
      4 x record element:
        SysPwrMd: type=SysPwrMd
        SysBkupPwrMdEn: type=SysBkupPwrMdEn
        SysBkUpPwrMd: type=SysPwrMd
        BkupPwrModeMstrVDA: type=BkupPwrModeMstrVDA
    RT_PPEI_Steering_Wheel_Angle_CE
      13 x record element:
        StrAngSnsChksm: type=StrAngSnsChksm
        StrWhAng: type=StrWhAng
        StWhlAngAliveRollCnt: type=StWhlAngAliveRollCnt
        StrWhAngGrd: type=StrWhAngGrd
        StrWhAngGrdMsk: type=StrWhAngGrdMsk
        StrWhAngGrdV: type=StrWhAngGrdV
        StrWhAngMsk: type=StrWhAngMsk
        StrWhlAngSenCalStat: type=StrWhlAngSenCalStat
        StrWhlAngSenTyp: type=StrWhlAngSenTyp
        StrWhAngV: type=StrWhAngV
        StrWhlAngMsgUnused{1..3}: type=StrWhlAngMsgUnused{1..3}
    RT_PPEI_Vheicle_Speed_and_Distance
      record element RT_VehSpdAvgNonDrvnGroup: type=RT_VehSpdAvgNonDrvnGroup
    RT_RampCmd
      record element target_X_f32: type=Float
      record element rate_XpmS_f32: type=Float
    RT_Trans_General_Status_2
      record element TrnShftPtrnActStat: type=TrnShftPtrnActStat
    RT_VehSpdAvgNonDrvnGroup
      record element VehSpdAvgNDrvn: type=VehSpdAvgNDrvn
      record element VehSpdAvgNDrvnV: type=VehSpdAvgNDrvnV
    RT_Wheel_Pulses_HS
      record element WhlRotStatTmstmpRes: type=WhlRotStatTmstmpRes
      record element WhlPlsPerRevNonDrvn: type=WhlPlsPerRevNonDrvn
    ShCurrCal_DataType
      record element EOLShcurrOffset_Volts_f32: type=Float
      record element EOLShcurrGain_AmpspVolt_f32: type=Float
    WhlImbAmp_DataType
      record element PeakLeft_Uls_f32: type=Float
      record element PeakRight_Uls_f32: type=Float
    WhlImbComp_DataType
      record element WIRMaxComp_Pct_f32: type=Float
      record element WIRCmpAct_Cnt_u32: type=DT_Array3_u32
    WhlRotStat
      6 x record element:
        WRSSeqNum: type=WRSSeqNum
        WRSWhlDistPCntr: type=WRSWhlDistPCntr
        WRSWhlDisTpRC: type=WRSWhlDisTpRC
        WRSWhlDistTstm: type=WRSWhlDistTstm
        WRSWhlDistVal: type=WRSWhlDistVal
        WRSWhlRotStatRst: type=WRSWhlRotStatRst
package /DataType/DataTypeUnits
  5 x unit:
    counts: display-name=counts
    deg: display-name=deg
    deg_sec: display-name=deg/sec
    km___h: display-name=km / h
    uSec: display-name=uSec
