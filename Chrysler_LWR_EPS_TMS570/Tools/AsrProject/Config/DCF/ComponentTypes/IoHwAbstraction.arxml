AUTOSAR XML (schema 314)
package /ComponentType
  ecu abstraction component type IoHwAbstraction
    15 x provide port:
      EpsEn: server-com-spec{operation=OP_GET, queue-length=1}, provided-interface=EpsEn
      FetDrvCntl: server-com-spec{operation=OP_GET, queue-length=1}, provided-interface=FetDrvCntl
      FetDrvReset: provided-com-specs=[{operation=OP_GET, queue-length=1}, {operation=OP_SET, queue-length=1}], provided-interface=FetDrvReset
      FetFlt1Data: server-com-spec{operation=OP_GET, queue-length=1}, provided-interface=FetFlt1Data
      FetFlt2Clk: provided-com-specs=[{operation=OP_GET, queue-length=1}, {operation=OP_SET, queue-length=1}], provided-interface=FetFlt2Clk
      IoHwAbPortConfig: server-com-spec{operation=SetFetFlt2ToOutput, queue-length=1}, provided-interface=IoHwAbPortConfig
      OvrVoltFdbk: server-com-spec{operation=OP_GET, queue-length=1}, provided-interface=OvrVoltFdbk
      PwrSwitchEn: server-com-spec{operation=OP_GET, queue-length=1}, provided-interface=PwrSwitchEn
      SysFault2: provided-com-specs=[{operation=OP_GET, queue-length=1}, {operation=OP_SET, queue-length=1}], provided-interface=SysFault2
      SysFault3: provided-com-specs=[{operation=OP_GET, queue-length=1}, {operation=OP_SET, queue-length=1}], provided-interface=SysFault3
      TcCS: server-com-spec{operation=OP_SET, queue-length=1}, provided-interface=TcCS
      TcMCLR: server-com-spec{operation=OP_SET, queue-length=1}, provided-interface=TcMCLR
      TODReset: server-com-spec{operation=OP_SET, queue-length=1}, provided-interface=TODReset
      WdMonitor: server-com-spec{operation=OP_SET, queue-length=1}, provided-interface=WdMonitor
      WdReset: server-com-spec{operation=OP_SET, queue-length=1}, provided-interface=WdReset
  internal behavior IoHwAbstraction_InternalBehavior: component=IoHwAbstraction
    8 x operation invoked event:
      OIT_IoHwAb_GetEpsEn_EpsEn_OP_GET: start-on-event=IoHwAb_GetEpsEn, operation=EpsEn.OP_GET
      OIT_IoHwAb_GetFetDrvCntl_FetDrvCntl_OP_GET: start-on-event=IoHwAb_GetFetDrvCntl, operation=FetDrvCntl.OP_GET
      OIT_IoHwAb_GetFetDrvReset_FetDrvReset_OP_GET: start-on-event=IoHwAb_GetFetDrvReset, operation=FetDrvReset.OP_GET
      OIT_IoHwAb_GetFetFlt1Data_FetFlt1Data_OP_GET: start-on-event=IoHwAb_GetFetFlt1Data, operation=FetFlt1Data.OP_GET
      OIT_IoHwAb_GetFetFlt2Clk_FetFlt2Clk_OP_GET: start-on-event=IoHwAb_GetFetFlt2Clk, operation=FetFlt2Clk.OP_GET
      OIT_IoHwAb_GetOvrVoltFdbk_OvrVoltFdbk_OP_GET: start-on-event=IoHwAb_GetOvrVoltFdbk, operation=OvrVoltFdbk.OP_GET
      OIT_IoHwAb_GetPwrSwitchEn_PwrSwitchEn_OP_GET: start-on-event=IoHwAb_GetPwrSwitchEn, operation=PwrSwitchEn.OP_GET
      OIT_IoHwAb_GetSysFault2_SysFault2_OP_GET: start-on-event=IoHwAb_GetSysFault2, operation=SysFault2.OP_GET
    timing event TMT_IoHwAb_MainFunctionDummy: start-on-event=IoHwAb_MainFunctionDummy, period=0.01
    11 x operation invoked event:
      OIT_IoHwAb_OP_GET_SysFault3_OP_GET: start-on-event=IoHwAb_OP_GET, operation=SysFault3.OP_GET
      OIT_IoHwAb_OP_SET_SysFault3_OP_SET: start-on-event=IoHwAb_OP_SET, operation=SysFault3.OP_SET
      OIT_IoHwAb_SetFetDrvReset_FetDrvReset_OP_SET: start-on-event=IoHwAb_SetFetDrvReset, operation=FetDrvReset.OP_SET
      OIT_IoHwAb_SetFetFlt2Clk_FetFlt2Clk_OP_SET: start-on-event=IoHwAb_SetFetFlt2Clk, operation=FetFlt2Clk.OP_SET
      OIT_IoHwAb_SetFetFlt2ToOutput_IoHwAbPortConfig_SetFetFlt2ToOutput: start-on-event=IoHwAb_SetFetFlt2ToOutput, operation=IoHwAbPortConfig.SetFetFlt2ToOutput
      OIT_IoHwAb_SetSysFault2_SysFault2_OP_SET: start-on-event=IoHwAb_SetSysFault2, operation=SysFault2.OP_SET
      OIT_IoHwAb_SetTcCS_TcCS_OP_SET: start-on-event=IoHwAb_SetTcCS, operation=TcCS.OP_SET
      OIT_IoHwAb_SetTcMCLR_TcMCLR_OP_SET: start-on-event=IoHwAb_SetTcMCLR, operation=TcMCLR.OP_SET
      OIT_IoHwAb_SetTODReset_TODReset_OP_SET: start-on-event=IoHwAb_SetTODReset, operation=TODReset.OP_SET
      OIT_IoHwAb_SetWdMonitor_WdMonitor_OP_SET: start-on-event=IoHwAb_SetWdMonitor, operation=WdMonitor.OP_SET
      OIT_IoHwAb_SetWdReset_WdReset_OP_SET: start-on-event=IoHwAb_SetWdReset, operation=WdReset.OP_SET
    port-api-options:
      enable-take-address=false, indirect-api=false, port=EpsEn
      enable-take-address=false, indirect-api=false, port=FetDrvCntl
      enable-take-address=false, indirect-api=false, port=FetDrvReset
      enable-take-address=false, indirect-api=false, port=FetFlt1Data
      enable-take-address=false, indirect-api=false, port=FetFlt2Clk
      enable-take-address=false, indirect-api=false, port=IoHwAbPortConfig
      enable-take-address=false, indirect-api=false, port=OvrVoltFdbk
      enable-take-address=false, indirect-api=false, port=PwrSwitchEn
      enable-take-address=false, indirect-api=false, port=SysFault2
      enable-take-address=false, indirect-api=false, port=SysFault3
      enable-take-address=false, indirect-api=false, port=TcCS
      enable-take-address=false, indirect-api=false, port=TcMCLR
      enable-take-address=false, indirect-api=false, port=TODReset
      enable-take-address=false, indirect-api=false, port=WdMonitor
      enable-take-address=false, indirect-api=false, port=WdReset
    20 x runnable:
      IoHwAb_GetEpsEn: can-be-invoked-concurrently=true
      IoHwAb_GetFetDrvCntl: can-be-invoked-concurrently=true
      IoHwAb_GetFetDrvReset: can-be-invoked-concurrently=true
      IoHwAb_GetFetFlt1Data: can-be-invoked-concurrently=true
      IoHwAb_GetFetFlt2Clk: can-be-invoked-concurrently=true
      IoHwAb_GetOvrVoltFdbk: can-be-invoked-concurrently=true
      IoHwAb_GetPwrSwitchEn: can-be-invoked-concurrently=true
      IoHwAb_GetSysFault2: can-be-invoked-concurrently=true
      IoHwAb_MainFunctionDummy
      IoHwAb_OP_GET: can-be-invoked-concurrently=true, symbol=IoHwAb_InputOP_GET
      IoHwAb_OP_SET: can-be-invoked-concurrently=true, symbol=IoHwAb_OutputOP_SET
      IoHwAb_SetFetDrvReset: can-be-invoked-concurrently=true
      IoHwAb_SetFetFlt2Clk: can-be-invoked-concurrently=true
      IoHwAb_SetFetFlt2ToOutput: can-be-invoked-concurrently=true, symbol=IoHwAb_OutputSetFetFlt2ToOutput
      IoHwAb_SetSysFault2: can-be-invoked-concurrently=true
      IoHwAb_SetTcCS: can-be-invoked-concurrently=true
      IoHwAb_SetTcMCLR: can-be-invoked-concurrently=true
      IoHwAb_SetTODReset: can-be-invoked-concurrently=true
      IoHwAb_SetWdMonitor: can-be-invoked-concurrently=true
      IoHwAb_SetWdReset: can-be-invoked-concurrently=true
  swc implementation IoHwAbstraction_Implementation: behavior=IoHwAbstraction_InternalBehavior
    code-descriptors:
      code Code: type=SRC
