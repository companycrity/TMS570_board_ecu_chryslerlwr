AUTOSAR XML (schema 314)
package /ComponentType
  internal behavior NvMProxy_InternalBehavior: component=NvMProxy
    14 x operation invoked event, all with start-on-event=GetErrorStatus:
      OIT_GetErrorStatus_PS_NvMP_NvmBlock_AstLmt_SteerAsstDefeat_GetErrorStatus: operation=PS_NvMP_NvmBlock_AstLmt_SteerAsstDefeat.GetErrorStatus
      OIT_GetErrorStatus_PS_NvMP_NvmBlock_CloseCheckData_GetErrorStatus: operation=PS_NvMP_NvmBlock_CloseCheckData.GetErrorStatus
      OIT_GetErrorStatus_PS_NvMP_NvmBlock_CoggingTables_GetErrorStatus: operation=PS_NvMP_NvmBlock_CoggingTables.GetErrorStatus
      OIT_GetErrorStatus_PS_NvMP_NvmBlock_CogtrqRplComp_GetErrorStatus: operation=PS_NvMP_NvmBlock_CogtrqRplComp.GetErrorStatus
      OIT_GetErrorStatus_PS_NvMP_NvmBlock_EOLCtrlPolarity_GetErrorStatus: operation=PS_NvMP_NvmBlock_EOLCtrlPolarity.GetErrorStatus
      OIT_GetErrorStatus_PS_NvMP_NvmBlock_EOLNomMtrParam_GetErrorStatus: operation=PS_NvMP_NvmBlock_EOLNomMtrParam.GetErrorStatus
      OIT_GetErrorStatus_PS_NvMP_NvmBlock_EOLTrqStepData_GetErrorStatus: operation=PS_NvMP_NvmBlock_EOLTrqStepData.GetErrorStatus
      OIT_GetErrorStatus_PS_NvMP_NvmBlock_HwTrqScaleData_GetErrorStatus: operation=PS_NvMP_NvmBlock_HwTrqScaleData.GetErrorStatus
      OIT_GetErrorStatus_PS_NvMP_NvmBlock_HwTrqTrimData_GetErrorStatus: operation=PS_NvMP_NvmBlock_HwTrqTrimData.GetErrorStatus
      OIT_GetErrorStatus_PS_NvMP_NvmBlock_MtrPosSnsr_EOLData_GetErrorStatus: operation=PS_NvMP_NvmBlock_MtrPosSnsr_EOLData.GetErrorStatus
      OIT_GetErrorStatus_PS_NvMP_NvmBlock_OverVoltageData_GetErrorStatus: operation=PS_NvMP_NvmBlock_OverVoltageData.GetErrorStatus
      OIT_GetErrorStatus_PS_NvMP_NvmBlock_ShCurrCal_GetErrorStatus: operation=PS_NvMP_NvmBlock_ShCurrCal.GetErrorStatus
      OIT_GetErrorStatus_PS_NvMP_NvmBlock_TorqueCmdSF_GetErrorStatus: operation=PS_NvMP_NvmBlock_TorqueCmdSF.GetErrorStatus
      OIT_GetErrorStatus_PS_NvMP_NvmBlock_TypeHRamBuffer_GetErrorStatus: operation=PS_NvMP_NvmBlock_TypeHRamBuffer.GetErrorStatus
    timing event TMT_NvMProxy_MainFunction: start-on-event=NvMProxy_MainFunction, period=0.01
    28 x operation invoked event:
      OIT_SetRamBlockStatus_PS_NvMP_NvmBlock_AstLmt_SteerAsstDefeat_SetRamBlockStatus: start-on-event=SetRamBlockStatus, operation=PS_NvMP_NvmBlock_AstLmt_SteerAsstDefeat.SetRamBlockStatus
      OIT_SetRamBlockStatus_PS_NvMP_NvmBlock_CloseCheckData_SetRamBlockStatus: start-on-event=SetRamBlockStatus, operation=PS_NvMP_NvmBlock_CloseCheckData.SetRamBlockStatus
      OIT_SetRamBlockStatus_PS_NvMP_NvmBlock_CoggingTables_SetRamBlockStatus: start-on-event=SetRamBlockStatus, operation=PS_NvMP_NvmBlock_CoggingTables.SetRamBlockStatus
      OIT_SetRamBlockStatus_PS_NvMP_NvmBlock_CogtrqRplComp_SetRamBlockStatus: start-on-event=SetRamBlockStatus, operation=PS_NvMP_NvmBlock_CogtrqRplComp.SetRamBlockStatus
      OIT_SetRamBlockStatus_PS_NvMP_NvmBlock_EOLCtrlPolarity_SetRamBlockStatus: start-on-event=SetRamBlockStatus, operation=PS_NvMP_NvmBlock_EOLCtrlPolarity.SetRamBlockStatus
      OIT_SetRamBlockStatus_PS_NvMP_NvmBlock_EOLNomMtrParam_SetRamBlockStatus: start-on-event=SetRamBlockStatus, operation=PS_NvMP_NvmBlock_EOLNomMtrParam.SetRamBlockStatus
      OIT_SetRamBlockStatus_PS_NvMP_NvmBlock_EOLTrqStepData_SetRamBlockStatus: start-on-event=SetRamBlockStatus, operation=PS_NvMP_NvmBlock_EOLTrqStepData.SetRamBlockStatus
      OIT_SetRamBlockStatus_PS_NvMP_NvmBlock_HwTrqScaleData_SetRamBlockStatus: start-on-event=SetRamBlockStatus, operation=PS_NvMP_NvmBlock_HwTrqScaleData.SetRamBlockStatus
      OIT_SetRamBlockStatus_PS_NvMP_NvmBlock_HwTrqTrimData_SetRamBlockStatus: start-on-event=SetRamBlockStatus, operation=PS_NvMP_NvmBlock_HwTrqTrimData.SetRamBlockStatus
      OIT_SetRamBlockStatus_PS_NvMP_NvmBlock_MtrPosSnsr_EOLData_SetRamBlockStatus: start-on-event=SetRamBlockStatus, operation=PS_NvMP_NvmBlock_MtrPosSnsr_EOLData.SetRamBlockStatus
      OIT_SetRamBlockStatus_PS_NvMP_NvmBlock_OverVoltageData_SetRamBlockStatus: start-on-event=SetRamBlockStatus, operation=PS_NvMP_NvmBlock_OverVoltageData.SetRamBlockStatus
      OIT_SetRamBlockStatus_PS_NvMP_NvmBlock_ShCurrCal_SetRamBlockStatus: start-on-event=SetRamBlockStatus, operation=PS_NvMP_NvmBlock_ShCurrCal.SetRamBlockStatus
      OIT_SetRamBlockStatus_PS_NvMP_NvmBlock_TorqueCmdSF_SetRamBlockStatus: start-on-event=SetRamBlockStatus, operation=PS_NvMP_NvmBlock_TorqueCmdSF.SetRamBlockStatus
      OIT_SetRamBlockStatus_PS_NvMP_NvmBlock_TypeHRamBuffer_SetRamBlockStatus: start-on-event=SetRamBlockStatus, operation=PS_NvMP_NvmBlock_TypeHRamBuffer.SetRamBlockStatus
      OIT_WriteBlock_PS_NvMP_NvmBlock_AstLmt_SteerAsstDefeat_WriteBlock: start-on-event=WriteBlock, operation=PS_NvMP_NvmBlock_AstLmt_SteerAsstDefeat.WriteBlock
      OIT_WriteBlock_PS_NvMP_NvmBlock_CloseCheckData_WriteBlock: start-on-event=WriteBlock, operation=PS_NvMP_NvmBlock_CloseCheckData.WriteBlock
      OIT_WriteBlock_PS_NvMP_NvmBlock_CoggingTables_WriteBlock: start-on-event=WriteBlock, operation=PS_NvMP_NvmBlock_CoggingTables.WriteBlock
      OIT_WriteBlock_PS_NvMP_NvmBlock_CogtrqRplComp_WriteBlock: start-on-event=WriteBlock, operation=PS_NvMP_NvmBlock_CogtrqRplComp.WriteBlock
      OIT_WriteBlock_PS_NvMP_NvmBlock_EOLCtrlPolarity_WriteBlock: start-on-event=WriteBlock, operation=PS_NvMP_NvmBlock_EOLCtrlPolarity.WriteBlock
      OIT_WriteBlock_PS_NvMP_NvmBlock_EOLNomMtrParam_WriteBlock: start-on-event=WriteBlock, operation=PS_NvMP_NvmBlock_EOLNomMtrParam.WriteBlock
      OIT_WriteBlock_PS_NvMP_NvmBlock_EOLTrqStepData_WriteBlock: start-on-event=WriteBlock, operation=PS_NvMP_NvmBlock_EOLTrqStepData.WriteBlock
      OIT_WriteBlock_PS_NvMP_NvmBlock_HwTrqScaleData_WriteBlock: start-on-event=WriteBlock, operation=PS_NvMP_NvmBlock_HwTrqScaleData.WriteBlock
      OIT_WriteBlock_PS_NvMP_NvmBlock_HwTrqTrimData_WriteBlock: start-on-event=WriteBlock, operation=PS_NvMP_NvmBlock_HwTrqTrimData.WriteBlock
      OIT_WriteBlock_PS_NvMP_NvmBlock_MtrPosSnsr_EOLData_WriteBlock: start-on-event=WriteBlock, operation=PS_NvMP_NvmBlock_MtrPosSnsr_EOLData.WriteBlock
      OIT_WriteBlock_PS_NvMP_NvmBlock_OverVoltageData_WriteBlock: start-on-event=WriteBlock, operation=PS_NvMP_NvmBlock_OverVoltageData.WriteBlock
      OIT_WriteBlock_PS_NvMP_NvmBlock_ShCurrCal_WriteBlock: start-on-event=WriteBlock, operation=PS_NvMP_NvmBlock_ShCurrCal.WriteBlock
      OIT_WriteBlock_PS_NvMP_NvmBlock_TorqueCmdSF_WriteBlock: start-on-event=WriteBlock, operation=PS_NvMP_NvmBlock_TorqueCmdSF.WriteBlock
      OIT_WriteBlock_PS_NvMP_NvmBlock_TypeHRamBuffer_WriteBlock: start-on-event=WriteBlock, operation=PS_NvMP_NvmBlock_TypeHRamBuffer.WriteBlock
    port-api-option enable-take-address=false, indirect-api=false, port=PS_NvMP_NvmBlock_AstLmt_SteerAsstDefeat:
      port-arg-values:
        integer literal NvM_ServiceBlockId_14: type=UInt8, value=14
    port-api-option enable-take-address=false, indirect-api=false, port=PS_NvMP_NvmBlock_CloseCheckData:
      port-arg-values:
        integer literal NvM_ServiceBlockId_9: type=UInt8, value=9
    port-api-option enable-take-address=false, indirect-api=false, port=PS_NvMP_NvmBlock_CoggingTables:
      port-arg-values:
        integer literal NvM_ServiceBlockId_11: type=UInt8, value=11
    port-api-option enable-take-address=false, indirect-api=false, port=PS_NvMP_NvmBlock_CogtrqRplComp:
      port-arg-values:
        integer literal NvM_ServiceBlockId_13: type=UInt8, value=13
    port-api-option enable-take-address=false, indirect-api=false, port=PS_NvMP_NvmBlock_EOLCtrlPolarity:
      port-arg-values:
        integer literal NvM_ServiceBlockId_8: type=UInt8, value=8
    port-api-option enable-take-address=false, indirect-api=false, port=PS_NvMP_NvmBlock_EOLNomMtrParam:
      port-arg-values:
        integer literal NvM_ServiceBlockId_6: type=UInt8, value=6
    port-api-option enable-take-address=false, indirect-api=false, port=PS_NvMP_NvmBlock_EOLTrqStepData:
      port-arg-values:
        integer literal NvM_ServiceBlockId_5: type=UInt8, value=5
    port-api-option enable-take-address=false, indirect-api=false, port=PS_NvMP_NvmBlock_HwTrqScaleData:
      port-arg-values:
        integer literal NvM_ServiceBlockId_3: type=UInt8, value=3
    port-api-option enable-take-address=false, indirect-api=false, port=PS_NvMP_NvmBlock_HwTrqTrimData:
      port-arg-values:
        integer literal NvM_ServiceBlockId_4: type=UInt8, value=4
    port-api-option enable-take-address=false, indirect-api=false, port=PS_NvMP_NvmBlock_MtrPosSnsr_EOLData:
      port-arg-values:
        integer literal NvM_ServiceBlockId_1: type=UInt8, value=1
    port-api-option enable-take-address=false, indirect-api=false, port=PS_NvMP_NvmBlock_OverVoltageData:
      port-arg-values:
        integer literal NvM_ServiceBlockId_12: type=UInt8, value=12
    port-api-option enable-take-address=false, indirect-api=false, port=PS_NvMP_NvmBlock_ShCurrCal:
      port-arg-values:
        integer literal NvM_ServiceBlockId_2: type=UInt8, value=2
    port-api-option enable-take-address=false, indirect-api=false, port=PS_NvMP_NvmBlock_TorqueCmdSF:
      port-arg-values:
        integer literal NvM_ServiceBlockId_7: type=UInt8, value=7
    port-api-option enable-take-address=false, indirect-api=false, port=PS_NvMP_NvmBlock_TypeHRamBuffer:
      port-arg-values:
        integer literal NvM_ServiceBlockId_10: type=UInt8, value=10
    4 x runnable:
      GetErrorStatus: can-be-invoked-concurrently=true, symbol=NvMProxy_GetErrorStatus
      NvMProxy_MainFunction: minimum-start-interval=0.01
      SetRamBlockStatus: can-be-invoked-concurrently=true, symbol=NvMProxy_SetRamBlockStatus
      WriteBlock: can-be-invoked-concurrently=true, symbol=NvMProxy_WriteBlock
  service component type NvMProxy: category=ServiceComponent  # Software Component description for NvM ASILD proxy based on generated file from Ecuc Package: ActiveEcuC
    14 x provide port, all with provided-interface=NvM_AC3_SRBS_Srv:
      PS_NvMP_NvmBlock_AstLmt_SteerAsstDefeat  # P-Port Prototype of NvM_AC3_SRBS_Srv for NVRAM Block Rte_NvmBlockProxy_AstLmt_SteerAsstDefeat
        provided-com-specs:
          operation=EraseBlock, queue-length=1
          operation=GetErrorStatus, queue-length=1
          operation=InvalidateNvBlock, queue-length=1
          operation=ReadBlock, queue-length=1
          operation=SetRamBlockStatus, queue-length=1
          operation=WriteBlock, queue-length=1
      PS_NvMP_NvmBlock_CloseCheckData  # P-Port Prototype of NvM_AC3_SRBS_Srv for NVRAM Block Rte_NvmBlockProxy_CloseCheckData
        provided-com-specs:
          operation=EraseBlock, queue-length=1
          operation=GetErrorStatus, queue-length=1
          operation=InvalidateNvBlock, queue-length=1
          operation=ReadBlock, queue-length=1
          operation=SetRamBlockStatus, queue-length=1
          operation=WriteBlock, queue-length=1
      PS_NvMP_NvmBlock_CoggingTables  # P-Port Prototype of NvM_AC3_SRBS_Srv for NVRAM Block Rte_NvmBlockProxy_CoggingTables
        provided-com-specs:
          operation=EraseBlock, queue-length=1
          operation=GetErrorStatus, queue-length=1
          operation=InvalidateNvBlock, queue-length=1
          operation=ReadBlock, queue-length=1
          operation=SetRamBlockStatus, queue-length=1
          operation=WriteBlock, queue-length=1
      PS_NvMP_NvmBlock_CogtrqRplComp  # P-Port Prototype of NvM_AC3_SRBS_Srv for NVRAM Block Rte_NvmBlockProxy_CogtrqRplComp
        provided-com-specs:
          operation=EraseBlock, queue-length=1
          operation=GetErrorStatus, queue-length=1
          operation=InvalidateNvBlock, queue-length=1
          operation=ReadBlock, queue-length=1
          operation=SetRamBlockStatus, queue-length=1
          operation=WriteBlock, queue-length=1
      PS_NvMP_NvmBlock_EOLCtrlPolarity  # P-Port Prototype of NvM_AC3_SRBS_Srv for NVRAM Block Rte_NvmBlockProxy_EOLCtrlPolarity
        provided-com-specs:
          operation=EraseBlock, queue-length=1
          operation=GetErrorStatus, queue-length=1
          operation=InvalidateNvBlock, queue-length=1
          operation=ReadBlock, queue-length=1
          operation=SetRamBlockStatus, queue-length=1
          operation=WriteBlock, queue-length=1
      PS_NvMP_NvmBlock_EOLNomMtrParam  # P-Port Prototype of NvM_AC3_SRBS_Srv for NVRAM Block Rte_NvmBlockProxy_EOLNomMtrParam
        provided-com-specs:
          operation=EraseBlock, queue-length=1
          operation=GetErrorStatus, queue-length=1
          operation=InvalidateNvBlock, queue-length=1
          operation=ReadBlock, queue-length=1
          operation=SetRamBlockStatus, queue-length=1
          operation=WriteBlock, queue-length=1
      PS_NvMP_NvmBlock_EOLTrqStepData  # P-Port Prototype of NvM_AC3_SRBS_Srv for NVRAM Block Rte_NvmBlockProxy_EOLTrqStepData
        provided-com-specs:
          operation=EraseBlock, queue-length=1
          operation=GetErrorStatus, queue-length=1
          operation=InvalidateNvBlock, queue-length=1
          operation=ReadBlock, queue-length=1
          operation=SetRamBlockStatus, queue-length=1
          operation=WriteBlock, queue-length=1
      PS_NvMP_NvmBlock_HwTrqScaleData  # P-Port Prototype of NvM_AC3_SRBS_Srv for NVRAM Block Rte_NvmBlockProxy_HwTrqScaleData
        provided-com-specs:
          operation=EraseBlock, queue-length=1
          operation=GetErrorStatus, queue-length=1
          operation=InvalidateNvBlock, queue-length=1
          operation=ReadBlock, queue-length=1
          operation=SetRamBlockStatus, queue-length=1
          operation=WriteBlock, queue-length=1
      PS_NvMP_NvmBlock_HwTrqTrimData  # P-Port Prototype of NvM_AC3_SRBS_Srv for NVRAM Block Rte_NvmBlockProxy_HwTrqTrimData
        provided-com-specs:
          operation=EraseBlock, queue-length=1
          operation=GetErrorStatus, queue-length=1
          operation=InvalidateNvBlock, queue-length=1
          operation=ReadBlock, queue-length=1
          operation=SetRamBlockStatus, queue-length=1
          operation=WriteBlock, queue-length=1
      PS_NvMP_NvmBlock_MtrPosSnsr_EOLData  # P-Port Prototype of NvM_AC3_SRBS_Srv for NVRAM Block Rte_NvmBlockProxy_MtrPosSnsr_EOLData
        provided-com-specs:
          operation=EraseBlock, queue-length=1
          operation=GetErrorStatus, queue-length=1
          operation=InvalidateNvBlock, queue-length=1
          operation=ReadBlock, queue-length=1
          operation=SetRamBlockStatus, queue-length=1
          operation=WriteBlock, queue-length=1
      PS_NvMP_NvmBlock_OverVoltageData  # P-Port Prototype of NvM_AC3_SRBS_Srv for NVRAM Block Rte_NvmBlockProxy_OverVoltageData
        provided-com-specs:
          operation=EraseBlock, queue-length=1
          operation=GetErrorStatus, queue-length=1
          operation=InvalidateNvBlock, queue-length=1
          operation=ReadBlock, queue-length=1
          operation=SetRamBlockStatus, queue-length=1
          operation=WriteBlock, queue-length=1
      PS_NvMP_NvmBlock_ShCurrCal  # P-Port Prototype of NvM_AC3_SRBS_Srv for NVRAM Block Rte_NvmBlockProxy_ShCurrCal
        provided-com-specs:
          operation=EraseBlock, queue-length=1
          operation=GetErrorStatus, queue-length=1
          operation=InvalidateNvBlock, queue-length=1
          operation=ReadBlock, queue-length=1
          operation=SetRamBlockStatus, queue-length=1
          operation=WriteBlock, queue-length=1
      PS_NvMP_NvmBlock_TorqueCmdSF  # P-Port Prototype of NvM_AC3_SRBS_Srv for NVRAM Block Rte_NvmBlockProxy_TorqueCmdSF
        provided-com-specs:
          operation=EraseBlock, queue-length=1
          operation=GetErrorStatus, queue-length=1
          operation=InvalidateNvBlock, queue-length=1
          operation=ReadBlock, queue-length=1
          operation=SetRamBlockStatus, queue-length=1
          operation=WriteBlock, queue-length=1
      PS_NvMP_NvmBlock_TypeHRamBuffer  # P-Port Prototype of NvM_AC3_SRBS_Srv for NVRAM Block Rte_NvmBlockProxy_TypeHRamBuffer
        provided-com-specs:
          operation=EraseBlock, queue-length=1
          operation=GetErrorStatus, queue-length=1
          operation=InvalidateNvBlock, queue-length=1
          operation=ReadBlock, queue-length=1
          operation=SetRamBlockStatus, queue-length=1
          operation=WriteBlock, queue-length=1
  swc implementation NvMProxy_Implementation: behavior=NvMProxy_InternalBehavior
    code-descriptors:
      code Code: type=SRC
