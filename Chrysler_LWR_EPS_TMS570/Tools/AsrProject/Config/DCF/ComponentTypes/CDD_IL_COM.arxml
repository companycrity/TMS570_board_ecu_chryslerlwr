AUTOSAR XML (schema 314)
package /ComponentType
  complex device driver component type CDD_IL_COM
    10 x require port:
      Driving_Mode_Control_HS_0x232: unqueued-receiver-com-spec{data-element=DummyRxSignal, init-value=Init_DummyRxSignal}, required-interface=DummyRxPort
      Engine_General_Status_1_0xC9: unqueued-receiver-com-spec{data-element=DummyRxSignal, init-value=Init_DummyRxSignal}, required-interface=DummyRxPort
      NonDrivn_Whl_Rotationl_Stat_0xC5: unqueued-receiver-com-spec{data-element=DummyRxSignal, init-value=Init_DummyRxSignal}, required-interface=DummyRxPort
      Platform_General_Status_0x1F1: unqueued-receiver-com-spec{data-element=DummyRxSignal, init-value=Init_DummyRxSignal}, required-interface=DummyRxPort
      Steering_Wheel_Angle_CE_0x1E5: unqueued-receiver-com-spec{data-element=DummyRxSignal, init-value=Init_DummyRxSignal}, required-interface=DummyRxPort
      Trans_General_Status_2_0x1F5: unqueued-receiver-com-spec{data-element=DummyRxSignal, init-value=Init_DummyRxSignal}, required-interface=DummyRxPort
      TX_DTC_Triggered_778: unqueued-receiver-com-spec{data-element=DTC_Triggered_778, init-value=Init_DTC_Triggered_778}, required-interface=Tx_DTC_Triggered_778
      Tx_Power_Steering_Information_HS: unqueued-receiver-com-spec{data-element=Power_Steering_Information_HS, init-value=Init_Power_Steering_Information_HS}, required-interface=Tx_Power_Steering_Information_HS
      Vehicle_Speed_and_Distance_0x3E9: unqueued-receiver-com-spec{data-element=DummyRxSignal, init-value=Init_DummyRxSignal}, required-interface=DummyRxPort
      Wheel_Pulses_HS_0x500: unqueued-receiver-com-spec{data-element=DummyRxSignal, init-value=Init_DummyRxSignal}, required-interface=DummyRxPort
  internal behavior CDD_IL_COM_InternalBehavior: component=CDD_IL_COM
    8 x data received event:
      DRT_Rx_Driving_Mode_Control_HS_Driving_Mode_Control_HS_0x232_DummyRxSignal: start-on-event=Rx_Driving_Mode_Control_HS, data=Driving_Mode_Control_HS_0x232.DummyRxSignal
      DRT_Rx_Engine_General_Status_1_Engine_General_Status_1_0xC9_DummyRxSignal: start-on-event=Rx_Engine_General_Status_1, data=Engine_General_Status_1_0xC9.DummyRxSignal
      DRT_Rx_PPEI_NonDrivn_Whl_Rotationl_Stat_NonDrivn_Whl_Rotationl_Stat_0xC5_DummyRxSignal: start-on-event=Rx_PPEI_NonDrivn_Whl_Rotationl_Stat, data=NonDrivn_Whl_Rotationl_Stat_0xC5.DummyRxSignal
      DRT_Rx_PPEI_Platform_General_Status_Platform_General_Status_0x1F1_DummyRxSignal: start-on-event=Rx_PPEI_Platform_General_Status, data=Platform_General_Status_0x1F1.DummyRxSignal
      DRT_Rx_PPEI_Vehicle_Speed_and_Distance_Vehicle_Speed_and_Distance_0x3E9_DummyRxSignal: start-on-event=Rx_PPEI_Vehicle_Speed_and_Distance, data=Vehicle_Speed_and_Distance_0x3E9.DummyRxSignal
      DRT_Rx_Steering_Wheel_Angle_CE_Steering_Wheel_Angle_CE_0x1E5_DummyRxSignal: start-on-event=Rx_Steering_Wheel_Angle_CE, data=Steering_Wheel_Angle_CE_0x1E5.DummyRxSignal
      DRT_Rx_Trans_General_Status_2_Trans_General_Status_2_0x1F5_DummyRxSignal: start-on-event=Rx_Trans_General_Status_2, data=Trans_General_Status_2_0x1F5.DummyRxSignal
      DRT_Rx_Wheel_Pulses_HS_Wheel_Pulses_HS_0x500_DummyRxSignal: start-on-event=Rx_Wheel_Pulses_HS, data=Wheel_Pulses_HS_0x500.DummyRxSignal
    timing event TMT_Tx_DTC_Triggered_778: start-on-event=Tx_DTC_Triggered_778, period=0.064
    timing event TMT_Tx_Power_Steering_Information_HS: start-on-event=Tx_Power_Steering_Information_HS, period=0.064
    port-api-options:
      enable-take-address=false, indirect-api=false, port=Driving_Mode_Control_HS_0x232
      enable-take-address=false, indirect-api=false, port=Engine_General_Status_1_0xC9
      enable-take-address=false, indirect-api=false, port=NonDrivn_Whl_Rotationl_Stat_0xC5
      enable-take-address=false, indirect-api=false, port=Platform_General_Status_0x1F1
      enable-take-address=false, indirect-api=false, port=Steering_Wheel_Angle_CE_0x1E5
      enable-take-address=false, indirect-api=false, port=Trans_General_Status_2_0x1F5
      enable-take-address=false, indirect-api=false, port=TX_DTC_Triggered_778
      enable-take-address=false, indirect-api=false, port=Tx_Power_Steering_Information_HS
      enable-take-address=false, indirect-api=false, port=Vehicle_Speed_and_Distance_0x3E9
      enable-take-address=false, indirect-api=false, port=Wheel_Pulses_HS_0x500
    10 x runnable:
      Rx_Driving_Mode_Control_HS
      Rx_Engine_General_Status_1
      Rx_PPEI_NonDrivn_Whl_Rotationl_Stat
      Rx_PPEI_Platform_General_Status
      Rx_PPEI_Vehicle_Speed_and_Distance
      Rx_Steering_Wheel_Angle_CE
      Rx_Trans_General_Status_2
      Rx_Wheel_Pulses_HS
      Tx_DTC_Triggered_778
        data read access READ_TX_DTC_Triggered_778_DTC_Triggered_778: data-element=TX_DTC_Triggered_778.DTC_Triggered_778
      Tx_Power_Steering_Information_HS
        data read access READ_Tx_Power_Steering_Information_HS_Power_Steering_Information_HS: data-element=Tx_Power_Steering_Information_HS.Power_Steering_Information_HS
  swc implementation CDD_IL_COM_Implementation: behavior=CDD_IL_COM_InternalBehavior
    code-descriptors:
      code Code: type=SRC
