AUTOSAR XML (schema 314)
package /ComponentType
  complex device driver component type Cd_ResetHandler
    require port NxtrDiagMgr: required-com-specs=[GetNTCFailed, GetNTCStatus, ResetEventStatus, SetNTCStatus, SetOperationCycleState], required-interface=NxtrDiagMgr
  internal behavior Cd_ResetHandler_InternalBehavior: component=Cd_ResetHandler, port-api-option{enable-take-address=false, indirect-api=false, port=NxtrDiagMgr}
    timing event ResetHandler_InitEvent: start-on-event=ResetHandler_Init, period=0
    runnable ResetHandler_Init
      sync call SC_NxtrDiagMgr_SetNTCStatus: operation=NxtrDiagMgr.SetNTCStatus, timeout=0
  swc implementation Cd_ResetHandler_Implementation: behavior=Cd_ResetHandler_InternalBehavior
    code-descriptors:
      code Code: type=SRC
