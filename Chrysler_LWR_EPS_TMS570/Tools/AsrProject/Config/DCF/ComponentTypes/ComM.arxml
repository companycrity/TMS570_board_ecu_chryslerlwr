AUTOSAR XML (schema 314)
package /ComponentType
  internal behavior ComM_InternalBehavior: component=ComM
    timing event TMT_ComM_MainFunction_0: start-on-event=ComM_MainFunction_0, period=0.02
    32 x operation invoked event:
      OIT_GetCurrentComMode_UR_ComMUser_VN_AllNodes_Ch0_1_GetCurrentComMode: start-on-event=GetCurrentComMode, operation=UR_ComMUser_VN_AllNodes_Ch0_1.GetCurrentComMode
      OIT_GetCurrentComMode_UR_ComMUser_VN_AllNodes_Ch1_4_GetCurrentComMode: start-on-event=GetCurrentComMode, operation=UR_ComMUser_VN_AllNodes_Ch1_4.GetCurrentComMode
      OIT_GetCurrentComMode_UR_ComMUser_VN_SLHS_VNReq_Ch0_2_GetCurrentComMode: start-on-event=GetCurrentComMode, operation=UR_ComMUser_VN_SLHS_VNReq_Ch0_2.GetCurrentComMode
      OIT_GetCurrentComMode_UR_ComMUser_VN_SLHS_VNReq_Ch1_5_GetCurrentComMode: start-on-event=GetCurrentComMode, operation=UR_ComMUser_VN_SLHS_VNReq_Ch1_5.GetCurrentComMode
      OIT_GetCurrentComMode_UR_ComMUser_VN_SLHSSharedDiagnostic_Ch0_0_GetCurrentComMode: start-on-event=GetCurrentComMode, operation=UR_ComMUser_VN_SLHSSharedDiagnostic_Ch0_0.GetCurrentComMode
      OIT_GetCurrentComMode_UR_ComMUser_VN_SLHSSharedDiagnostic_Ch1_3_GetCurrentComMode: start-on-event=GetCurrentComMode, operation=UR_ComMUser_VN_SLHSSharedDiagnostic_Ch1_3.GetCurrentComMode
      OIT_GetInhibitionStatus_CL_A_FlexRay_GetInhibitionStatus: start-on-event=GetInhibitionStatus, operation=CL_A_FlexRay.GetInhibitionStatus
      OIT_GetMaxComMode_UR_ComMUser_VN_AllNodes_Ch0_1_GetMaxComMode: start-on-event=GetMaxComMode, operation=UR_ComMUser_VN_AllNodes_Ch0_1.GetMaxComMode
      OIT_GetMaxComMode_UR_ComMUser_VN_AllNodes_Ch1_4_GetMaxComMode: start-on-event=GetMaxComMode, operation=UR_ComMUser_VN_AllNodes_Ch1_4.GetMaxComMode
      OIT_GetMaxComMode_UR_ComMUser_VN_SLHS_VNReq_Ch0_2_GetMaxComMode: start-on-event=GetMaxComMode, operation=UR_ComMUser_VN_SLHS_VNReq_Ch0_2.GetMaxComMode
      OIT_GetMaxComMode_UR_ComMUser_VN_SLHS_VNReq_Ch1_5_GetMaxComMode: start-on-event=GetMaxComMode, operation=UR_ComMUser_VN_SLHS_VNReq_Ch1_5.GetMaxComMode
      OIT_GetMaxComMode_UR_ComMUser_VN_SLHSSharedDiagnostic_Ch0_0_GetMaxComMode: start-on-event=GetMaxComMode, operation=UR_ComMUser_VN_SLHSSharedDiagnostic_Ch0_0.GetMaxComMode
      OIT_GetMaxComMode_UR_ComMUser_VN_SLHSSharedDiagnostic_Ch1_3_GetMaxComMode: start-on-event=GetMaxComMode, operation=UR_ComMUser_VN_SLHSSharedDiagnostic_Ch1_3.GetMaxComMode
      OIT_GetNumSendRcvAppl_NumSendRcvAppl_GetNumSendRcvAppl: start-on-event=GetNumSendRcvAppl, operation=NumSendRcvAppl.GetNumSendRcvAppl
      OIT_GetRequestedComMode_UR_ComMUser_VN_AllNodes_Ch0_1_GetRequestedComMode: start-on-event=GetRequestedComMode, operation=UR_ComMUser_VN_AllNodes_Ch0_1.GetRequestedComMode
      OIT_GetRequestedComMode_UR_ComMUser_VN_AllNodes_Ch1_4_GetRequestedComMode: start-on-event=GetRequestedComMode, operation=UR_ComMUser_VN_AllNodes_Ch1_4.GetRequestedComMode
      OIT_GetRequestedComMode_UR_ComMUser_VN_SLHS_VNReq_Ch0_2_GetRequestedComMode: start-on-event=GetRequestedComMode, operation=UR_ComMUser_VN_SLHS_VNReq_Ch0_2.GetRequestedComMode
      OIT_GetRequestedComMode_UR_ComMUser_VN_SLHS_VNReq_Ch1_5_GetRequestedComMode: start-on-event=GetRequestedComMode, operation=UR_ComMUser_VN_SLHS_VNReq_Ch1_5.GetRequestedComMode
      OIT_GetRequestedComMode_UR_ComMUser_VN_SLHSSharedDiagnostic_Ch0_0_GetRequestedComMode: start-on-event=GetRequestedComMode, operation=UR_ComMUser_VN_SLHSSharedDiagnostic_Ch0_0.GetRequestedComMode
      OIT_GetRequestedComMode_UR_ComMUser_VN_SLHSSharedDiagnostic_Ch1_3_GetRequestedComMode: start-on-event=GetRequestedComMode, operation=UR_ComMUser_VN_SLHSSharedDiagnostic_Ch1_3.GetRequestedComMode
      OIT_LimitChannelToNoComMode_CL_A_FlexRay_LimitChannelToNoComMode: start-on-event=LimitChannelToNoComMode, operation=CL_A_FlexRay.LimitChannelToNoComMode
      OIT_LimitECUToNoComMode_modeLimitation_LimitECUToNoComMode: start-on-event=LimitECUToNoComMode, operation=modeLimitation.LimitECUToNoComMode
      OIT_PreventWakeUp_CW_A_FlexRay_PreventWakeUp: start-on-event=PreventWakeUp, operation=CW_A_FlexRay.PreventWakeUp
      OIT_ReadInhibitCounter_modeLimitation_ReadInhibitCounter: start-on-event=ReadInhibitCounter, operation=modeLimitation.ReadInhibitCounter
      OIT_RequestComMode_UR_ComMUser_VN_AllNodes_Ch0_1_RequestComMode: start-on-event=RequestComMode, operation=UR_ComMUser_VN_AllNodes_Ch0_1.RequestComMode
      OIT_RequestComMode_UR_ComMUser_VN_AllNodes_Ch1_4_RequestComMode: start-on-event=RequestComMode, operation=UR_ComMUser_VN_AllNodes_Ch1_4.RequestComMode
      OIT_RequestComMode_UR_ComMUser_VN_SLHS_VNReq_Ch0_2_RequestComMode: start-on-event=RequestComMode, operation=UR_ComMUser_VN_SLHS_VNReq_Ch0_2.RequestComMode
      OIT_RequestComMode_UR_ComMUser_VN_SLHS_VNReq_Ch1_5_RequestComMode: start-on-event=RequestComMode, operation=UR_ComMUser_VN_SLHS_VNReq_Ch1_5.RequestComMode
      OIT_RequestComMode_UR_ComMUser_VN_SLHSSharedDiagnostic_Ch0_0_RequestComMode: start-on-event=RequestComMode, operation=UR_ComMUser_VN_SLHSSharedDiagnostic_Ch0_0.RequestComMode
      OIT_RequestComMode_UR_ComMUser_VN_SLHSSharedDiagnostic_Ch1_3_RequestComMode: start-on-event=RequestComMode, operation=UR_ComMUser_VN_SLHSSharedDiagnostic_Ch1_3.RequestComMode
      OIT_ResetInhibitCounter_modeLimitation_ResetInhibitCounter: start-on-event=ResetInhibitCounter, operation=modeLimitation.ResetInhibitCounter
      OIT_SetECUGroupClassification_modeLimitation_SetECUGroupClassification: start-on-event=SetECUGroupClassification, operation=modeLimitation.SetECUGroupClassification
    port-api-options port-api-option={enable-take-address=true, indirect-api=false, port=modeLimitation}, port-api-option={enable-take-address=true, indirect-api=false, port=NumSendRcvAppl}:
      port-api-option enable-take-address=true, indirect-api=false, port=CL_A_FlexRay:
        port-arg-values:
          integer literal CL_A_FlexRay: type=ComM_NetworkHandleType, value=0
      port-api-option enable-take-address=true, indirect-api=false, port=CW_A_FlexRay:
        port-arg-values:
          integer literal CW_A_FlexRay: type=ComM_NetworkHandleType, value=0
      port-api-option enable-take-address=true, indirect-api=false, port=UR_ComMUser_VN_AllNodes_Ch0_1:
        port-arg-values:
          integer literal UR_ComMUser_VN_AllNodes_Ch0_1: type=ComM_UserHandleType, value=1
      port-api-option enable-take-address=true, indirect-api=false, port=UR_ComMUser_VN_AllNodes_Ch1_4:
        port-arg-values:
          integer literal UR_ComMUser_VN_AllNodes_Ch1_4: type=ComM_UserHandleType, value=4
      port-api-option enable-take-address=true, indirect-api=false, port=UR_ComMUser_VN_SLHS_VNReq_Ch0_2:
        port-arg-values:
          integer literal UR_ComMUser_VN_SLHS_VNReq_Ch0_2: type=ComM_UserHandleType, value=2
      port-api-option enable-take-address=true, indirect-api=false, port=UR_ComMUser_VN_SLHS_VNReq_Ch1_5:
        port-arg-values:
          integer literal UR_ComMUser_VN_SLHS_VNReq_Ch1_5: type=ComM_UserHandleType, value=5
      port-api-option enable-take-address=true, indirect-api=false, port=UR_ComMUser_VN_SLHSSharedDiagnostic_Ch0_0:
        port-arg-values:
          integer literal UR_ComMUser_VN_SLHSSharedDiagnostic_Ch0_0: type=ComM_UserHandleType, value=0
      port-api-option enable-take-address=true, indirect-api=false, port=UR_ComMUser_VN_SLHSSharedDiagnostic_Ch1_3:
        port-arg-values:
          integer literal UR_ComMUser_VN_SLHSSharedDiagnostic_Ch1_3: type=ComM_UserHandleType, value=3
    13 x runnable, all with can-be-invoked-concurrently=true:
      ComM_MainFunction_0
      GetCurrentComMode: symbol=ComM_GetCurrentComMode
      GetInhibitionStatus: symbol=ComM_GetInhibitionStatus
      GetMaxComMode: symbol=ComM_GetMaxComMode
      GetNumSendRcvAppl: symbol=ComM_GetNumSendRcvAppl
      GetRequestedComMode: symbol=ComM_GetRequestedComMode
      LimitChannelToNoComMode: symbol=ComM_ServiceLimitChannelToNoComMode
      LimitECUToNoComMode: symbol=ComM_LimitECUToNoComMode
      PreventWakeUp: symbol=ComM_ServicePreventWakeUp
      ReadInhibitCounter: symbol=ComM_ReadInhibitCounter
      RequestComMode: symbol=ComM_RequestComMode
      ResetInhibitCounter: symbol=ComM_ResetInhibitCounter
      SetECUGroupClassification: symbol=ComM_SetECUGroupClassification
  service component type ComM: category=ServiceComponent
    10 x provide port:
      CL_A_FlexRay: provided-com-specs=[{operation=GetInhibitionStatus, queue-length=1}, {operation=LimitChannelToNoComMode, queue-length=1}], provided-interface=ComM_ChannelLimitation
      CW_A_FlexRay: server-com-spec{operation=PreventWakeUp, queue-length=1}, provided-interface=ComM_ChannelWakeUp
      modeLimitation: provided-interface=ComM_ECUModeLimitation
        provided-com-specs:
          operation=LimitECUToNoComMode, queue-length=1
          operation=ReadInhibitCounter, queue-length=1
          operation=ResetInhibitCounter, queue-length=1
          operation=SetECUGroupClassification, queue-length=1
      NumSendRcvAppl: server-com-spec{operation=GetNumSendRcvAppl, queue-length=1}, provided-interface=ComM_GetNumSendRcvAppl
      UR_ComMUser_VN_AllNodes_Ch0_1: provided-interface=ComM_UserRequest
        provided-com-specs:
          operation=GetCurrentComMode, queue-length=1
          operation=GetMaxComMode, queue-length=1
          operation=GetRequestedComMode, queue-length=1
          operation=RequestComMode, queue-length=1
      UR_ComMUser_VN_AllNodes_Ch1_4: provided-interface=ComM_UserRequest
        provided-com-specs:
          operation=GetCurrentComMode, queue-length=1
          operation=GetMaxComMode, queue-length=1
          operation=GetRequestedComMode, queue-length=1
          operation=RequestComMode, queue-length=1
      UR_ComMUser_VN_SLHS_VNReq_Ch0_2: provided-interface=ComM_UserRequest
        provided-com-specs:
          operation=GetCurrentComMode, queue-length=1
          operation=GetMaxComMode, queue-length=1
          operation=GetRequestedComMode, queue-length=1
          operation=RequestComMode, queue-length=1
      UR_ComMUser_VN_SLHS_VNReq_Ch1_5: provided-interface=ComM_UserRequest
        provided-com-specs:
          operation=GetCurrentComMode, queue-length=1
          operation=GetMaxComMode, queue-length=1
          operation=GetRequestedComMode, queue-length=1
          operation=RequestComMode, queue-length=1
      UR_ComMUser_VN_SLHSSharedDiagnostic_Ch0_0: provided-interface=ComM_UserRequest
        provided-com-specs:
          operation=GetCurrentComMode, queue-length=1
          operation=GetMaxComMode, queue-length=1
          operation=GetRequestedComMode, queue-length=1
          operation=RequestComMode, queue-length=1
      UR_ComMUser_VN_SLHSSharedDiagnostic_Ch1_3: provided-interface=ComM_UserRequest
        provided-com-specs:
          operation=GetCurrentComMode, queue-length=1
          operation=GetMaxComMode, queue-length=1
          operation=GetRequestedComMode, queue-length=1
          operation=RequestComMode, queue-length=1
  swc implementation ComM_Implementation: behavior=ComM_InternalBehavior
    code-descriptors:
      code Code: type=SRC
