AUTOSAR XML (schema 314)
package /ComponentType
  internal behavior EcuM_InternalBehavior: component=EcuM
    timing event TMT_EcuM_MainFunction: start-on-event=EcuM_MainFunction, period=0.01
    5 x operation invoked event:
      OIT_GetState_EcuMUsrCfg_EPS_GetState: start-on-event=GetState, operation=EcuMUsrCfg_EPS.GetState
      OIT_ReleasePOSTRUN_EcuMUsrCfg_EPS_ReleasePOSTRUN: start-on-event=ReleasePOSTRUN, operation=EcuMUsrCfg_EPS.ReleasePOSTRUN
      OIT_ReleaseRUN_EcuMUsrCfg_EPS_ReleaseRUN: start-on-event=ReleaseRUN, operation=EcuMUsrCfg_EPS.ReleaseRUN
      OIT_RequestPOSTRUN_EcuMUsrCfg_EPS_RequestPOSTRUN: start-on-event=RequestPOSTRUN, operation=EcuMUsrCfg_EPS.RequestPOSTRUN
      OIT_RequestRUN_EcuMUsrCfg_EPS_RequestRUN: start-on-event=RequestRUN, operation=EcuMUsrCfg_EPS.RequestRUN
    port-api-options port-api-option={enable-take-address=false, indirect-api=false, port=currentMode}:
      port-api-option enable-take-address=false, indirect-api=false, port=EcuMUsrCfg_EPS:
        port-arg-values:
          integer literal EcuMUsrCfg_EPS: type=EcuM_UserType, value=1
    6 x runnable:
      EcuM_MainFunction
        mode switch point SWITCH_currentMode_currentMode: mode-group=currentMode.currentMode
      GetState: can-be-invoked-concurrently=true, symbol=EcuM_GetStateWrapper
      ReleasePOSTRUN: can-be-invoked-concurrently=true, symbol=EcuM_ReleasePOST_RUN
      ReleaseRUN: can-be-invoked-concurrently=true, symbol=EcuM_ReleaseRUN
      RequestPOSTRUN: can-be-invoked-concurrently=true, symbol=EcuM_RequestPOST_RUN
      RequestRUN: can-be-invoked-concurrently=true, symbol=EcuM_RequestRUN
  service component type EcuM: category=ServiceComponent
    provide port currentMode: mode-switch-com-spec{mode-group=currentMode, queue-length=2}, provided-interface=EcuM_CurrentMode
    provide port EcuMUsrCfg_EPS: provided-interface=StateRequest  # P-Port Prototype of EcuM for requesting and releasing RUN state for EcuM user 1.
      provided-com-specs:
        operation=GetState, queue-length=1
        operation=ReleasePOSTRUN, queue-length=1
        operation=ReleaseRUN, queue-length=1
        operation=RequestPOSTRUN, queue-length=1
        operation=RequestRUN, queue-length=1
  swc implementation EcuM_Implementation: behavior=EcuM_InternalBehavior
    code-descriptors:
      code Code: type=SRC
