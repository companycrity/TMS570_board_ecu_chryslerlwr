AUTOSAR XML (schema 314)
package /ComponentType
  application software component type Ccl
  internal behavior Ccl_InternalBehavior: component=Ccl
    4 x timing event:
      TMT_Ccl_10_0msTaskCont: start-on-event=Ccl_10_0msTaskCont, period=0.01
      TMT_Ccl_10_2msTaskCont: start-on-event=Ccl_10_2msTaskCont, period=0.01
      TMT_Ccl_2_0msTaskCont: start-on-event=Ccl_2_0msTaskCont, period=0.002
      TMT_CclPollingTask: start-on-event=CclPollingTask, period=0.01
    4 x runnable:
      Ccl_10_0msTaskCont
      Ccl_10_2msTaskCont
      Ccl_2_0msTaskCont  # Name: Communication Control Layer References: TechnicalReference_CCL.pdf v1.8 and TechnicalReference_CCL_DPM_DC.pdf v1.21 Synopsis: The runnables described here are dependant on the configuration options selected in Geny. The descripiton for this component is not generated. It must be updated maunally based on the generation options.
      CclPollingTask
  swc implementation Ccl_Implementation: behavior=Ccl_InternalBehavior
    code-descriptors:
      code Code: type=SRC
