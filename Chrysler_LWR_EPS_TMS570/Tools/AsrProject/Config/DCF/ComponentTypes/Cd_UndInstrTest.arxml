AUTOSAR XML (schema 314)
package /ComponentType
  application software component type Cd_UndInstrTest
  internal behavior Cd_UndInstrTest_InternalBehavior: component=Cd_UndInstrTest
    timing event UndInstrTest_InitEvent: start-on-event=UndInstrTest_Init, period=0
    runnable UndInstrTest_Init  # This component is a complex device driver, but is currently defined as an application component because Developer mysteriously changes it to a Service component when it is defined as a application complex driver
  swc implementation Cd_UndInstrTest_Implementation: behavior=Cd_UndInstrTest_InternalBehavior
    code-descriptors:
      code Code: type=SRC
