AUTOSAR XML (schema 314)
package /ComponentType
  internal behavior Sa_PrimaryShutdown_InternalBehavior: component=Sa_PrimaryShutdown, port-api-option{enable-take-address=false, indirect-api=false, port=SystemState}
    timing event PrimShtdn_InitEvent: start-on-event=PrimShtdn_Init, period=0
    mode switch event MST_PrimShtdn_Trns1_0: start-on-event=PrimShtdn_Trns1, activation=ENTRY, mode=SystemState.Mode.OPERATE
    mode switch event MST_PrimShtdn_Trns2_0: start-on-event=PrimShtdn_Trns2, activation=EXIT, mode=SystemState.Mode.OPERATE
    runnable PrimShtdn_Init
    runnable PrimShtdn_Trns1
    runnable PrimShtdn_Trns2
  sensor actuator software component type Sa_PrimaryShutdown
    require port SystemState: required-interface=SystemState
  swc implementation Sa_PrimaryShutdown_Implementation: behavior=Sa_PrimaryShutdown_InternalBehavior
    code-descriptors:
      code Code: type=SRC
