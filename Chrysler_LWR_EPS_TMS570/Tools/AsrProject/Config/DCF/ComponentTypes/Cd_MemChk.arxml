AUTOSAR XML (schema 314)
package /ComponentType
  complex device driver component type Cd_MemChk
    require port NxtrDiagMgr: required-com-specs=[GetNTCFailed, GetNTCStatus, ResetEventStatus, SetNTCStatus, SetOperationCycleState], required-interface=NxtrDiagMgr
  internal behavior Cd_MemChk_InternalBehavior: component=Cd_MemChk, port-api-option{enable-take-address=false, indirect-api=false, port=NxtrDiagMgr}
    timing event MemChk_Init1_InitEvent: start-on-event=MemChk_Init1, period=0
    timing event TMT_MemChk_Per1: start-on-event=MemChk_Per1, period=0.01
    runnable MemChk_Init1
      sync call SC_NxtrDiagMgr_SetNTCStatus: operation=NxtrDiagMgr.SetNTCStatus, timeout=0
    runnable MemChk_Per1
      sync call SC_NxtrDiagMgr_SetNTCStatus: operation=NxtrDiagMgr.SetNTCStatus, timeout=0
  swc implementation Cd_MemChk_Implementation: behavior=Cd_MemChk_InternalBehavior
    code-descriptors:
      code Code: type=SRC
