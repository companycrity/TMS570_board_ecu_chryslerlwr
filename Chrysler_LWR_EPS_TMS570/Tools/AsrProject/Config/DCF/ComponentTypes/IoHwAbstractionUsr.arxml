AUTOSAR XML (schema 314)
package /ComponentType
  ecu abstraction component type IoHwAbstractionUsr
    11 x provide port:
      Batt: unqueued-sender-com-spec{data-element=Volt_f32, can-invalidate=false, init-value=D_ZERO_ULS_F32}, provided-interface=Voltage_Volt_f32
      BattSwitched: unqueued-sender-com-spec{data-element=Volt_f32, can-invalidate=false, init-value=D_ZERO_ULS_F32}, provided-interface=Voltage_Volt_f32
      InvCos2Scaled: unqueued-sender-com-spec{data-element=Volt_f32, can-invalidate=false, init-value=D_ZERO_ULS_F32}, provided-interface=Voltage_Volt_f32
      InvSin2Scaled: unqueued-sender-com-spec{data-element=Volt_f32, can-invalidate=false, init-value=D_ZERO_ULS_F32}, provided-interface=Voltage_Volt_f32
      MtrPos: provided-interface=MtrPos
        provided-com-specs:
          operation=CosTheta1_V_f32, queue-length=1
          operation=InvCosTheta2_V_f32, queue-length=1
          operation=InvSinTheta2_V_f32, queue-length=1
          operation=SinTheta1_V_f32, queue-length=1
      SysCT1ADC: unqueued-sender-com-spec{data-element=Volt_f32, can-invalidate=false, init-value=D_ZERO_ULS_F32}, provided-interface=Voltage_Volt_f32
      SysCT2ADC: unqueued-sender-com-spec{data-element=Volt_f32, can-invalidate=false, init-value=D_ZERO_ULS_F32}, provided-interface=Voltage_Volt_f32
      SysCVSwitch: unqueued-sender-com-spec{data-element=Volt_f32, can-invalidate=false, init-value=D_ZERO_ULS_F32}, provided-interface=Voltage_Volt_f32
      T1ADC: unqueued-sender-com-spec{data-element=Volt_f32, can-invalidate=false, init-value=D_ZERO_ULS_F32}, provided-interface=Voltage
      T2ADC: unqueued-sender-com-spec{data-element=Volt_f32, can-invalidate=false, init-value=D_ZERO_ULS_F32}, provided-interface=Voltage
      TemperatureADC: unqueued-sender-com-spec{data-element=Volt_f32, can-invalidate=false, init-value=D_ZERO_ULS_F32}, provided-interface=Voltage
    require port NxtrDiagMgr: required-com-specs=[GetNTCActive, GetNTCFailed, GetNTCStatus, SetNTCStatus], required-interface=NxtrDiagMgr
    require port SystemTime: required-interface=SystemTime
      required-com-specs:
        DtrmnElapsedTime_mS_u16
        DtrmnElapsedTime_mS_u32
        DtrmnElapsedTime_uS_u16
        DtrmnElapsedTime_uS_u32
        GetSystemTime_mS_u32
        GetSystemTime_uS_u32
  internal behavior IoHwAbstractionUsr_InternalBehavior: component=IoHwAbstractionUsr
    timing event TMT_IoHwAb_FdbkPathAdc: start-on-event=IoHwAb_FdbkPathAdc, period=0.002
    timing event TMT_IoHwAb_FwdPathAdc: start-on-event=IoHwAb_FwdPathAdc, period=0.002
    timing event IoHwAb_InitEvent: start-on-event=IoHwAb_Init, period=0
    port-api-options:
      enable-take-address=false, indirect-api=false, port=Batt
      enable-take-address=false, indirect-api=false, port=BattSwitched
      enable-take-address=false, indirect-api=false, port=InvCos2Scaled
      enable-take-address=false, indirect-api=false, port=InvSin2Scaled
      enable-take-address=false, indirect-api=false, port=MtrPos
      enable-take-address=false, indirect-api=false, port=NxtrDiagMgr
      enable-take-address=false, indirect-api=false, port=SysCT1ADC
      enable-take-address=false, indirect-api=false, port=SysCT2ADC
      enable-take-address=false, indirect-api=false, port=SysCVSwitch
      enable-take-address=false, indirect-api=false, port=SystemTime
      enable-take-address=false, indirect-api=false, port=T1ADC
      enable-take-address=false, indirect-api=false, port=T2ADC
      enable-take-address=false, indirect-api=false, port=TemperatureADC
    runnable IoHwAb_FdbkPathAdc: can-be-invoked-concurrently=true
      6 x data write access:
        WRITE_Batt_Volt_f32: data-element=Batt.Volt_f32
        WRITE_BattSwitched_Volt_f32: data-element=BattSwitched.Volt_f32
        WRITE_InvCos2Scaled_Volt_f32: data-element=InvCos2Scaled.Volt_f32
        WRITE_InvSin2Scaled_Volt_f32: data-element=InvSin2Scaled.Volt_f32
        WRITE_SysCVSwitch_Volt_f32: data-element=SysCVSwitch.Volt_f32
        WRITE_TemperatureADC_Volt_f32: data-element=TemperatureADC.Volt_f32
      sync call SC_NxtrDiagMgr_SetNTCStatus: operation=NxtrDiagMgr.SetNTCStatus, timeout=0
      sync call SC_SystemTime_DtrmnElapsedTime_uS_u16: operation=SystemTime.DtrmnElapsedTime_uS_u16, timeout=0
      sync call SC_SystemTime_GetSystemTime_uS_u32: operation=SystemTime.GetSystemTime_uS_u32, timeout=0
    runnable IoHwAb_FwdPathAdc: can-be-invoked-concurrently=true
      4 x data write access:
        WRITE_SysCT1ADC_Volt_f32: data-element=SysCT1ADC.Volt_f32
        WRITE_SysCT2ADC_Volt_f32: data-element=SysCT2ADC.Volt_f32
        WRITE_T1ADC_Volt_f32: data-element=T1ADC.Volt_f32
        WRITE_T2ADC_Volt_f32: data-element=T2ADC.Volt_f32
      sync call SC_NxtrDiagMgr_SetNTCStatus: operation=NxtrDiagMgr.SetNTCStatus, timeout=0
      sync call SC_SystemTime_DtrmnElapsedTime_uS_u16: operation=SystemTime.DtrmnElapsedTime_uS_u16, timeout=0
      sync call SC_SystemTime_GetSystemTime_uS_u32: operation=SystemTime.GetSystemTime_uS_u32, timeout=0
    runnable IoHwAb_Init: can-be-invoked-concurrently=true
      10 x data write access:
        WRITE_Batt_Volt_f32: data-element=Batt.Volt_f32
        WRITE_BattSwitched_Volt_f32: data-element=BattSwitched.Volt_f32
        WRITE_InvCos2Scaled_Volt_f32: data-element=InvCos2Scaled.Volt_f32
        WRITE_InvSin2Scaled_Volt_f32: data-element=InvSin2Scaled.Volt_f32
        WRITE_SysCT1ADC_Volt_f32: data-element=SysCT1ADC.Volt_f32
        WRITE_SysCT2ADC_Volt_f32: data-element=SysCT2ADC.Volt_f32
        WRITE_SysCVSwitch_Volt_f32: data-element=SysCVSwitch.Volt_f32
        WRITE_T1ADC_Volt_f32: data-element=T1ADC.Volt_f32
        WRITE_T2ADC_Volt_f32: data-element=T2ADC.Volt_f32
        WRITE_TemperatureADC_Volt_f32: data-element=TemperatureADC.Volt_f32
      sync call SC_NxtrDiagMgr_SetNTCStatus: operation=NxtrDiagMgr.SetNTCStatus, timeout=0
      sync call SC_SystemTime_DtrmnElapsedTime_uS_u16: operation=SystemTime.DtrmnElapsedTime_uS_u16, timeout=0
      sync call SC_SystemTime_GetSystemTime_uS_u32: operation=SystemTime.GetSystemTime_uS_u32, timeout=0
  swc implementation IoHwAbstractionUsr_Implementation: behavior=IoHwAbstractionUsr_InternalBehavior
    code-descriptors:
      code Code: type=SRC
