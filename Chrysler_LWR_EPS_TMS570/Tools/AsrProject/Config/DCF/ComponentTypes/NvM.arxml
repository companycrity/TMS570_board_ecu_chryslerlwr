AUTOSAR XML (schema 314)
package /ComponentType
  internal behavior NvM_InternalBehavior: component=NvM
    150 x operation invoked event:
      OIT_EraseBlock_PS_ConfigBlock_EraseBlock: start-on-event=EraseBlock, operation=PS_ConfigBlock.EraseBlock
      OIT_EraseBlock_PS_NVM_BLOCK_CMS_ECUHWPN_EraseBlock: start-on-event=EraseBlock, operation=PS_NVM_BLOCK_CMS_ECUHWPN.EraseBlock
      OIT_EraseBlock_PS_NVM_BLOCK_CMS_ECUSRLNUM_EraseBlock: start-on-event=EraseBlock, operation=PS_NVM_BLOCK_CMS_ECUSRLNUM.EraseBlock
      OIT_EraseBlock_PS_NVM_BLOCK_CMS_EPSSRLNUM_EraseBlock: start-on-event=EraseBlock, operation=PS_NVM_BLOCK_CMS_EPSSRLNUM.EraseBlock
      OIT_EraseBlock_PS_NVM_BLOCK_CMS_IGNCNTR_EraseBlock: start-on-event=EraseBlock, operation=PS_NVM_BLOCK_CMS_IGNCNTR.EraseBlock
      OIT_EraseBlock_PS_NVM_BLOCK_CMS_NXTRMANUFSCRATCHPAD_EraseBlock: start-on-event=EraseBlock, operation=PS_NVM_BLOCK_CMS_NXTRMANUFSCRATCHPAD.EraseBlock
      OIT_EraseBlock_PS_NVM_BLOCK_CMS_NXTRMEC_EraseBlock: start-on-event=EraseBlock, operation=PS_NVM_BLOCK_CMS_NXTRMEC.EraseBlock
      OIT_EraseBlock_PS_NVM_BLOCK_DIAGMGR_BLACKBOX_EraseBlock: start-on-event=EraseBlock, operation=PS_NVM_BLOCK_DIAGMGR_BLACKBOX.EraseBlock
      OIT_EraseBlock_PS_NVM_BLOCK_DIAGMGR_LATCHCNTRS_EraseBlock: start-on-event=EraseBlock, operation=PS_NVM_BLOCK_DIAGMGR_LATCHCNTRS.EraseBlock
      OIT_EraseBlock_PS_NVM_BLOCK_DIAGMGR_NTCSTRG_EraseBlock: start-on-event=EraseBlock, operation=PS_NVM_BLOCK_DIAGMGR_NTCSTRG.EraseBlock
      OIT_EraseBlock_PS_NVM_BLOCK_EPSDEFEATS_EraseBlock: start-on-event=EraseBlock, operation=PS_NVM_BLOCK_EPSDEFEATS.EraseBlock
      OIT_EraseBlock_PS_NVM_BLOCK_NXTRWIRSELECT_EraseBlock: start-on-event=EraseBlock, operation=PS_NVM_BLOCK_NXTRWIRSELECT.EraseBlock
      OIT_EraseBlock_PS_NVM_BLOCK_PROGREQCNT_EraseBlock: start-on-event=EraseBlock, operation=PS_NVM_BLOCK_PROGREQCNT.EraseBlock
      OIT_EraseBlock_PS_NVM_BLOCK_RESETRESP_EraseBlock: start-on-event=EraseBlock, operation=PS_NVM_BLOCK_RESETRESP.EraseBlock
      OIT_EraseBlock_PS_NVM_BLOCK_SECDLYEN_EraseBlock: start-on-event=EraseBlock, operation=PS_NVM_BLOCK_SECDLYEN.EraseBlock
      OIT_EraseBlock_PS_NVM_BLOCK_SER_ACTIVEDIAGINFO_APPL_EraseBlock: start-on-event=EraseBlock, operation=PS_NVM_BLOCK_SER_ACTIVEDIAGINFO_APPL.EraseBlock
      OIT_EraseBlock_PS_NVM_BLOCK_SER_ACTIVEDIAGINFO_BOOT_EraseBlock: start-on-event=EraseBlock, operation=PS_NVM_BLOCK_SER_ACTIVEDIAGINFO_BOOT.EraseBlock
      OIT_EraseBlock_PS_NVM_BLOCK_SER_BOOTSWVERSIONINFO_EraseBlock: start-on-event=EraseBlock, operation=PS_NVM_BLOCK_SER_BOOTSWVERSIONINFO.EraseBlock
      OIT_EraseBlock_PS_NVM_BLOCK_SER_DIAGSPECINFO_EraseBlock: start-on-event=EraseBlock, operation=PS_NVM_BLOCK_SER_DIAGSPECINFO.EraseBlock
      OIT_EraseBlock_PS_NVM_BLOCK_SER_ECUPN_EraseBlock: start-on-event=EraseBlock, operation=PS_NVM_BLOCK_SER_ECUPN.EraseBlock
      OIT_EraseBlock_PS_NVM_BLOCK_SER_ECUSERIALNUMBER_EraseBlock: start-on-event=EraseBlock, operation=PS_NVM_BLOCK_SER_ECUSERIALNUMBER.EraseBlock
      OIT_EraseBlock_PS_NVM_BLOCK_SER_HWPARTNUMBER_EraseBlock: start-on-event=EraseBlock, operation=PS_NVM_BLOCK_SER_HWPARTNUMBER.EraseBlock
      OIT_EraseBlock_PS_NVM_BLOCK_SER_HWSUPPID_EraseBlock: start-on-event=EraseBlock, operation=PS_NVM_BLOCK_SER_HWSUPPID.EraseBlock
      OIT_EraseBlock_PS_NVM_BLOCK_SER_HWVERSIONINFO_EraseBlock: start-on-event=EraseBlock, operation=PS_NVM_BLOCK_SER_HWVERSIONINFO.EraseBlock
      OIT_EraseBlock_PS_NVM_BLOCK_SER_METADATA_APPLICATION_EraseBlock: start-on-event=EraseBlock, operation=PS_NVM_BLOCK_SER_METADATA_APPLICATION.EraseBlock
      OIT_EraseBlock_PS_NVM_BLOCK_SER_METADATA_CAL1_EraseBlock: start-on-event=EraseBlock, operation=PS_NVM_BLOCK_SER_METADATA_CAL1.EraseBlock
      OIT_EraseBlock_PS_NVM_BLOCK_SER_METADATA_CAL2_EraseBlock: start-on-event=EraseBlock, operation=PS_NVM_BLOCK_SER_METADATA_CAL2.EraseBlock
      OIT_EraseBlock_PS_NVM_BLOCK_SER_RESPONEVENTACTVSTATE_EraseBlock: start-on-event=EraseBlock, operation=PS_NVM_BLOCK_SER_RESPONEVENTACTVSTATE.EraseBlock
      OIT_EraseBlock_PS_NVM_BLOCK_SER_VEHICLEINFO_EraseBlock: start-on-event=EraseBlock, operation=PS_NVM_BLOCK_SER_VEHICLEINFO.EraseBlock
      OIT_EraseBlock_PS_NVM_BLOCK_SER_VINCURRENT_EraseBlock: start-on-event=EraseBlock, operation=PS_NVM_BLOCK_SER_VINCURRENT.EraseBlock
      OIT_EraseBlock_PS_NVM_BLOCK_SER_VINODOMETERCOUNTER_EraseBlock: start-on-event=EraseBlock, operation=PS_NVM_BLOCK_SER_VINODOMETERCOUNTER.EraseBlock
      OIT_EraseBlock_PS_NVM_BLOCK_SER_VINORIGINAL_EraseBlock: start-on-event=EraseBlock, operation=PS_NVM_BLOCK_SER_VINORIGINAL.EraseBlock
      OIT_EraseBlock_PS_NVM_BLOCK_SWFINGERPRINT_EraseBlock: start-on-event=EraseBlock, operation=PS_NVM_BLOCK_SWFINGERPRINT.EraseBlock
      OIT_EraseBlock_PS_Rte_NvmBlock_Ap_AstLmt_SteerAsstDefeat_EraseBlock: start-on-event=EraseBlock, operation=PS_Rte_NvmBlock_Ap_AstLmt_SteerAsstDefeat.EraseBlock
      OIT_EraseBlock_PS_Rte_NvmBlock_Ap_AvgFricLrn_AvgFricLrnData_EraseBlock: start-on-event=EraseBlock, operation=PS_Rte_NvmBlock_Ap_AvgFricLrn_AvgFricLrnData.EraseBlock
      OIT_EraseBlock_PS_Rte_NvmBlock_Ap_TrqCanc_CogTrqRplComp_EraseBlock: start-on-event=EraseBlock, operation=PS_Rte_NvmBlock_Ap_TrqCanc_CogTrqRplComp.EraseBlock
      OIT_EraseBlock_PS_Rte_NvmBlock_BatteryVoltage_OvervoltageData_EraseBlock: start-on-event=EraseBlock, operation=PS_Rte_NvmBlock_BatteryVoltage_OvervoltageData.EraseBlock
      OIT_EraseBlock_PS_Rte_NvmBlock_CmMtrCurr_CurrTempOffset_EraseBlock: start-on-event=EraseBlock, operation=PS_Rte_NvmBlock_CmMtrCurr_CurrTempOffset.EraseBlock
      OIT_EraseBlock_PS_Rte_NvmBlock_CmMtrCurr_ShCurrCal_EraseBlock: start-on-event=EraseBlock, operation=PS_Rte_NvmBlock_CmMtrCurr_ShCurrCal.EraseBlock
      OIT_EraseBlock_PS_Rte_NvmBlock_CurrParamComp_EOLNomMtrParam_EraseBlock: start-on-event=EraseBlock, operation=PS_Rte_NvmBlock_CurrParamComp_EOLNomMtrParam.EraseBlock
      OIT_EraseBlock_PS_Rte_NvmBlock_HwTrq_EOLTrqStepData_EraseBlock: start-on-event=EraseBlock, operation=PS_Rte_NvmBlock_HwTrq_EOLTrqStepData.EraseBlock
      OIT_EraseBlock_PS_Rte_NvmBlock_HwTrq_HwTrqScaleData_EraseBlock: start-on-event=EraseBlock, operation=PS_Rte_NvmBlock_HwTrq_HwTrqScaleData.EraseBlock
      OIT_EraseBlock_PS_Rte_NvmBlock_HwTrq_HwTrqTrimData_EraseBlock: start-on-event=EraseBlock, operation=PS_Rte_NvmBlock_HwTrq_HwTrqTrimData.EraseBlock
      OIT_EraseBlock_PS_Rte_NvmBlock_IPMTrqCanc_CogTrqCal_EraseBlock: start-on-event=EraseBlock, operation=PS_Rte_NvmBlock_IPMTrqCanc_CogTrqCal.EraseBlock
      OIT_EraseBlock_PS_Rte_NvmBlock_LrnEOT_LearnedEOT_EraseBlock: start-on-event=EraseBlock, operation=PS_Rte_NvmBlock_LrnEOT_LearnedEOT.EraseBlock
      OIT_EraseBlock_PS_Rte_NvmBlock_MtrPos_MtrPosSnsr_EOLData_EraseBlock: start-on-event=EraseBlock, operation=PS_Rte_NvmBlock_MtrPos_MtrPosSnsr_EOLData.EraseBlock
      OIT_EraseBlock_PS_Rte_NvmBlock_Polarity_EOLCtrlPolarity_EraseBlock: start-on-event=EraseBlock, operation=PS_Rte_NvmBlock_Polarity_EOLCtrlPolarity.EraseBlock
      OIT_EraseBlock_PS_Rte_NvmBlock_StaMd_CloseCheckData_EraseBlock: start-on-event=EraseBlock, operation=PS_Rte_NvmBlock_StaMd_CloseCheckData.EraseBlock
      OIT_EraseBlock_PS_Rte_NvmBlock_StaMd_TypeHRamBuffer_EraseBlock: start-on-event=EraseBlock, operation=PS_Rte_NvmBlock_StaMd_TypeHRamBuffer.EraseBlock
      OIT_EraseBlock_PS_Rte_NvmBlock_TrqCmdScl_TorqueCmdSF_Uls_f32_EraseBlock: start-on-event=EraseBlock, operation=PS_Rte_NvmBlock_TrqCmdScl_TorqueCmdSF_Uls_f32.EraseBlock
      OIT_GetErrorStatus_PS_ConfigBlock_GetErrorStatus: start-on-event=GetErrorStatus, operation=PS_ConfigBlock.GetErrorStatus
      OIT_GetErrorStatus_PS_NVM_BLOCK_CMS_ECUHWPN_GetErrorStatus: start-on-event=GetErrorStatus, operation=PS_NVM_BLOCK_CMS_ECUHWPN.GetErrorStatus
      OIT_GetErrorStatus_PS_NVM_BLOCK_CMS_ECUSRLNUM_GetErrorStatus: start-on-event=GetErrorStatus, operation=PS_NVM_BLOCK_CMS_ECUSRLNUM.GetErrorStatus
      OIT_GetErrorStatus_PS_NVM_BLOCK_CMS_EPSSRLNUM_GetErrorStatus: start-on-event=GetErrorStatus, operation=PS_NVM_BLOCK_CMS_EPSSRLNUM.GetErrorStatus
      OIT_GetErrorStatus_PS_NVM_BLOCK_CMS_IGNCNTR_GetErrorStatus: start-on-event=GetErrorStatus, operation=PS_NVM_BLOCK_CMS_IGNCNTR.GetErrorStatus
      OIT_GetErrorStatus_PS_NVM_BLOCK_CMS_NXTRMANUFSCRATCHPAD_GetErrorStatus: start-on-event=GetErrorStatus, operation=PS_NVM_BLOCK_CMS_NXTRMANUFSCRATCHPAD.GetErrorStatus
      OIT_GetErrorStatus_PS_NVM_BLOCK_CMS_NXTRMEC_GetErrorStatus: start-on-event=GetErrorStatus, operation=PS_NVM_BLOCK_CMS_NXTRMEC.GetErrorStatus
      OIT_GetErrorStatus_PS_NVM_BLOCK_DIAGMGR_BLACKBOX_GetErrorStatus: start-on-event=GetErrorStatus, operation=PS_NVM_BLOCK_DIAGMGR_BLACKBOX.GetErrorStatus
      OIT_GetErrorStatus_PS_NVM_BLOCK_DIAGMGR_LATCHCNTRS_GetErrorStatus: start-on-event=GetErrorStatus, operation=PS_NVM_BLOCK_DIAGMGR_LATCHCNTRS.GetErrorStatus
      OIT_GetErrorStatus_PS_NVM_BLOCK_DIAGMGR_NTCSTRG_GetErrorStatus: start-on-event=GetErrorStatus, operation=PS_NVM_BLOCK_DIAGMGR_NTCSTRG.GetErrorStatus
      OIT_GetErrorStatus_PS_NVM_BLOCK_EPSDEFEATS_GetErrorStatus: start-on-event=GetErrorStatus, operation=PS_NVM_BLOCK_EPSDEFEATS.GetErrorStatus
      OIT_GetErrorStatus_PS_NVM_BLOCK_NXTRWIRSELECT_GetErrorStatus: start-on-event=GetErrorStatus, operation=PS_NVM_BLOCK_NXTRWIRSELECT.GetErrorStatus
      OIT_GetErrorStatus_PS_NVM_BLOCK_PROGREQCNT_GetErrorStatus: start-on-event=GetErrorStatus, operation=PS_NVM_BLOCK_PROGREQCNT.GetErrorStatus
      OIT_GetErrorStatus_PS_NVM_BLOCK_RESETRESP_GetErrorStatus: start-on-event=GetErrorStatus, operation=PS_NVM_BLOCK_RESETRESP.GetErrorStatus
      OIT_GetErrorStatus_PS_NVM_BLOCK_SECDLYEN_GetErrorStatus: start-on-event=GetErrorStatus, operation=PS_NVM_BLOCK_SECDLYEN.GetErrorStatus
      OIT_GetErrorStatus_PS_NVM_BLOCK_SER_ACTIVEDIAGINFO_APPL_GetErrorStatus: start-on-event=GetErrorStatus, operation=PS_NVM_BLOCK_SER_ACTIVEDIAGINFO_APPL.GetErrorStatus
      OIT_GetErrorStatus_PS_NVM_BLOCK_SER_ACTIVEDIAGINFO_BOOT_GetErrorStatus: start-on-event=GetErrorStatus, operation=PS_NVM_BLOCK_SER_ACTIVEDIAGINFO_BOOT.GetErrorStatus
      OIT_GetErrorStatus_PS_NVM_BLOCK_SER_BOOTSWVERSIONINFO_GetErrorStatus: start-on-event=GetErrorStatus, operation=PS_NVM_BLOCK_SER_BOOTSWVERSIONINFO.GetErrorStatus
      OIT_GetErrorStatus_PS_NVM_BLOCK_SER_DIAGSPECINFO_GetErrorStatus: start-on-event=GetErrorStatus, operation=PS_NVM_BLOCK_SER_DIAGSPECINFO.GetErrorStatus
      OIT_GetErrorStatus_PS_NVM_BLOCK_SER_ECUPN_GetErrorStatus: start-on-event=GetErrorStatus, operation=PS_NVM_BLOCK_SER_ECUPN.GetErrorStatus
      OIT_GetErrorStatus_PS_NVM_BLOCK_SER_ECUSERIALNUMBER_GetErrorStatus: start-on-event=GetErrorStatus, operation=PS_NVM_BLOCK_SER_ECUSERIALNUMBER.GetErrorStatus
      OIT_GetErrorStatus_PS_NVM_BLOCK_SER_HWPARTNUMBER_GetErrorStatus: start-on-event=GetErrorStatus, operation=PS_NVM_BLOCK_SER_HWPARTNUMBER.GetErrorStatus
      OIT_GetErrorStatus_PS_NVM_BLOCK_SER_HWSUPPID_GetErrorStatus: start-on-event=GetErrorStatus, operation=PS_NVM_BLOCK_SER_HWSUPPID.GetErrorStatus
      OIT_GetErrorStatus_PS_NVM_BLOCK_SER_HWVERSIONINFO_GetErrorStatus: start-on-event=GetErrorStatus, operation=PS_NVM_BLOCK_SER_HWVERSIONINFO.GetErrorStatus
      OIT_GetErrorStatus_PS_NVM_BLOCK_SER_METADATA_APPLICATION_GetErrorStatus: start-on-event=GetErrorStatus, operation=PS_NVM_BLOCK_SER_METADATA_APPLICATION.GetErrorStatus
      OIT_GetErrorStatus_PS_NVM_BLOCK_SER_METADATA_CAL1_GetErrorStatus: start-on-event=GetErrorStatus, operation=PS_NVM_BLOCK_SER_METADATA_CAL1.GetErrorStatus
      OIT_GetErrorStatus_PS_NVM_BLOCK_SER_METADATA_CAL2_GetErrorStatus: start-on-event=GetErrorStatus, operation=PS_NVM_BLOCK_SER_METADATA_CAL2.GetErrorStatus
      OIT_GetErrorStatus_PS_NVM_BLOCK_SER_RESPONEVENTACTVSTATE_GetErrorStatus: start-on-event=GetErrorStatus, operation=PS_NVM_BLOCK_SER_RESPONEVENTACTVSTATE.GetErrorStatus
      OIT_GetErrorStatus_PS_NVM_BLOCK_SER_VEHICLEINFO_GetErrorStatus: start-on-event=GetErrorStatus, operation=PS_NVM_BLOCK_SER_VEHICLEINFO.GetErrorStatus
      OIT_GetErrorStatus_PS_NVM_BLOCK_SER_VINCURRENT_GetErrorStatus: start-on-event=GetErrorStatus, operation=PS_NVM_BLOCK_SER_VINCURRENT.GetErrorStatus
      OIT_GetErrorStatus_PS_NVM_BLOCK_SER_VINODOMETERCOUNTER_GetErrorStatus: start-on-event=GetErrorStatus, operation=PS_NVM_BLOCK_SER_VINODOMETERCOUNTER.GetErrorStatus
      OIT_GetErrorStatus_PS_NVM_BLOCK_SER_VINORIGINAL_GetErrorStatus: start-on-event=GetErrorStatus, operation=PS_NVM_BLOCK_SER_VINORIGINAL.GetErrorStatus
      OIT_GetErrorStatus_PS_NVM_BLOCK_SWFINGERPRINT_GetErrorStatus: start-on-event=GetErrorStatus, operation=PS_NVM_BLOCK_SWFINGERPRINT.GetErrorStatus
      OIT_GetErrorStatus_PS_Rte_NvmBlock_Ap_AstLmt_SteerAsstDefeat_GetErrorStatus: start-on-event=GetErrorStatus, operation=PS_Rte_NvmBlock_Ap_AstLmt_SteerAsstDefeat.GetErrorStatus
      OIT_GetErrorStatus_PS_Rte_NvmBlock_Ap_AvgFricLrn_AvgFricLrnData_GetErrorStatus: start-on-event=GetErrorStatus, operation=PS_Rte_NvmBlock_Ap_AvgFricLrn_AvgFricLrnData.GetErrorStatus
      OIT_GetErrorStatus_PS_Rte_NvmBlock_Ap_TrqCanc_CogTrqRplComp_GetErrorStatus: start-on-event=GetErrorStatus, operation=PS_Rte_NvmBlock_Ap_TrqCanc_CogTrqRplComp.GetErrorStatus
      OIT_GetErrorStatus_PS_Rte_NvmBlock_BatteryVoltage_OvervoltageData_GetErrorStatus: start-on-event=GetErrorStatus, operation=PS_Rte_NvmBlock_BatteryVoltage_OvervoltageData.GetErrorStatus
      OIT_GetErrorStatus_PS_Rte_NvmBlock_CmMtrCurr_CurrTempOffset_GetErrorStatus: start-on-event=GetErrorStatus, operation=PS_Rte_NvmBlock_CmMtrCurr_CurrTempOffset.GetErrorStatus
      OIT_GetErrorStatus_PS_Rte_NvmBlock_CmMtrCurr_ShCurrCal_GetErrorStatus: start-on-event=GetErrorStatus, operation=PS_Rte_NvmBlock_CmMtrCurr_ShCurrCal.GetErrorStatus
      OIT_GetErrorStatus_PS_Rte_NvmBlock_CurrParamComp_EOLNomMtrParam_GetErrorStatus: start-on-event=GetErrorStatus, operation=PS_Rte_NvmBlock_CurrParamComp_EOLNomMtrParam.GetErrorStatus
      OIT_GetErrorStatus_PS_Rte_NvmBlock_HwTrq_EOLTrqStepData_GetErrorStatus: start-on-event=GetErrorStatus, operation=PS_Rte_NvmBlock_HwTrq_EOLTrqStepData.GetErrorStatus
      OIT_GetErrorStatus_PS_Rte_NvmBlock_HwTrq_HwTrqScaleData_GetErrorStatus: start-on-event=GetErrorStatus, operation=PS_Rte_NvmBlock_HwTrq_HwTrqScaleData.GetErrorStatus
      OIT_GetErrorStatus_PS_Rte_NvmBlock_HwTrq_HwTrqTrimData_GetErrorStatus: start-on-event=GetErrorStatus, operation=PS_Rte_NvmBlock_HwTrq_HwTrqTrimData.GetErrorStatus
      OIT_GetErrorStatus_PS_Rte_NvmBlock_IPMTrqCanc_CogTrqCal_GetErrorStatus: start-on-event=GetErrorStatus, operation=PS_Rte_NvmBlock_IPMTrqCanc_CogTrqCal.GetErrorStatus
      OIT_GetErrorStatus_PS_Rte_NvmBlock_LrnEOT_LearnedEOT_GetErrorStatus: start-on-event=GetErrorStatus, operation=PS_Rte_NvmBlock_LrnEOT_LearnedEOT.GetErrorStatus
      OIT_GetErrorStatus_PS_Rte_NvmBlock_MtrPos_MtrPosSnsr_EOLData_GetErrorStatus: start-on-event=GetErrorStatus, operation=PS_Rte_NvmBlock_MtrPos_MtrPosSnsr_EOLData.GetErrorStatus
      OIT_GetErrorStatus_PS_Rte_NvmBlock_Polarity_EOLCtrlPolarity_GetErrorStatus: start-on-event=GetErrorStatus, operation=PS_Rte_NvmBlock_Polarity_EOLCtrlPolarity.GetErrorStatus
      OIT_GetErrorStatus_PS_Rte_NvmBlock_StaMd_CloseCheckData_GetErrorStatus: start-on-event=GetErrorStatus, operation=PS_Rte_NvmBlock_StaMd_CloseCheckData.GetErrorStatus
      OIT_GetErrorStatus_PS_Rte_NvmBlock_StaMd_TypeHRamBuffer_GetErrorStatus: start-on-event=GetErrorStatus, operation=PS_Rte_NvmBlock_StaMd_TypeHRamBuffer.GetErrorStatus
      OIT_GetErrorStatus_PS_Rte_NvmBlock_TrqCmdScl_TorqueCmdSF_Uls_f32_GetErrorStatus: start-on-event=GetErrorStatus, operation=PS_Rte_NvmBlock_TrqCmdScl_TorqueCmdSF_Uls_f32.GetErrorStatus
      OIT_InvalidateNvBlock_PS_ConfigBlock_InvalidateNvBlock: start-on-event=InvalidateNvBlock, operation=PS_ConfigBlock.InvalidateNvBlock
      OIT_InvalidateNvBlock_PS_NVM_BLOCK_CMS_ECUHWPN_InvalidateNvBlock: start-on-event=InvalidateNvBlock, operation=PS_NVM_BLOCK_CMS_ECUHWPN.InvalidateNvBlock
      OIT_InvalidateNvBlock_PS_NVM_BLOCK_CMS_ECUSRLNUM_InvalidateNvBlock: start-on-event=InvalidateNvBlock, operation=PS_NVM_BLOCK_CMS_ECUSRLNUM.InvalidateNvBlock
      OIT_InvalidateNvBlock_PS_NVM_BLOCK_CMS_EPSSRLNUM_InvalidateNvBlock: start-on-event=InvalidateNvBlock, operation=PS_NVM_BLOCK_CMS_EPSSRLNUM.InvalidateNvBlock
      OIT_InvalidateNvBlock_PS_NVM_BLOCK_CMS_IGNCNTR_InvalidateNvBlock: start-on-event=InvalidateNvBlock, operation=PS_NVM_BLOCK_CMS_IGNCNTR.InvalidateNvBlock
      OIT_InvalidateNvBlock_PS_NVM_BLOCK_CMS_NXTRMANUFSCRATCHPAD_InvalidateNvBlock: start-on-event=InvalidateNvBlock, operation=PS_NVM_BLOCK_CMS_NXTRMANUFSCRATCHPAD.InvalidateNvBlock
      OIT_InvalidateNvBlock_PS_NVM_BLOCK_CMS_NXTRMEC_InvalidateNvBlock: start-on-event=InvalidateNvBlock, operation=PS_NVM_BLOCK_CMS_NXTRMEC.InvalidateNvBlock
      OIT_InvalidateNvBlock_PS_NVM_BLOCK_DIAGMGR_BLACKBOX_InvalidateNvBlock: start-on-event=InvalidateNvBlock, operation=PS_NVM_BLOCK_DIAGMGR_BLACKBOX.InvalidateNvBlock
      OIT_InvalidateNvBlock_PS_NVM_BLOCK_DIAGMGR_LATCHCNTRS_InvalidateNvBlock: start-on-event=InvalidateNvBlock, operation=PS_NVM_BLOCK_DIAGMGR_LATCHCNTRS.InvalidateNvBlock
      OIT_InvalidateNvBlock_PS_NVM_BLOCK_DIAGMGR_NTCSTRG_InvalidateNvBlock: start-on-event=InvalidateNvBlock, operation=PS_NVM_BLOCK_DIAGMGR_NTCSTRG.InvalidateNvBlock
      OIT_InvalidateNvBlock_PS_NVM_BLOCK_EPSDEFEATS_InvalidateNvBlock: start-on-event=InvalidateNvBlock, operation=PS_NVM_BLOCK_EPSDEFEATS.InvalidateNvBlock
      OIT_InvalidateNvBlock_PS_NVM_BLOCK_NXTRWIRSELECT_InvalidateNvBlock: start-on-event=InvalidateNvBlock, operation=PS_NVM_BLOCK_NXTRWIRSELECT.InvalidateNvBlock
      OIT_InvalidateNvBlock_PS_NVM_BLOCK_PROGREQCNT_InvalidateNvBlock: start-on-event=InvalidateNvBlock, operation=PS_NVM_BLOCK_PROGREQCNT.InvalidateNvBlock
      OIT_InvalidateNvBlock_PS_NVM_BLOCK_RESETRESP_InvalidateNvBlock: start-on-event=InvalidateNvBlock, operation=PS_NVM_BLOCK_RESETRESP.InvalidateNvBlock
      OIT_InvalidateNvBlock_PS_NVM_BLOCK_SECDLYEN_InvalidateNvBlock: start-on-event=InvalidateNvBlock, operation=PS_NVM_BLOCK_SECDLYEN.InvalidateNvBlock
      OIT_InvalidateNvBlock_PS_NVM_BLOCK_SER_ACTIVEDIAGINFO_APPL_InvalidateNvBlock: start-on-event=InvalidateNvBlock, operation=PS_NVM_BLOCK_SER_ACTIVEDIAGINFO_APPL.InvalidateNvBlock
      OIT_InvalidateNvBlock_PS_NVM_BLOCK_SER_ACTIVEDIAGINFO_BOOT_InvalidateNvBlock: start-on-event=InvalidateNvBlock, operation=PS_NVM_BLOCK_SER_ACTIVEDIAGINFO_BOOT.InvalidateNvBlock
      OIT_InvalidateNvBlock_PS_NVM_BLOCK_SER_BOOTSWVERSIONINFO_InvalidateNvBlock: start-on-event=InvalidateNvBlock, operation=PS_NVM_BLOCK_SER_BOOTSWVERSIONINFO.InvalidateNvBlock
      OIT_InvalidateNvBlock_PS_NVM_BLOCK_SER_DIAGSPECINFO_InvalidateNvBlock: start-on-event=InvalidateNvBlock, operation=PS_NVM_BLOCK_SER_DIAGSPECINFO.InvalidateNvBlock
      OIT_InvalidateNvBlock_PS_NVM_BLOCK_SER_ECUPN_InvalidateNvBlock: start-on-event=InvalidateNvBlock, operation=PS_NVM_BLOCK_SER_ECUPN.InvalidateNvBlock
      OIT_InvalidateNvBlock_PS_NVM_BLOCK_SER_ECUSERIALNUMBER_InvalidateNvBlock: start-on-event=InvalidateNvBlock, operation=PS_NVM_BLOCK_SER_ECUSERIALNUMBER.InvalidateNvBlock
      OIT_InvalidateNvBlock_PS_NVM_BLOCK_SER_HWPARTNUMBER_InvalidateNvBlock: start-on-event=InvalidateNvBlock, operation=PS_NVM_BLOCK_SER_HWPARTNUMBER.InvalidateNvBlock
      OIT_InvalidateNvBlock_PS_NVM_BLOCK_SER_HWSUPPID_InvalidateNvBlock: start-on-event=InvalidateNvBlock, operation=PS_NVM_BLOCK_SER_HWSUPPID.InvalidateNvBlock
      OIT_InvalidateNvBlock_PS_NVM_BLOCK_SER_HWVERSIONINFO_InvalidateNvBlock: start-on-event=InvalidateNvBlock, operation=PS_NVM_BLOCK_SER_HWVERSIONINFO.InvalidateNvBlock
      OIT_InvalidateNvBlock_PS_NVM_BLOCK_SER_METADATA_APPLICATION_InvalidateNvBlock: start-on-event=InvalidateNvBlock, operation=PS_NVM_BLOCK_SER_METADATA_APPLICATION.InvalidateNvBlock
      OIT_InvalidateNvBlock_PS_NVM_BLOCK_SER_METADATA_CAL1_InvalidateNvBlock: start-on-event=InvalidateNvBlock, operation=PS_NVM_BLOCK_SER_METADATA_CAL1.InvalidateNvBlock
      OIT_InvalidateNvBlock_PS_NVM_BLOCK_SER_METADATA_CAL2_InvalidateNvBlock: start-on-event=InvalidateNvBlock, operation=PS_NVM_BLOCK_SER_METADATA_CAL2.InvalidateNvBlock
      OIT_InvalidateNvBlock_PS_NVM_BLOCK_SER_RESPONEVENTACTVSTATE_InvalidateNvBlock: start-on-event=InvalidateNvBlock, operation=PS_NVM_BLOCK_SER_RESPONEVENTACTVSTATE.InvalidateNvBlock
      OIT_InvalidateNvBlock_PS_NVM_BLOCK_SER_VEHICLEINFO_InvalidateNvBlock: start-on-event=InvalidateNvBlock, operation=PS_NVM_BLOCK_SER_VEHICLEINFO.InvalidateNvBlock
      OIT_InvalidateNvBlock_PS_NVM_BLOCK_SER_VINCURRENT_InvalidateNvBlock: start-on-event=InvalidateNvBlock, operation=PS_NVM_BLOCK_SER_VINCURRENT.InvalidateNvBlock
      OIT_InvalidateNvBlock_PS_NVM_BLOCK_SER_VINODOMETERCOUNTER_InvalidateNvBlock: start-on-event=InvalidateNvBlock, operation=PS_NVM_BLOCK_SER_VINODOMETERCOUNTER.InvalidateNvBlock
      OIT_InvalidateNvBlock_PS_NVM_BLOCK_SER_VINORIGINAL_InvalidateNvBlock: start-on-event=InvalidateNvBlock, operation=PS_NVM_BLOCK_SER_VINORIGINAL.InvalidateNvBlock
      OIT_InvalidateNvBlock_PS_NVM_BLOCK_SWFINGERPRINT_InvalidateNvBlock: start-on-event=InvalidateNvBlock, operation=PS_NVM_BLOCK_SWFINGERPRINT.InvalidateNvBlock
      OIT_InvalidateNvBlock_PS_Rte_NvmBlock_Ap_AstLmt_SteerAsstDefeat_InvalidateNvBlock: start-on-event=InvalidateNvBlock, operation=PS_Rte_NvmBlock_Ap_AstLmt_SteerAsstDefeat.InvalidateNvBlock
      OIT_InvalidateNvBlock_PS_Rte_NvmBlock_Ap_AvgFricLrn_AvgFricLrnData_InvalidateNvBlock: start-on-event=InvalidateNvBlock, operation=PS_Rte_NvmBlock_Ap_AvgFricLrn_AvgFricLrnData.InvalidateNvBlock
      OIT_InvalidateNvBlock_PS_Rte_NvmBlock_Ap_TrqCanc_CogTrqRplComp_InvalidateNvBlock: start-on-event=InvalidateNvBlock, operation=PS_Rte_NvmBlock_Ap_TrqCanc_CogTrqRplComp.InvalidateNvBlock
      OIT_InvalidateNvBlock_PS_Rte_NvmBlock_BatteryVoltage_OvervoltageData_InvalidateNvBlock: start-on-event=InvalidateNvBlock, operation=PS_Rte_NvmBlock_BatteryVoltage_OvervoltageData.InvalidateNvBlock
      OIT_InvalidateNvBlock_PS_Rte_NvmBlock_CmMtrCurr_CurrTempOffset_InvalidateNvBlock: start-on-event=InvalidateNvBlock, operation=PS_Rte_NvmBlock_CmMtrCurr_CurrTempOffset.InvalidateNvBlock
      OIT_InvalidateNvBlock_PS_Rte_NvmBlock_CmMtrCurr_ShCurrCal_InvalidateNvBlock: start-on-event=InvalidateNvBlock, operation=PS_Rte_NvmBlock_CmMtrCurr_ShCurrCal.InvalidateNvBlock
      OIT_InvalidateNvBlock_PS_Rte_NvmBlock_CurrParamComp_EOLNomMtrParam_InvalidateNvBlock: start-on-event=InvalidateNvBlock, operation=PS_Rte_NvmBlock_CurrParamComp_EOLNomMtrParam.InvalidateNvBlock
      OIT_InvalidateNvBlock_PS_Rte_NvmBlock_HwTrq_EOLTrqStepData_InvalidateNvBlock: start-on-event=InvalidateNvBlock, operation=PS_Rte_NvmBlock_HwTrq_EOLTrqStepData.InvalidateNvBlock
      OIT_InvalidateNvBlock_PS_Rte_NvmBlock_HwTrq_HwTrqScaleData_InvalidateNvBlock: start-on-event=InvalidateNvBlock, operation=PS_Rte_NvmBlock_HwTrq_HwTrqScaleData.InvalidateNvBlock
      OIT_InvalidateNvBlock_PS_Rte_NvmBlock_HwTrq_HwTrqTrimData_InvalidateNvBlock: start-on-event=InvalidateNvBlock, operation=PS_Rte_NvmBlock_HwTrq_HwTrqTrimData.InvalidateNvBlock
      OIT_InvalidateNvBlock_PS_Rte_NvmBlock_IPMTrqCanc_CogTrqCal_InvalidateNvBlock: start-on-event=InvalidateNvBlock, operation=PS_Rte_NvmBlock_IPMTrqCanc_CogTrqCal.InvalidateNvBlock
      OIT_InvalidateNvBlock_PS_Rte_NvmBlock_LrnEOT_LearnedEOT_InvalidateNvBlock: start-on-event=InvalidateNvBlock, operation=PS_Rte_NvmBlock_LrnEOT_LearnedEOT.InvalidateNvBlock
      OIT_InvalidateNvBlock_PS_Rte_NvmBlock_MtrPos_MtrPosSnsr_EOLData_InvalidateNvBlock: start-on-event=InvalidateNvBlock, operation=PS_Rte_NvmBlock_MtrPos_MtrPosSnsr_EOLData.InvalidateNvBlock
      OIT_InvalidateNvBlock_PS_Rte_NvmBlock_Polarity_EOLCtrlPolarity_InvalidateNvBlock: start-on-event=InvalidateNvBlock, operation=PS_Rte_NvmBlock_Polarity_EOLCtrlPolarity.InvalidateNvBlock
      OIT_InvalidateNvBlock_PS_Rte_NvmBlock_StaMd_CloseCheckData_InvalidateNvBlock: start-on-event=InvalidateNvBlock, operation=PS_Rte_NvmBlock_StaMd_CloseCheckData.InvalidateNvBlock
      OIT_InvalidateNvBlock_PS_Rte_NvmBlock_StaMd_TypeHRamBuffer_InvalidateNvBlock: start-on-event=InvalidateNvBlock, operation=PS_Rte_NvmBlock_StaMd_TypeHRamBuffer.InvalidateNvBlock
      OIT_InvalidateNvBlock_PS_Rte_NvmBlock_TrqCmdScl_TorqueCmdSF_Uls_f32_InvalidateNvBlock: start-on-event=InvalidateNvBlock, operation=PS_Rte_NvmBlock_TrqCmdScl_TorqueCmdSF_Uls_f32.InvalidateNvBlock
    timing event TMT_NvM_MainFunction: start-on-event=NvM_MainFunction, period=0.01
    200 x operation invoked event:
      OIT_ReadBlock_PS_ConfigBlock_ReadBlock: start-on-event=ReadBlock, operation=PS_ConfigBlock.ReadBlock
      OIT_ReadBlock_PS_NVM_BLOCK_CMS_ECUHWPN_ReadBlock: start-on-event=ReadBlock, operation=PS_NVM_BLOCK_CMS_ECUHWPN.ReadBlock
      OIT_ReadBlock_PS_NVM_BLOCK_CMS_ECUSRLNUM_ReadBlock: start-on-event=ReadBlock, operation=PS_NVM_BLOCK_CMS_ECUSRLNUM.ReadBlock
      OIT_ReadBlock_PS_NVM_BLOCK_CMS_EPSSRLNUM_ReadBlock: start-on-event=ReadBlock, operation=PS_NVM_BLOCK_CMS_EPSSRLNUM.ReadBlock
      OIT_ReadBlock_PS_NVM_BLOCK_CMS_IGNCNTR_ReadBlock: start-on-event=ReadBlock, operation=PS_NVM_BLOCK_CMS_IGNCNTR.ReadBlock
      OIT_ReadBlock_PS_NVM_BLOCK_CMS_NXTRMANUFSCRATCHPAD_ReadBlock: start-on-event=ReadBlock, operation=PS_NVM_BLOCK_CMS_NXTRMANUFSCRATCHPAD.ReadBlock
      OIT_ReadBlock_PS_NVM_BLOCK_CMS_NXTRMEC_ReadBlock: start-on-event=ReadBlock, operation=PS_NVM_BLOCK_CMS_NXTRMEC.ReadBlock
      OIT_ReadBlock_PS_NVM_BLOCK_DIAGMGR_BLACKBOX_ReadBlock: start-on-event=ReadBlock, operation=PS_NVM_BLOCK_DIAGMGR_BLACKBOX.ReadBlock
      OIT_ReadBlock_PS_NVM_BLOCK_DIAGMGR_LATCHCNTRS_ReadBlock: start-on-event=ReadBlock, operation=PS_NVM_BLOCK_DIAGMGR_LATCHCNTRS.ReadBlock
      OIT_ReadBlock_PS_NVM_BLOCK_DIAGMGR_NTCSTRG_ReadBlock: start-on-event=ReadBlock, operation=PS_NVM_BLOCK_DIAGMGR_NTCSTRG.ReadBlock
      OIT_ReadBlock_PS_NVM_BLOCK_EPSDEFEATS_ReadBlock: start-on-event=ReadBlock, operation=PS_NVM_BLOCK_EPSDEFEATS.ReadBlock
      OIT_ReadBlock_PS_NVM_BLOCK_NXTRWIRSELECT_ReadBlock: start-on-event=ReadBlock, operation=PS_NVM_BLOCK_NXTRWIRSELECT.ReadBlock
      OIT_ReadBlock_PS_NVM_BLOCK_PROGREQCNT_ReadBlock: start-on-event=ReadBlock, operation=PS_NVM_BLOCK_PROGREQCNT.ReadBlock
      OIT_ReadBlock_PS_NVM_BLOCK_RESETRESP_ReadBlock: start-on-event=ReadBlock, operation=PS_NVM_BLOCK_RESETRESP.ReadBlock
      OIT_ReadBlock_PS_NVM_BLOCK_SECDLYEN_ReadBlock: start-on-event=ReadBlock, operation=PS_NVM_BLOCK_SECDLYEN.ReadBlock
      OIT_ReadBlock_PS_NVM_BLOCK_SER_ACTIVEDIAGINFO_APPL_ReadBlock: start-on-event=ReadBlock, operation=PS_NVM_BLOCK_SER_ACTIVEDIAGINFO_APPL.ReadBlock
      OIT_ReadBlock_PS_NVM_BLOCK_SER_ACTIVEDIAGINFO_BOOT_ReadBlock: start-on-event=ReadBlock, operation=PS_NVM_BLOCK_SER_ACTIVEDIAGINFO_BOOT.ReadBlock
      OIT_ReadBlock_PS_NVM_BLOCK_SER_BOOTSWVERSIONINFO_ReadBlock: start-on-event=ReadBlock, operation=PS_NVM_BLOCK_SER_BOOTSWVERSIONINFO.ReadBlock
      OIT_ReadBlock_PS_NVM_BLOCK_SER_DIAGSPECINFO_ReadBlock: start-on-event=ReadBlock, operation=PS_NVM_BLOCK_SER_DIAGSPECINFO.ReadBlock
      OIT_ReadBlock_PS_NVM_BLOCK_SER_ECUPN_ReadBlock: start-on-event=ReadBlock, operation=PS_NVM_BLOCK_SER_ECUPN.ReadBlock
      OIT_ReadBlock_PS_NVM_BLOCK_SER_ECUSERIALNUMBER_ReadBlock: start-on-event=ReadBlock, operation=PS_NVM_BLOCK_SER_ECUSERIALNUMBER.ReadBlock
      OIT_ReadBlock_PS_NVM_BLOCK_SER_HWPARTNUMBER_ReadBlock: start-on-event=ReadBlock, operation=PS_NVM_BLOCK_SER_HWPARTNUMBER.ReadBlock
      OIT_ReadBlock_PS_NVM_BLOCK_SER_HWSUPPID_ReadBlock: start-on-event=ReadBlock, operation=PS_NVM_BLOCK_SER_HWSUPPID.ReadBlock
      OIT_ReadBlock_PS_NVM_BLOCK_SER_HWVERSIONINFO_ReadBlock: start-on-event=ReadBlock, operation=PS_NVM_BLOCK_SER_HWVERSIONINFO.ReadBlock
      OIT_ReadBlock_PS_NVM_BLOCK_SER_METADATA_APPLICATION_ReadBlock: start-on-event=ReadBlock, operation=PS_NVM_BLOCK_SER_METADATA_APPLICATION.ReadBlock
      OIT_ReadBlock_PS_NVM_BLOCK_SER_METADATA_CAL1_ReadBlock: start-on-event=ReadBlock, operation=PS_NVM_BLOCK_SER_METADATA_CAL1.ReadBlock
      OIT_ReadBlock_PS_NVM_BLOCK_SER_METADATA_CAL2_ReadBlock: start-on-event=ReadBlock, operation=PS_NVM_BLOCK_SER_METADATA_CAL2.ReadBlock
      OIT_ReadBlock_PS_NVM_BLOCK_SER_RESPONEVENTACTVSTATE_ReadBlock: start-on-event=ReadBlock, operation=PS_NVM_BLOCK_SER_RESPONEVENTACTVSTATE.ReadBlock
      OIT_ReadBlock_PS_NVM_BLOCK_SER_VEHICLEINFO_ReadBlock: start-on-event=ReadBlock, operation=PS_NVM_BLOCK_SER_VEHICLEINFO.ReadBlock
      OIT_ReadBlock_PS_NVM_BLOCK_SER_VINCURRENT_ReadBlock: start-on-event=ReadBlock, operation=PS_NVM_BLOCK_SER_VINCURRENT.ReadBlock
      OIT_ReadBlock_PS_NVM_BLOCK_SER_VINODOMETERCOUNTER_ReadBlock: start-on-event=ReadBlock, operation=PS_NVM_BLOCK_SER_VINODOMETERCOUNTER.ReadBlock
      OIT_ReadBlock_PS_NVM_BLOCK_SER_VINORIGINAL_ReadBlock: start-on-event=ReadBlock, operation=PS_NVM_BLOCK_SER_VINORIGINAL.ReadBlock
      OIT_ReadBlock_PS_NVM_BLOCK_SWFINGERPRINT_ReadBlock: start-on-event=ReadBlock, operation=PS_NVM_BLOCK_SWFINGERPRINT.ReadBlock
      OIT_ReadBlock_PS_Rte_NvmBlock_Ap_AstLmt_SteerAsstDefeat_ReadBlock: start-on-event=ReadBlock, operation=PS_Rte_NvmBlock_Ap_AstLmt_SteerAsstDefeat.ReadBlock
      OIT_ReadBlock_PS_Rte_NvmBlock_Ap_AvgFricLrn_AvgFricLrnData_ReadBlock: start-on-event=ReadBlock, operation=PS_Rte_NvmBlock_Ap_AvgFricLrn_AvgFricLrnData.ReadBlock
      OIT_ReadBlock_PS_Rte_NvmBlock_Ap_TrqCanc_CogTrqRplComp_ReadBlock: start-on-event=ReadBlock, operation=PS_Rte_NvmBlock_Ap_TrqCanc_CogTrqRplComp.ReadBlock
      OIT_ReadBlock_PS_Rte_NvmBlock_BatteryVoltage_OvervoltageData_ReadBlock: start-on-event=ReadBlock, operation=PS_Rte_NvmBlock_BatteryVoltage_OvervoltageData.ReadBlock
      OIT_ReadBlock_PS_Rte_NvmBlock_CmMtrCurr_CurrTempOffset_ReadBlock: start-on-event=ReadBlock, operation=PS_Rte_NvmBlock_CmMtrCurr_CurrTempOffset.ReadBlock
      OIT_ReadBlock_PS_Rte_NvmBlock_CmMtrCurr_ShCurrCal_ReadBlock: start-on-event=ReadBlock, operation=PS_Rte_NvmBlock_CmMtrCurr_ShCurrCal.ReadBlock
      OIT_ReadBlock_PS_Rte_NvmBlock_CurrParamComp_EOLNomMtrParam_ReadBlock: start-on-event=ReadBlock, operation=PS_Rte_NvmBlock_CurrParamComp_EOLNomMtrParam.ReadBlock
      OIT_ReadBlock_PS_Rte_NvmBlock_HwTrq_EOLTrqStepData_ReadBlock: start-on-event=ReadBlock, operation=PS_Rte_NvmBlock_HwTrq_EOLTrqStepData.ReadBlock
      OIT_ReadBlock_PS_Rte_NvmBlock_HwTrq_HwTrqScaleData_ReadBlock: start-on-event=ReadBlock, operation=PS_Rte_NvmBlock_HwTrq_HwTrqScaleData.ReadBlock
      OIT_ReadBlock_PS_Rte_NvmBlock_HwTrq_HwTrqTrimData_ReadBlock: start-on-event=ReadBlock, operation=PS_Rte_NvmBlock_HwTrq_HwTrqTrimData.ReadBlock
      OIT_ReadBlock_PS_Rte_NvmBlock_IPMTrqCanc_CogTrqCal_ReadBlock: start-on-event=ReadBlock, operation=PS_Rte_NvmBlock_IPMTrqCanc_CogTrqCal.ReadBlock
      OIT_ReadBlock_PS_Rte_NvmBlock_LrnEOT_LearnedEOT_ReadBlock: start-on-event=ReadBlock, operation=PS_Rte_NvmBlock_LrnEOT_LearnedEOT.ReadBlock
      OIT_ReadBlock_PS_Rte_NvmBlock_MtrPos_MtrPosSnsr_EOLData_ReadBlock: start-on-event=ReadBlock, operation=PS_Rte_NvmBlock_MtrPos_MtrPosSnsr_EOLData.ReadBlock
      OIT_ReadBlock_PS_Rte_NvmBlock_Polarity_EOLCtrlPolarity_ReadBlock: start-on-event=ReadBlock, operation=PS_Rte_NvmBlock_Polarity_EOLCtrlPolarity.ReadBlock
      OIT_ReadBlock_PS_Rte_NvmBlock_StaMd_CloseCheckData_ReadBlock: start-on-event=ReadBlock, operation=PS_Rte_NvmBlock_StaMd_CloseCheckData.ReadBlock
      OIT_ReadBlock_PS_Rte_NvmBlock_StaMd_TypeHRamBuffer_ReadBlock: start-on-event=ReadBlock, operation=PS_Rte_NvmBlock_StaMd_TypeHRamBuffer.ReadBlock
      OIT_ReadBlock_PS_Rte_NvmBlock_TrqCmdScl_TorqueCmdSF_Uls_f32_ReadBlock: start-on-event=ReadBlock, operation=PS_Rte_NvmBlock_TrqCmdScl_TorqueCmdSF_Uls_f32.ReadBlock
      OIT_SetBlockProtection_PAdmin_ConfigBlock_SetBlockProtection: start-on-event=SetBlockProtection, operation=PAdmin_ConfigBlock.SetBlockProtection
      OIT_SetBlockProtection_PAdmin_NVM_BLOCK_CMS_ECUHWPN_SetBlockProtection: start-on-event=SetBlockProtection, operation=PAdmin_NVM_BLOCK_CMS_ECUHWPN.SetBlockProtection
      OIT_SetBlockProtection_PAdmin_NVM_BLOCK_CMS_ECUSRLNUM_SetBlockProtection: start-on-event=SetBlockProtection, operation=PAdmin_NVM_BLOCK_CMS_ECUSRLNUM.SetBlockProtection
      OIT_SetBlockProtection_PAdmin_NVM_BLOCK_CMS_EPSSRLNUM_SetBlockProtection: start-on-event=SetBlockProtection, operation=PAdmin_NVM_BLOCK_CMS_EPSSRLNUM.SetBlockProtection
      OIT_SetBlockProtection_PAdmin_NVM_BLOCK_CMS_IGNCNTR_SetBlockProtection: start-on-event=SetBlockProtection, operation=PAdmin_NVM_BLOCK_CMS_IGNCNTR.SetBlockProtection
      OIT_SetBlockProtection_PAdmin_NVM_BLOCK_CMS_NXTRMANUFSCRATCHPAD_SetBlockProtection: start-on-event=SetBlockProtection, operation=PAdmin_NVM_BLOCK_CMS_NXTRMANUFSCRATCHPAD.SetBlockProtection
      OIT_SetBlockProtection_PAdmin_NVM_BLOCK_CMS_NXTRMEC_SetBlockProtection: start-on-event=SetBlockProtection, operation=PAdmin_NVM_BLOCK_CMS_NXTRMEC.SetBlockProtection
      OIT_SetBlockProtection_PAdmin_NVM_BLOCK_DIAGMGR_BLACKBOX_SetBlockProtection: start-on-event=SetBlockProtection, operation=PAdmin_NVM_BLOCK_DIAGMGR_BLACKBOX.SetBlockProtection
      OIT_SetBlockProtection_PAdmin_NVM_BLOCK_DIAGMGR_LATCHCNTRS_SetBlockProtection: start-on-event=SetBlockProtection, operation=PAdmin_NVM_BLOCK_DIAGMGR_LATCHCNTRS.SetBlockProtection
      OIT_SetBlockProtection_PAdmin_NVM_BLOCK_DIAGMGR_NTCSTRG_SetBlockProtection: start-on-event=SetBlockProtection, operation=PAdmin_NVM_BLOCK_DIAGMGR_NTCSTRG.SetBlockProtection
      OIT_SetBlockProtection_PAdmin_NVM_BLOCK_EPSDEFEATS_SetBlockProtection: start-on-event=SetBlockProtection, operation=PAdmin_NVM_BLOCK_EPSDEFEATS.SetBlockProtection
      OIT_SetBlockProtection_PAdmin_NVM_BLOCK_NXTRWIRSELECT_SetBlockProtection: start-on-event=SetBlockProtection, operation=PAdmin_NVM_BLOCK_NXTRWIRSELECT.SetBlockProtection
      OIT_SetBlockProtection_PAdmin_NVM_BLOCK_PROGREQCNT_SetBlockProtection: start-on-event=SetBlockProtection, operation=PAdmin_NVM_BLOCK_PROGREQCNT.SetBlockProtection
      OIT_SetBlockProtection_PAdmin_NVM_BLOCK_RESETRESP_SetBlockProtection: start-on-event=SetBlockProtection, operation=PAdmin_NVM_BLOCK_RESETRESP.SetBlockProtection
      OIT_SetBlockProtection_PAdmin_NVM_BLOCK_SECDLYEN_SetBlockProtection: start-on-event=SetBlockProtection, operation=PAdmin_NVM_BLOCK_SECDLYEN.SetBlockProtection
      OIT_SetBlockProtection_PAdmin_NVM_BLOCK_SER_ACTIVEDIAGINFO_APPL_SetBlockProtection: start-on-event=SetBlockProtection, operation=PAdmin_NVM_BLOCK_SER_ACTIVEDIAGINFO_APPL.SetBlockProtection
      OIT_SetBlockProtection_PAdmin_NVM_BLOCK_SER_ACTIVEDIAGINFO_BOOT_SetBlockProtection: start-on-event=SetBlockProtection, operation=PAdmin_NVM_BLOCK_SER_ACTIVEDIAGINFO_BOOT.SetBlockProtection
      OIT_SetBlockProtection_PAdmin_NVM_BLOCK_SER_BOOTSWVERSIONINFO_SetBlockProtection: start-on-event=SetBlockProtection, operation=PAdmin_NVM_BLOCK_SER_BOOTSWVERSIONINFO.SetBlockProtection
      OIT_SetBlockProtection_PAdmin_NVM_BLOCK_SER_DIAGSPECINFO_SetBlockProtection: start-on-event=SetBlockProtection, operation=PAdmin_NVM_BLOCK_SER_DIAGSPECINFO.SetBlockProtection
      OIT_SetBlockProtection_PAdmin_NVM_BLOCK_SER_ECUPN_SetBlockProtection: start-on-event=SetBlockProtection, operation=PAdmin_NVM_BLOCK_SER_ECUPN.SetBlockProtection
      OIT_SetBlockProtection_PAdmin_NVM_BLOCK_SER_ECUSERIALNUMBER_SetBlockProtection: start-on-event=SetBlockProtection, operation=PAdmin_NVM_BLOCK_SER_ECUSERIALNUMBER.SetBlockProtection
      OIT_SetBlockProtection_PAdmin_NVM_BLOCK_SER_HWPARTNUMBER_SetBlockProtection: start-on-event=SetBlockProtection, operation=PAdmin_NVM_BLOCK_SER_HWPARTNUMBER.SetBlockProtection
      OIT_SetBlockProtection_PAdmin_NVM_BLOCK_SER_HWSUPPID_SetBlockProtection: start-on-event=SetBlockProtection, operation=PAdmin_NVM_BLOCK_SER_HWSUPPID.SetBlockProtection
      OIT_SetBlockProtection_PAdmin_NVM_BLOCK_SER_HWVERSIONINFO_SetBlockProtection: start-on-event=SetBlockProtection, operation=PAdmin_NVM_BLOCK_SER_HWVERSIONINFO.SetBlockProtection
      OIT_SetBlockProtection_PAdmin_NVM_BLOCK_SER_METADATA_APPLICATION_SetBlockProtection: start-on-event=SetBlockProtection, operation=PAdmin_NVM_BLOCK_SER_METADATA_APPLICATION.SetBlockProtection
      OIT_SetBlockProtection_PAdmin_NVM_BLOCK_SER_METADATA_CAL1_SetBlockProtection: start-on-event=SetBlockProtection, operation=PAdmin_NVM_BLOCK_SER_METADATA_CAL1.SetBlockProtection
      OIT_SetBlockProtection_PAdmin_NVM_BLOCK_SER_METADATA_CAL2_SetBlockProtection: start-on-event=SetBlockProtection, operation=PAdmin_NVM_BLOCK_SER_METADATA_CAL2.SetBlockProtection
      OIT_SetBlockProtection_PAdmin_NVM_BLOCK_SER_RESPONEVENTACTVSTATE_SetBlockProtection: start-on-event=SetBlockProtection, operation=PAdmin_NVM_BLOCK_SER_RESPONEVENTACTVSTATE.SetBlockProtection
      OIT_SetBlockProtection_PAdmin_NVM_BLOCK_SER_VEHICLEINFO_SetBlockProtection: start-on-event=SetBlockProtection, operation=PAdmin_NVM_BLOCK_SER_VEHICLEINFO.SetBlockProtection
      OIT_SetBlockProtection_PAdmin_NVM_BLOCK_SER_VINCURRENT_SetBlockProtection: start-on-event=SetBlockProtection, operation=PAdmin_NVM_BLOCK_SER_VINCURRENT.SetBlockProtection
      OIT_SetBlockProtection_PAdmin_NVM_BLOCK_SER_VINODOMETERCOUNTER_SetBlockProtection: start-on-event=SetBlockProtection, operation=PAdmin_NVM_BLOCK_SER_VINODOMETERCOUNTER.SetBlockProtection
      OIT_SetBlockProtection_PAdmin_NVM_BLOCK_SER_VINORIGINAL_SetBlockProtection: start-on-event=SetBlockProtection, operation=PAdmin_NVM_BLOCK_SER_VINORIGINAL.SetBlockProtection
      OIT_SetBlockProtection_PAdmin_NVM_BLOCK_SWFINGERPRINT_SetBlockProtection: start-on-event=SetBlockProtection, operation=PAdmin_NVM_BLOCK_SWFINGERPRINT.SetBlockProtection
      OIT_SetBlockProtection_PAdmin_Rte_NvmBlock_Ap_AstLmt_SteerAsstDefeat_SetBlockProtection: start-on-event=SetBlockProtection, operation=PAdmin_Rte_NvmBlock_Ap_AstLmt_SteerAsstDefeat.SetBlockProtection
      OIT_SetBlockProtection_PAdmin_Rte_NvmBlock_Ap_AvgFricLrn_AvgFricLrnData_SetBlockProtection: start-on-event=SetBlockProtection, operation=PAdmin_Rte_NvmBlock_Ap_AvgFricLrn_AvgFricLrnData.SetBlockProtection
      OIT_SetBlockProtection_PAdmin_Rte_NvmBlock_Ap_TrqCanc_CogTrqRplComp_SetBlockProtection: start-on-event=SetBlockProtection, operation=PAdmin_Rte_NvmBlock_Ap_TrqCanc_CogTrqRplComp.SetBlockProtection
      OIT_SetBlockProtection_PAdmin_Rte_NvmBlock_BatteryVoltage_OvervoltageData_SetBlockProtection: start-on-event=SetBlockProtection, operation=PAdmin_Rte_NvmBlock_BatteryVoltage_OvervoltageData.SetBlockProtection
      OIT_SetBlockProtection_PAdmin_Rte_NvmBlock_CmMtrCurr_CurrTempOffset_SetBlockProtection: start-on-event=SetBlockProtection, operation=PAdmin_Rte_NvmBlock_CmMtrCurr_CurrTempOffset.SetBlockProtection
      OIT_SetBlockProtection_PAdmin_Rte_NvmBlock_CmMtrCurr_ShCurrCal_SetBlockProtection: start-on-event=SetBlockProtection, operation=PAdmin_Rte_NvmBlock_CmMtrCurr_ShCurrCal.SetBlockProtection
      OIT_SetBlockProtection_PAdmin_Rte_NvmBlock_CurrParamComp_EOLNomMtrParam_SetBlockProtection: start-on-event=SetBlockProtection, operation=PAdmin_Rte_NvmBlock_CurrParamComp_EOLNomMtrParam.SetBlockProtection
      OIT_SetBlockProtection_PAdmin_Rte_NvmBlock_HwTrq_EOLTrqStepData_SetBlockProtection: start-on-event=SetBlockProtection, operation=PAdmin_Rte_NvmBlock_HwTrq_EOLTrqStepData.SetBlockProtection
      OIT_SetBlockProtection_PAdmin_Rte_NvmBlock_HwTrq_HwTrqScaleData_SetBlockProtection: start-on-event=SetBlockProtection, operation=PAdmin_Rte_NvmBlock_HwTrq_HwTrqScaleData.SetBlockProtection
      OIT_SetBlockProtection_PAdmin_Rte_NvmBlock_HwTrq_HwTrqTrimData_SetBlockProtection: start-on-event=SetBlockProtection, operation=PAdmin_Rte_NvmBlock_HwTrq_HwTrqTrimData.SetBlockProtection
      OIT_SetBlockProtection_PAdmin_Rte_NvmBlock_IPMTrqCanc_CogTrqCal_SetBlockProtection: start-on-event=SetBlockProtection, operation=PAdmin_Rte_NvmBlock_IPMTrqCanc_CogTrqCal.SetBlockProtection
      OIT_SetBlockProtection_PAdmin_Rte_NvmBlock_LrnEOT_LearnedEOT_SetBlockProtection: start-on-event=SetBlockProtection, operation=PAdmin_Rte_NvmBlock_LrnEOT_LearnedEOT.SetBlockProtection
      OIT_SetBlockProtection_PAdmin_Rte_NvmBlock_MtrPos_MtrPosSnsr_EOLData_SetBlockProtection: start-on-event=SetBlockProtection, operation=PAdmin_Rte_NvmBlock_MtrPos_MtrPosSnsr_EOLData.SetBlockProtection
      OIT_SetBlockProtection_PAdmin_Rte_NvmBlock_Polarity_EOLCtrlPolarity_SetBlockProtection: start-on-event=SetBlockProtection, operation=PAdmin_Rte_NvmBlock_Polarity_EOLCtrlPolarity.SetBlockProtection
      OIT_SetBlockProtection_PAdmin_Rte_NvmBlock_StaMd_CloseCheckData_SetBlockProtection: start-on-event=SetBlockProtection, operation=PAdmin_Rte_NvmBlock_StaMd_CloseCheckData.SetBlockProtection
      OIT_SetBlockProtection_PAdmin_Rte_NvmBlock_StaMd_TypeHRamBuffer_SetBlockProtection: start-on-event=SetBlockProtection, operation=PAdmin_Rte_NvmBlock_StaMd_TypeHRamBuffer.SetBlockProtection
      OIT_SetBlockProtection_PAdmin_Rte_NvmBlock_TrqCmdScl_TorqueCmdSF_Uls_f32_SetBlockProtection: start-on-event=SetBlockProtection, operation=PAdmin_Rte_NvmBlock_TrqCmdScl_TorqueCmdSF_Uls_f32.SetBlockProtection
      OIT_SetRamBlockStatus_PS_ConfigBlock_SetRamBlockStatus: start-on-event=SetRamBlockStatus, operation=PS_ConfigBlock.SetRamBlockStatus
      OIT_SetRamBlockStatus_PS_NVM_BLOCK_CMS_ECUHWPN_SetRamBlockStatus: start-on-event=SetRamBlockStatus, operation=PS_NVM_BLOCK_CMS_ECUHWPN.SetRamBlockStatus
      OIT_SetRamBlockStatus_PS_NVM_BLOCK_CMS_ECUSRLNUM_SetRamBlockStatus: start-on-event=SetRamBlockStatus, operation=PS_NVM_BLOCK_CMS_ECUSRLNUM.SetRamBlockStatus
      OIT_SetRamBlockStatus_PS_NVM_BLOCK_CMS_EPSSRLNUM_SetRamBlockStatus: start-on-event=SetRamBlockStatus, operation=PS_NVM_BLOCK_CMS_EPSSRLNUM.SetRamBlockStatus
      OIT_SetRamBlockStatus_PS_NVM_BLOCK_CMS_IGNCNTR_SetRamBlockStatus: start-on-event=SetRamBlockStatus, operation=PS_NVM_BLOCK_CMS_IGNCNTR.SetRamBlockStatus
      OIT_SetRamBlockStatus_PS_NVM_BLOCK_CMS_NXTRMANUFSCRATCHPAD_SetRamBlockStatus: start-on-event=SetRamBlockStatus, operation=PS_NVM_BLOCK_CMS_NXTRMANUFSCRATCHPAD.SetRamBlockStatus
      OIT_SetRamBlockStatus_PS_NVM_BLOCK_CMS_NXTRMEC_SetRamBlockStatus: start-on-event=SetRamBlockStatus, operation=PS_NVM_BLOCK_CMS_NXTRMEC.SetRamBlockStatus
      OIT_SetRamBlockStatus_PS_NVM_BLOCK_DIAGMGR_BLACKBOX_SetRamBlockStatus: start-on-event=SetRamBlockStatus, operation=PS_NVM_BLOCK_DIAGMGR_BLACKBOX.SetRamBlockStatus
      OIT_SetRamBlockStatus_PS_NVM_BLOCK_DIAGMGR_LATCHCNTRS_SetRamBlockStatus: start-on-event=SetRamBlockStatus, operation=PS_NVM_BLOCK_DIAGMGR_LATCHCNTRS.SetRamBlockStatus
      OIT_SetRamBlockStatus_PS_NVM_BLOCK_DIAGMGR_NTCSTRG_SetRamBlockStatus: start-on-event=SetRamBlockStatus, operation=PS_NVM_BLOCK_DIAGMGR_NTCSTRG.SetRamBlockStatus
      OIT_SetRamBlockStatus_PS_NVM_BLOCK_EPSDEFEATS_SetRamBlockStatus: start-on-event=SetRamBlockStatus, operation=PS_NVM_BLOCK_EPSDEFEATS.SetRamBlockStatus
      OIT_SetRamBlockStatus_PS_NVM_BLOCK_NXTRWIRSELECT_SetRamBlockStatus: start-on-event=SetRamBlockStatus, operation=PS_NVM_BLOCK_NXTRWIRSELECT.SetRamBlockStatus
      OIT_SetRamBlockStatus_PS_NVM_BLOCK_PROGREQCNT_SetRamBlockStatus: start-on-event=SetRamBlockStatus, operation=PS_NVM_BLOCK_PROGREQCNT.SetRamBlockStatus
      OIT_SetRamBlockStatus_PS_NVM_BLOCK_RESETRESP_SetRamBlockStatus: start-on-event=SetRamBlockStatus, operation=PS_NVM_BLOCK_RESETRESP.SetRamBlockStatus
      OIT_SetRamBlockStatus_PS_NVM_BLOCK_SECDLYEN_SetRamBlockStatus: start-on-event=SetRamBlockStatus, operation=PS_NVM_BLOCK_SECDLYEN.SetRamBlockStatus
      OIT_SetRamBlockStatus_PS_NVM_BLOCK_SER_ACTIVEDIAGINFO_APPL_SetRamBlockStatus: start-on-event=SetRamBlockStatus, operation=PS_NVM_BLOCK_SER_ACTIVEDIAGINFO_APPL.SetRamBlockStatus
      OIT_SetRamBlockStatus_PS_NVM_BLOCK_SER_ACTIVEDIAGINFO_BOOT_SetRamBlockStatus: start-on-event=SetRamBlockStatus, operation=PS_NVM_BLOCK_SER_ACTIVEDIAGINFO_BOOT.SetRamBlockStatus
      OIT_SetRamBlockStatus_PS_NVM_BLOCK_SER_BOOTSWVERSIONINFO_SetRamBlockStatus: start-on-event=SetRamBlockStatus, operation=PS_NVM_BLOCK_SER_BOOTSWVERSIONINFO.SetRamBlockStatus
      OIT_SetRamBlockStatus_PS_NVM_BLOCK_SER_DIAGSPECINFO_SetRamBlockStatus: start-on-event=SetRamBlockStatus, operation=PS_NVM_BLOCK_SER_DIAGSPECINFO.SetRamBlockStatus
      OIT_SetRamBlockStatus_PS_NVM_BLOCK_SER_ECUPN_SetRamBlockStatus: start-on-event=SetRamBlockStatus, operation=PS_NVM_BLOCK_SER_ECUPN.SetRamBlockStatus
      OIT_SetRamBlockStatus_PS_NVM_BLOCK_SER_ECUSERIALNUMBER_SetRamBlockStatus: start-on-event=SetRamBlockStatus, operation=PS_NVM_BLOCK_SER_ECUSERIALNUMBER.SetRamBlockStatus
      OIT_SetRamBlockStatus_PS_NVM_BLOCK_SER_HWPARTNUMBER_SetRamBlockStatus: start-on-event=SetRamBlockStatus, operation=PS_NVM_BLOCK_SER_HWPARTNUMBER.SetRamBlockStatus
      OIT_SetRamBlockStatus_PS_NVM_BLOCK_SER_HWSUPPID_SetRamBlockStatus: start-on-event=SetRamBlockStatus, operation=PS_NVM_BLOCK_SER_HWSUPPID.SetRamBlockStatus
      OIT_SetRamBlockStatus_PS_NVM_BLOCK_SER_HWVERSIONINFO_SetRamBlockStatus: start-on-event=SetRamBlockStatus, operation=PS_NVM_BLOCK_SER_HWVERSIONINFO.SetRamBlockStatus
      OIT_SetRamBlockStatus_PS_NVM_BLOCK_SER_METADATA_APPLICATION_SetRamBlockStatus: start-on-event=SetRamBlockStatus, operation=PS_NVM_BLOCK_SER_METADATA_APPLICATION.SetRamBlockStatus
      OIT_SetRamBlockStatus_PS_NVM_BLOCK_SER_METADATA_CAL1_SetRamBlockStatus: start-on-event=SetRamBlockStatus, operation=PS_NVM_BLOCK_SER_METADATA_CAL1.SetRamBlockStatus
      OIT_SetRamBlockStatus_PS_NVM_BLOCK_SER_METADATA_CAL2_SetRamBlockStatus: start-on-event=SetRamBlockStatus, operation=PS_NVM_BLOCK_SER_METADATA_CAL2.SetRamBlockStatus
      OIT_SetRamBlockStatus_PS_NVM_BLOCK_SER_RESPONEVENTACTVSTATE_SetRamBlockStatus: start-on-event=SetRamBlockStatus, operation=PS_NVM_BLOCK_SER_RESPONEVENTACTVSTATE.SetRamBlockStatus
      OIT_SetRamBlockStatus_PS_NVM_BLOCK_SER_VEHICLEINFO_SetRamBlockStatus: start-on-event=SetRamBlockStatus, operation=PS_NVM_BLOCK_SER_VEHICLEINFO.SetRamBlockStatus
      OIT_SetRamBlockStatus_PS_NVM_BLOCK_SER_VINCURRENT_SetRamBlockStatus: start-on-event=SetRamBlockStatus, operation=PS_NVM_BLOCK_SER_VINCURRENT.SetRamBlockStatus
      OIT_SetRamBlockStatus_PS_NVM_BLOCK_SER_VINODOMETERCOUNTER_SetRamBlockStatus: start-on-event=SetRamBlockStatus, operation=PS_NVM_BLOCK_SER_VINODOMETERCOUNTER.SetRamBlockStatus
      OIT_SetRamBlockStatus_PS_NVM_BLOCK_SER_VINORIGINAL_SetRamBlockStatus: start-on-event=SetRamBlockStatus, operation=PS_NVM_BLOCK_SER_VINORIGINAL.SetRamBlockStatus
      OIT_SetRamBlockStatus_PS_NVM_BLOCK_SWFINGERPRINT_SetRamBlockStatus: start-on-event=SetRamBlockStatus, operation=PS_NVM_BLOCK_SWFINGERPRINT.SetRamBlockStatus
      OIT_SetRamBlockStatus_PS_Rte_NvmBlock_Ap_AstLmt_SteerAsstDefeat_SetRamBlockStatus: start-on-event=SetRamBlockStatus, operation=PS_Rte_NvmBlock_Ap_AstLmt_SteerAsstDefeat.SetRamBlockStatus
      OIT_SetRamBlockStatus_PS_Rte_NvmBlock_Ap_AvgFricLrn_AvgFricLrnData_SetRamBlockStatus: start-on-event=SetRamBlockStatus, operation=PS_Rte_NvmBlock_Ap_AvgFricLrn_AvgFricLrnData.SetRamBlockStatus
      OIT_SetRamBlockStatus_PS_Rte_NvmBlock_Ap_TrqCanc_CogTrqRplComp_SetRamBlockStatus: start-on-event=SetRamBlockStatus, operation=PS_Rte_NvmBlock_Ap_TrqCanc_CogTrqRplComp.SetRamBlockStatus
      OIT_SetRamBlockStatus_PS_Rte_NvmBlock_BatteryVoltage_OvervoltageData_SetRamBlockStatus: start-on-event=SetRamBlockStatus, operation=PS_Rte_NvmBlock_BatteryVoltage_OvervoltageData.SetRamBlockStatus
      OIT_SetRamBlockStatus_PS_Rte_NvmBlock_CmMtrCurr_CurrTempOffset_SetRamBlockStatus: start-on-event=SetRamBlockStatus, operation=PS_Rte_NvmBlock_CmMtrCurr_CurrTempOffset.SetRamBlockStatus
      OIT_SetRamBlockStatus_PS_Rte_NvmBlock_CmMtrCurr_ShCurrCal_SetRamBlockStatus: start-on-event=SetRamBlockStatus, operation=PS_Rte_NvmBlock_CmMtrCurr_ShCurrCal.SetRamBlockStatus
      OIT_SetRamBlockStatus_PS_Rte_NvmBlock_CurrParamComp_EOLNomMtrParam_SetRamBlockStatus: start-on-event=SetRamBlockStatus, operation=PS_Rte_NvmBlock_CurrParamComp_EOLNomMtrParam.SetRamBlockStatus
      OIT_SetRamBlockStatus_PS_Rte_NvmBlock_HwTrq_EOLTrqStepData_SetRamBlockStatus: start-on-event=SetRamBlockStatus, operation=PS_Rte_NvmBlock_HwTrq_EOLTrqStepData.SetRamBlockStatus
      OIT_SetRamBlockStatus_PS_Rte_NvmBlock_HwTrq_HwTrqScaleData_SetRamBlockStatus: start-on-event=SetRamBlockStatus, operation=PS_Rte_NvmBlock_HwTrq_HwTrqScaleData.SetRamBlockStatus
      OIT_SetRamBlockStatus_PS_Rte_NvmBlock_HwTrq_HwTrqTrimData_SetRamBlockStatus: start-on-event=SetRamBlockStatus, operation=PS_Rte_NvmBlock_HwTrq_HwTrqTrimData.SetRamBlockStatus
      OIT_SetRamBlockStatus_PS_Rte_NvmBlock_IPMTrqCanc_CogTrqCal_SetRamBlockStatus: start-on-event=SetRamBlockStatus, operation=PS_Rte_NvmBlock_IPMTrqCanc_CogTrqCal.SetRamBlockStatus
      OIT_SetRamBlockStatus_PS_Rte_NvmBlock_LrnEOT_LearnedEOT_SetRamBlockStatus: start-on-event=SetRamBlockStatus, operation=PS_Rte_NvmBlock_LrnEOT_LearnedEOT.SetRamBlockStatus
      OIT_SetRamBlockStatus_PS_Rte_NvmBlock_MtrPos_MtrPosSnsr_EOLData_SetRamBlockStatus: start-on-event=SetRamBlockStatus, operation=PS_Rte_NvmBlock_MtrPos_MtrPosSnsr_EOLData.SetRamBlockStatus
      OIT_SetRamBlockStatus_PS_Rte_NvmBlock_Polarity_EOLCtrlPolarity_SetRamBlockStatus: start-on-event=SetRamBlockStatus, operation=PS_Rte_NvmBlock_Polarity_EOLCtrlPolarity.SetRamBlockStatus
      OIT_SetRamBlockStatus_PS_Rte_NvmBlock_StaMd_CloseCheckData_SetRamBlockStatus: start-on-event=SetRamBlockStatus, operation=PS_Rte_NvmBlock_StaMd_CloseCheckData.SetRamBlockStatus
      OIT_SetRamBlockStatus_PS_Rte_NvmBlock_StaMd_TypeHRamBuffer_SetRamBlockStatus: start-on-event=SetRamBlockStatus, operation=PS_Rte_NvmBlock_StaMd_TypeHRamBuffer.SetRamBlockStatus
      OIT_SetRamBlockStatus_PS_Rte_NvmBlock_TrqCmdScl_TorqueCmdSF_Uls_f32_SetRamBlockStatus: start-on-event=SetRamBlockStatus, operation=PS_Rte_NvmBlock_TrqCmdScl_TorqueCmdSF_Uls_f32.SetRamBlockStatus
      OIT_WriteBlock_PS_ConfigBlock_WriteBlock: start-on-event=WriteBlock, operation=PS_ConfigBlock.WriteBlock
      OIT_WriteBlock_PS_NVM_BLOCK_CMS_ECUHWPN_WriteBlock: start-on-event=WriteBlock, operation=PS_NVM_BLOCK_CMS_ECUHWPN.WriteBlock
      OIT_WriteBlock_PS_NVM_BLOCK_CMS_ECUSRLNUM_WriteBlock: start-on-event=WriteBlock, operation=PS_NVM_BLOCK_CMS_ECUSRLNUM.WriteBlock
      OIT_WriteBlock_PS_NVM_BLOCK_CMS_EPSSRLNUM_WriteBlock: start-on-event=WriteBlock, operation=PS_NVM_BLOCK_CMS_EPSSRLNUM.WriteBlock
      OIT_WriteBlock_PS_NVM_BLOCK_CMS_IGNCNTR_WriteBlock: start-on-event=WriteBlock, operation=PS_NVM_BLOCK_CMS_IGNCNTR.WriteBlock
      OIT_WriteBlock_PS_NVM_BLOCK_CMS_NXTRMANUFSCRATCHPAD_WriteBlock: start-on-event=WriteBlock, operation=PS_NVM_BLOCK_CMS_NXTRMANUFSCRATCHPAD.WriteBlock
      OIT_WriteBlock_PS_NVM_BLOCK_CMS_NXTRMEC_WriteBlock: start-on-event=WriteBlock, operation=PS_NVM_BLOCK_CMS_NXTRMEC.WriteBlock
      OIT_WriteBlock_PS_NVM_BLOCK_DIAGMGR_BLACKBOX_WriteBlock: start-on-event=WriteBlock, operation=PS_NVM_BLOCK_DIAGMGR_BLACKBOX.WriteBlock
      OIT_WriteBlock_PS_NVM_BLOCK_DIAGMGR_LATCHCNTRS_WriteBlock: start-on-event=WriteBlock, operation=PS_NVM_BLOCK_DIAGMGR_LATCHCNTRS.WriteBlock
      OIT_WriteBlock_PS_NVM_BLOCK_DIAGMGR_NTCSTRG_WriteBlock: start-on-event=WriteBlock, operation=PS_NVM_BLOCK_DIAGMGR_NTCSTRG.WriteBlock
      OIT_WriteBlock_PS_NVM_BLOCK_EPSDEFEATS_WriteBlock: start-on-event=WriteBlock, operation=PS_NVM_BLOCK_EPSDEFEATS.WriteBlock
      OIT_WriteBlock_PS_NVM_BLOCK_NXTRWIRSELECT_WriteBlock: start-on-event=WriteBlock, operation=PS_NVM_BLOCK_NXTRWIRSELECT.WriteBlock
      OIT_WriteBlock_PS_NVM_BLOCK_PROGREQCNT_WriteBlock: start-on-event=WriteBlock, operation=PS_NVM_BLOCK_PROGREQCNT.WriteBlock
      OIT_WriteBlock_PS_NVM_BLOCK_RESETRESP_WriteBlock: start-on-event=WriteBlock, operation=PS_NVM_BLOCK_RESETRESP.WriteBlock
      OIT_WriteBlock_PS_NVM_BLOCK_SECDLYEN_WriteBlock: start-on-event=WriteBlock, operation=PS_NVM_BLOCK_SECDLYEN.WriteBlock
      OIT_WriteBlock_PS_NVM_BLOCK_SER_ACTIVEDIAGINFO_APPL_WriteBlock: start-on-event=WriteBlock, operation=PS_NVM_BLOCK_SER_ACTIVEDIAGINFO_APPL.WriteBlock
      OIT_WriteBlock_PS_NVM_BLOCK_SER_ACTIVEDIAGINFO_BOOT_WriteBlock: start-on-event=WriteBlock, operation=PS_NVM_BLOCK_SER_ACTIVEDIAGINFO_BOOT.WriteBlock
      OIT_WriteBlock_PS_NVM_BLOCK_SER_BOOTSWVERSIONINFO_WriteBlock: start-on-event=WriteBlock, operation=PS_NVM_BLOCK_SER_BOOTSWVERSIONINFO.WriteBlock
      OIT_WriteBlock_PS_NVM_BLOCK_SER_DIAGSPECINFO_WriteBlock: start-on-event=WriteBlock, operation=PS_NVM_BLOCK_SER_DIAGSPECINFO.WriteBlock
      OIT_WriteBlock_PS_NVM_BLOCK_SER_ECUPN_WriteBlock: start-on-event=WriteBlock, operation=PS_NVM_BLOCK_SER_ECUPN.WriteBlock
      OIT_WriteBlock_PS_NVM_BLOCK_SER_ECUSERIALNUMBER_WriteBlock: start-on-event=WriteBlock, operation=PS_NVM_BLOCK_SER_ECUSERIALNUMBER.WriteBlock
      OIT_WriteBlock_PS_NVM_BLOCK_SER_HWPARTNUMBER_WriteBlock: start-on-event=WriteBlock, operation=PS_NVM_BLOCK_SER_HWPARTNUMBER.WriteBlock
      OIT_WriteBlock_PS_NVM_BLOCK_SER_HWSUPPID_WriteBlock: start-on-event=WriteBlock, operation=PS_NVM_BLOCK_SER_HWSUPPID.WriteBlock
      OIT_WriteBlock_PS_NVM_BLOCK_SER_HWVERSIONINFO_WriteBlock: start-on-event=WriteBlock, operation=PS_NVM_BLOCK_SER_HWVERSIONINFO.WriteBlock
      OIT_WriteBlock_PS_NVM_BLOCK_SER_METADATA_APPLICATION_WriteBlock: start-on-event=WriteBlock, operation=PS_NVM_BLOCK_SER_METADATA_APPLICATION.WriteBlock
      OIT_WriteBlock_PS_NVM_BLOCK_SER_METADATA_CAL1_WriteBlock: start-on-event=WriteBlock, operation=PS_NVM_BLOCK_SER_METADATA_CAL1.WriteBlock
      OIT_WriteBlock_PS_NVM_BLOCK_SER_METADATA_CAL2_WriteBlock: start-on-event=WriteBlock, operation=PS_NVM_BLOCK_SER_METADATA_CAL2.WriteBlock
      OIT_WriteBlock_PS_NVM_BLOCK_SER_RESPONEVENTACTVSTATE_WriteBlock: start-on-event=WriteBlock, operation=PS_NVM_BLOCK_SER_RESPONEVENTACTVSTATE.WriteBlock
      OIT_WriteBlock_PS_NVM_BLOCK_SER_VEHICLEINFO_WriteBlock: start-on-event=WriteBlock, operation=PS_NVM_BLOCK_SER_VEHICLEINFO.WriteBlock
      OIT_WriteBlock_PS_NVM_BLOCK_SER_VINCURRENT_WriteBlock: start-on-event=WriteBlock, operation=PS_NVM_BLOCK_SER_VINCURRENT.WriteBlock
      OIT_WriteBlock_PS_NVM_BLOCK_SER_VINODOMETERCOUNTER_WriteBlock: start-on-event=WriteBlock, operation=PS_NVM_BLOCK_SER_VINODOMETERCOUNTER.WriteBlock
      OIT_WriteBlock_PS_NVM_BLOCK_SER_VINORIGINAL_WriteBlock: start-on-event=WriteBlock, operation=PS_NVM_BLOCK_SER_VINORIGINAL.WriteBlock
      OIT_WriteBlock_PS_NVM_BLOCK_SWFINGERPRINT_WriteBlock: start-on-event=WriteBlock, operation=PS_NVM_BLOCK_SWFINGERPRINT.WriteBlock
      OIT_WriteBlock_PS_Rte_NvmBlock_Ap_AstLmt_SteerAsstDefeat_WriteBlock: start-on-event=WriteBlock, operation=PS_Rte_NvmBlock_Ap_AstLmt_SteerAsstDefeat.WriteBlock
      OIT_WriteBlock_PS_Rte_NvmBlock_Ap_AvgFricLrn_AvgFricLrnData_WriteBlock: start-on-event=WriteBlock, operation=PS_Rte_NvmBlock_Ap_AvgFricLrn_AvgFricLrnData.WriteBlock
      OIT_WriteBlock_PS_Rte_NvmBlock_Ap_TrqCanc_CogTrqRplComp_WriteBlock: start-on-event=WriteBlock, operation=PS_Rte_NvmBlock_Ap_TrqCanc_CogTrqRplComp.WriteBlock
      OIT_WriteBlock_PS_Rte_NvmBlock_BatteryVoltage_OvervoltageData_WriteBlock: start-on-event=WriteBlock, operation=PS_Rte_NvmBlock_BatteryVoltage_OvervoltageData.WriteBlock
      OIT_WriteBlock_PS_Rte_NvmBlock_CmMtrCurr_CurrTempOffset_WriteBlock: start-on-event=WriteBlock, operation=PS_Rte_NvmBlock_CmMtrCurr_CurrTempOffset.WriteBlock
      OIT_WriteBlock_PS_Rte_NvmBlock_CmMtrCurr_ShCurrCal_WriteBlock: start-on-event=WriteBlock, operation=PS_Rte_NvmBlock_CmMtrCurr_ShCurrCal.WriteBlock
      OIT_WriteBlock_PS_Rte_NvmBlock_CurrParamComp_EOLNomMtrParam_WriteBlock: start-on-event=WriteBlock, operation=PS_Rte_NvmBlock_CurrParamComp_EOLNomMtrParam.WriteBlock
      OIT_WriteBlock_PS_Rte_NvmBlock_HwTrq_EOLTrqStepData_WriteBlock: start-on-event=WriteBlock, operation=PS_Rte_NvmBlock_HwTrq_EOLTrqStepData.WriteBlock
      OIT_WriteBlock_PS_Rte_NvmBlock_HwTrq_HwTrqScaleData_WriteBlock: start-on-event=WriteBlock, operation=PS_Rte_NvmBlock_HwTrq_HwTrqScaleData.WriteBlock
      OIT_WriteBlock_PS_Rte_NvmBlock_HwTrq_HwTrqTrimData_WriteBlock: start-on-event=WriteBlock, operation=PS_Rte_NvmBlock_HwTrq_HwTrqTrimData.WriteBlock
      OIT_WriteBlock_PS_Rte_NvmBlock_IPMTrqCanc_CogTrqCal_WriteBlock: start-on-event=WriteBlock, operation=PS_Rte_NvmBlock_IPMTrqCanc_CogTrqCal.WriteBlock
      OIT_WriteBlock_PS_Rte_NvmBlock_LrnEOT_LearnedEOT_WriteBlock: start-on-event=WriteBlock, operation=PS_Rte_NvmBlock_LrnEOT_LearnedEOT.WriteBlock
      OIT_WriteBlock_PS_Rte_NvmBlock_MtrPos_MtrPosSnsr_EOLData_WriteBlock: start-on-event=WriteBlock, operation=PS_Rte_NvmBlock_MtrPos_MtrPosSnsr_EOLData.WriteBlock
      OIT_WriteBlock_PS_Rte_NvmBlock_Polarity_EOLCtrlPolarity_WriteBlock: start-on-event=WriteBlock, operation=PS_Rte_NvmBlock_Polarity_EOLCtrlPolarity.WriteBlock
      OIT_WriteBlock_PS_Rte_NvmBlock_StaMd_CloseCheckData_WriteBlock: start-on-event=WriteBlock, operation=PS_Rte_NvmBlock_StaMd_CloseCheckData.WriteBlock
      OIT_WriteBlock_PS_Rte_NvmBlock_StaMd_TypeHRamBuffer_WriteBlock: start-on-event=WriteBlock, operation=PS_Rte_NvmBlock_StaMd_TypeHRamBuffer.WriteBlock
      OIT_WriteBlock_PS_Rte_NvmBlock_TrqCmdScl_TorqueCmdSF_Uls_f32_WriteBlock: start-on-event=WriteBlock, operation=PS_Rte_NvmBlock_TrqCmdScl_TorqueCmdSF_Uls_f32.WriteBlock
    port-api-option enable-take-address=false, indirect-api=false, port=PAdmin_ConfigBlock:
      port-arg-values:
        integer literal NvM_AdminBlockId_1: type=NvM_BlockIdType, value=1
    port-api-option enable-take-address=false, indirect-api=false, port=PAdmin_NVM_BLOCK_CMS_ECUHWPN:
      port-arg-values:
        integer literal NvM_AdminBlockId_47: type=NvM_BlockIdType, value=47
    port-api-option enable-take-address=false, indirect-api=false, port=PAdmin_NVM_BLOCK_CMS_ECUSRLNUM:
      port-arg-values:
        integer literal NvM_AdminBlockId_34: type=NvM_BlockIdType, value=34
    port-api-option enable-take-address=false, indirect-api=false, port=PAdmin_NVM_BLOCK_CMS_EPSSRLNUM:
      port-arg-values:
        integer literal NvM_AdminBlockId_35: type=NvM_BlockIdType, value=35
    port-api-option enable-take-address=false, indirect-api=false, port=PAdmin_NVM_BLOCK_CMS_IGNCNTR:
      port-arg-values:
        integer literal NvM_AdminBlockId_38: type=NvM_BlockIdType, value=38
    port-api-option enable-take-address=false, indirect-api=false, port=PAdmin_NVM_BLOCK_CMS_NXTRMANUFSCRATCHPAD:
      port-arg-values:
        integer literal NvM_AdminBlockId_37: type=NvM_BlockIdType, value=37
    port-api-option enable-take-address=false, indirect-api=false, port=PAdmin_NVM_BLOCK_CMS_NXTRMEC:
      port-arg-values:
        integer literal NvM_AdminBlockId_33: type=NvM_BlockIdType, value=33
    port-api-option enable-take-address=false, indirect-api=false, port=PAdmin_NVM_BLOCK_DIAGMGR_BLACKBOX:
      port-arg-values:
        integer literal NvM_AdminBlockId_40: type=NvM_BlockIdType, value=40
    port-api-option enable-take-address=false, indirect-api=false, port=PAdmin_NVM_BLOCK_DIAGMGR_LATCHCNTRS:
      port-arg-values:
        integer literal NvM_AdminBlockId_43: type=NvM_BlockIdType, value=43
    port-api-option enable-take-address=false, indirect-api=false, port=PAdmin_NVM_BLOCK_DIAGMGR_NTCSTRG:
      port-arg-values:
        integer literal NvM_AdminBlockId_7: type=NvM_BlockIdType, value=7
    port-api-option enable-take-address=false, indirect-api=false, port=PAdmin_NVM_BLOCK_EPSDEFEATS:
      port-arg-values:
        integer literal NvM_AdminBlockId_8: type=NvM_BlockIdType, value=8
    port-api-option enable-take-address=false, indirect-api=false, port=PAdmin_NVM_BLOCK_NXTRWIRSELECT:
      port-arg-values:
        integer literal NvM_AdminBlockId_2: type=NvM_BlockIdType, value=2
    port-api-option enable-take-address=false, indirect-api=false, port=PAdmin_NVM_BLOCK_PROGREQCNT:
      port-arg-values:
        integer literal NvM_AdminBlockId_50: type=NvM_BlockIdType, value=50
    port-api-option enable-take-address=false, indirect-api=false, port=PAdmin_NVM_BLOCK_RESETRESP:
      port-arg-values:
        integer literal NvM_AdminBlockId_49: type=NvM_BlockIdType, value=49
    port-api-option enable-take-address=false, indirect-api=false, port=PAdmin_NVM_BLOCK_SECDLYEN:
      port-arg-values:
        integer literal NvM_AdminBlockId_51: type=NvM_BlockIdType, value=51
    port-api-option enable-take-address=false, indirect-api=false, port=PAdmin_NVM_BLOCK_SER_ACTIVEDIAGINFO_APPL:
      port-arg-values:
        integer literal NvM_AdminBlockId_32: type=NvM_BlockIdType, value=32
    port-api-option enable-take-address=false, indirect-api=false, port=PAdmin_NVM_BLOCK_SER_ACTIVEDIAGINFO_BOOT:
      port-arg-values:
        integer literal NvM_AdminBlockId_20: type=NvM_BlockIdType, value=20
    port-api-option enable-take-address=false, indirect-api=false, port=PAdmin_NVM_BLOCK_SER_BOOTSWVERSIONINFO:
      port-arg-values:
        integer literal NvM_AdminBlockId_23: type=NvM_BlockIdType, value=23
    port-api-option enable-take-address=false, indirect-api=false, port=PAdmin_NVM_BLOCK_SER_DIAGSPECINFO:
      port-arg-values:
        integer literal NvM_AdminBlockId_27: type=NvM_BlockIdType, value=27
    port-api-option enable-take-address=false, indirect-api=false, port=PAdmin_NVM_BLOCK_SER_ECUPN:
      port-arg-values:
        integer literal NvM_AdminBlockId_36: type=NvM_BlockIdType, value=36
    port-api-option enable-take-address=false, indirect-api=false, port=PAdmin_NVM_BLOCK_SER_ECUSERIALNUMBER:
      port-arg-values:
        integer literal NvM_AdminBlockId_29: type=NvM_BlockIdType, value=29
    port-api-option enable-take-address=false, indirect-api=false, port=PAdmin_NVM_BLOCK_SER_HWPARTNUMBER:
      port-arg-values:
        integer literal NvM_AdminBlockId_21: type=NvM_BlockIdType, value=21
    port-api-option enable-take-address=false, indirect-api=false, port=PAdmin_NVM_BLOCK_SER_HWSUPPID:
      port-arg-values:
        integer literal NvM_AdminBlockId_24: type=NvM_BlockIdType, value=24
    port-api-option enable-take-address=false, indirect-api=false, port=PAdmin_NVM_BLOCK_SER_HWVERSIONINFO:
      port-arg-values:
        integer literal NvM_AdminBlockId_22: type=NvM_BlockIdType, value=22
    port-api-option enable-take-address=false, indirect-api=false, port=PAdmin_NVM_BLOCK_SER_METADATA_APPLICATION:
      port-arg-values:
        integer literal NvM_AdminBlockId_17: type=NvM_BlockIdType, value=17
    port-api-option enable-take-address=false, indirect-api=false, port=PAdmin_NVM_BLOCK_SER_METADATA_CAL1:
      port-arg-values:
        integer literal NvM_AdminBlockId_18: type=NvM_BlockIdType, value=18
    port-api-option enable-take-address=false, indirect-api=false, port=PAdmin_NVM_BLOCK_SER_METADATA_CAL2:
      port-arg-values:
        integer literal NvM_AdminBlockId_19: type=NvM_BlockIdType, value=19
    port-api-option enable-take-address=false, indirect-api=false, port=PAdmin_NVM_BLOCK_SER_RESPONEVENTACTVSTATE:
      port-arg-values:
        integer literal NvM_AdminBlockId_25: type=NvM_BlockIdType, value=25
    port-api-option enable-take-address=false, indirect-api=false, port=PAdmin_NVM_BLOCK_SER_VEHICLEINFO:
      port-arg-values:
        integer literal NvM_AdminBlockId_28: type=NvM_BlockIdType, value=28
    port-api-option enable-take-address=false, indirect-api=false, port=PAdmin_NVM_BLOCK_SER_VINCURRENT:
      port-arg-values:
        integer literal NvM_AdminBlockId_30: type=NvM_BlockIdType, value=30
    port-api-option enable-take-address=false, indirect-api=false, port=PAdmin_NVM_BLOCK_SER_VINODOMETERCOUNTER:
      port-arg-values:
        integer literal NvM_AdminBlockId_26: type=NvM_BlockIdType, value=26
    port-api-option enable-take-address=false, indirect-api=false, port=PAdmin_NVM_BLOCK_SER_VINORIGINAL:
      port-arg-values:
        integer literal NvM_AdminBlockId_31: type=NvM_BlockIdType, value=31
    port-api-option enable-take-address=false, indirect-api=false, port=PAdmin_NVM_BLOCK_SWFINGERPRINT:
      port-arg-values:
        integer literal NvM_AdminBlockId_48: type=NvM_BlockIdType, value=48
    port-api-option enable-take-address=false, indirect-api=false, port=PAdmin_Rte_NvmBlock_Ap_AstLmt_SteerAsstDefeat:
      port-arg-values:
        integer literal NvM_AdminBlockId_46: type=NvM_BlockIdType, value=46
    port-api-option enable-take-address=false, indirect-api=false, port=PAdmin_Rte_NvmBlock_Ap_AvgFricLrn_AvgFricLrnData:
      port-arg-values:
        integer literal NvM_AdminBlockId_41: type=NvM_BlockIdType, value=41
    port-api-option enable-take-address=false, indirect-api=false, port=PAdmin_Rte_NvmBlock_Ap_TrqCanc_CogTrqRplComp:
      port-arg-values:
        integer literal NvM_AdminBlockId_45: type=NvM_BlockIdType, value=45
    port-api-option enable-take-address=false, indirect-api=false, port=PAdmin_Rte_NvmBlock_BatteryVoltage_OvervoltageData:
      port-arg-values:
        integer literal NvM_AdminBlockId_42: type=NvM_BlockIdType, value=42
    port-api-option enable-take-address=false, indirect-api=false, port=PAdmin_Rte_NvmBlock_CmMtrCurr_CurrTempOffset:
      port-arg-values:
        integer literal NvM_AdminBlockId_11: type=NvM_BlockIdType, value=11
    port-api-option enable-take-address=false, indirect-api=false, port=PAdmin_Rte_NvmBlock_CmMtrCurr_ShCurrCal:
      port-arg-values:
        integer literal NvM_AdminBlockId_12: type=NvM_BlockIdType, value=12
    port-api-option enable-take-address=false, indirect-api=false, port=PAdmin_Rte_NvmBlock_CurrParamComp_EOLNomMtrParam:
      port-arg-values:
        integer literal NvM_AdminBlockId_13: type=NvM_BlockIdType, value=13
    port-api-option enable-take-address=false, indirect-api=false, port=PAdmin_Rte_NvmBlock_HwTrq_EOLTrqStepData:
      port-arg-values:
        integer literal NvM_AdminBlockId_16: type=NvM_BlockIdType, value=16
    port-api-option enable-take-address=false, indirect-api=false, port=PAdmin_Rte_NvmBlock_HwTrq_HwTrqScaleData:
      port-arg-values:
        integer literal NvM_AdminBlockId_4: type=NvM_BlockIdType, value=4
    port-api-option enable-take-address=false, indirect-api=false, port=PAdmin_Rte_NvmBlock_HwTrq_HwTrqTrimData:
      port-arg-values:
        integer literal NvM_AdminBlockId_6: type=NvM_BlockIdType, value=6
    port-api-option enable-take-address=false, indirect-api=false, port=PAdmin_Rte_NvmBlock_IPMTrqCanc_CogTrqCal:
      port-arg-values:
        integer literal NvM_AdminBlockId_15: type=NvM_BlockIdType, value=15
    port-api-option enable-take-address=false, indirect-api=false, port=PAdmin_Rte_NvmBlock_LrnEOT_LearnedEOT:
      port-arg-values:
        integer literal NvM_AdminBlockId_14: type=NvM_BlockIdType, value=14
    port-api-option enable-take-address=false, indirect-api=false, port=PAdmin_Rte_NvmBlock_MtrPos_MtrPosSnsr_EOLData:
      port-arg-values:
        integer literal NvM_AdminBlockId_3: type=NvM_BlockIdType, value=3
    port-api-option enable-take-address=false, indirect-api=false, port=PAdmin_Rte_NvmBlock_Polarity_EOLCtrlPolarity:
      port-arg-values:
        integer literal NvM_AdminBlockId_5: type=NvM_BlockIdType, value=5
    port-api-option enable-take-address=false, indirect-api=false, port=PAdmin_Rte_NvmBlock_StaMd_CloseCheckData:
      port-arg-values:
        integer literal NvM_AdminBlockId_39: type=NvM_BlockIdType, value=39
    port-api-option enable-take-address=false, indirect-api=false, port=PAdmin_Rte_NvmBlock_StaMd_TypeHRamBuffer:
      port-arg-values:
        integer literal NvM_AdminBlockId_9: type=NvM_BlockIdType, value=9
    port-api-option enable-take-address=false, indirect-api=false, port=PAdmin_Rte_NvmBlock_TrqCmdScl_TorqueCmdSF_Uls_f32:
      port-arg-values:
        integer literal NvM_AdminBlockId_10: type=NvM_BlockIdType, value=10
    port-api-option enable-take-address=false, indirect-api=false, port=PS_ConfigBlock:
      port-arg-values:
        integer literal NvM_ServiceBlockId_1: type=NvM_BlockIdType, value=1
    port-api-option enable-take-address=false, indirect-api=false, port=PS_NVM_BLOCK_CMS_ECUHWPN:
      port-arg-values:
        integer literal NvM_ServiceBlockId_47: type=NvM_BlockIdType, value=47
    port-api-option enable-take-address=false, indirect-api=false, port=PS_NVM_BLOCK_CMS_ECUSRLNUM:
      port-arg-values:
        integer literal NvM_ServiceBlockId_34: type=NvM_BlockIdType, value=34
    port-api-option enable-take-address=false, indirect-api=false, port=PS_NVM_BLOCK_CMS_EPSSRLNUM:
      port-arg-values:
        integer literal NvM_ServiceBlockId_35: type=NvM_BlockIdType, value=35
    port-api-option enable-take-address=false, indirect-api=false, port=PS_NVM_BLOCK_CMS_IGNCNTR:
      port-arg-values:
        integer literal NvM_ServiceBlockId_38: type=NvM_BlockIdType, value=38
    port-api-option enable-take-address=false, indirect-api=false, port=PS_NVM_BLOCK_CMS_NXTRMANUFSCRATCHPAD:
      port-arg-values:
        integer literal NvM_ServiceBlockId_37: type=NvM_BlockIdType, value=37
    port-api-option enable-take-address=false, indirect-api=false, port=PS_NVM_BLOCK_CMS_NXTRMEC:
      port-arg-values:
        integer literal NvM_ServiceBlockId_33: type=NvM_BlockIdType, value=33
    port-api-option enable-take-address=false, indirect-api=false, port=PS_NVM_BLOCK_DIAGMGR_BLACKBOX:
      port-arg-values:
        integer literal NvM_ServiceBlockId_40: type=NvM_BlockIdType, value=40
    port-api-option enable-take-address=false, indirect-api=false, port=PS_NVM_BLOCK_DIAGMGR_LATCHCNTRS:
      port-arg-values:
        integer literal NvM_ServiceBlockId_43: type=NvM_BlockIdType, value=43
    port-api-option enable-take-address=false, indirect-api=false, port=PS_NVM_BLOCK_DIAGMGR_NTCSTRG:
      port-arg-values:
        integer literal NvM_ServiceBlockId_7: type=NvM_BlockIdType, value=7
    port-api-option enable-take-address=false, indirect-api=false, port=PS_NVM_BLOCK_EPSDEFEATS:
      port-arg-values:
        integer literal NvM_ServiceBlockId_8: type=NvM_BlockIdType, value=8
    port-api-option enable-take-address=false, indirect-api=false, port=PS_NVM_BLOCK_NXTRWIRSELECT:
      port-arg-values:
        integer literal NvM_ServiceBlockId_2: type=NvM_BlockIdType, value=2
    port-api-option enable-take-address=false, indirect-api=false, port=PS_NVM_BLOCK_PROGREQCNT:
      port-arg-values:
        integer literal NvM_ServiceBlockId_50: type=NvM_BlockIdType, value=50
    port-api-option enable-take-address=false, indirect-api=false, port=PS_NVM_BLOCK_RESETRESP:
      port-arg-values:
        integer literal NvM_ServiceBlockId_49: type=NvM_BlockIdType, value=49
    port-api-option enable-take-address=false, indirect-api=false, port=PS_NVM_BLOCK_SECDLYEN:
      port-arg-values:
        integer literal NvM_ServiceBlockId_51: type=NvM_BlockIdType, value=51
    port-api-option enable-take-address=false, indirect-api=false, port=PS_NVM_BLOCK_SER_ACTIVEDIAGINFO_APPL:
      port-arg-values:
        integer literal NvM_ServiceBlockId_32: type=NvM_BlockIdType, value=32
    port-api-option enable-take-address=false, indirect-api=false, port=PS_NVM_BLOCK_SER_ACTIVEDIAGINFO_BOOT:
      port-arg-values:
        integer literal NvM_ServiceBlockId_20: type=NvM_BlockIdType, value=20
    port-api-option enable-take-address=false, indirect-api=false, port=PS_NVM_BLOCK_SER_BOOTSWVERSIONINFO:
      port-arg-values:
        integer literal NvM_ServiceBlockId_23: type=NvM_BlockIdType, value=23
    port-api-option enable-take-address=false, indirect-api=false, port=PS_NVM_BLOCK_SER_DIAGSPECINFO:
      port-arg-values:
        integer literal NvM_ServiceBlockId_27: type=NvM_BlockIdType, value=27
    port-api-option enable-take-address=false, indirect-api=false, port=PS_NVM_BLOCK_SER_ECUPN:
      port-arg-values:
        integer literal NvM_ServiceBlockId_36: type=NvM_BlockIdType, value=36
    port-api-option enable-take-address=false, indirect-api=false, port=PS_NVM_BLOCK_SER_ECUSERIALNUMBER:
      port-arg-values:
        integer literal NvM_ServiceBlockId_29: type=NvM_BlockIdType, value=29
    port-api-option enable-take-address=false, indirect-api=false, port=PS_NVM_BLOCK_SER_HWPARTNUMBER:
      port-arg-values:
        integer literal NvM_ServiceBlockId_21: type=NvM_BlockIdType, value=21
    port-api-option enable-take-address=false, indirect-api=false, port=PS_NVM_BLOCK_SER_HWSUPPID:
      port-arg-values:
        integer literal NvM_ServiceBlockId_24: type=NvM_BlockIdType, value=24
    port-api-option enable-take-address=false, indirect-api=false, port=PS_NVM_BLOCK_SER_HWVERSIONINFO:
      port-arg-values:
        integer literal NvM_ServiceBlockId_22: type=NvM_BlockIdType, value=22
    port-api-option enable-take-address=false, indirect-api=false, port=PS_NVM_BLOCK_SER_METADATA_APPLICATION:
      port-arg-values:
        integer literal NvM_ServiceBlockId_17: type=NvM_BlockIdType, value=17
    port-api-option enable-take-address=false, indirect-api=false, port=PS_NVM_BLOCK_SER_METADATA_CAL1:
      port-arg-values:
        integer literal NvM_ServiceBlockId_18: type=NvM_BlockIdType, value=18
    port-api-option enable-take-address=false, indirect-api=false, port=PS_NVM_BLOCK_SER_METADATA_CAL2:
      port-arg-values:
        integer literal NvM_ServiceBlockId_19: type=NvM_BlockIdType, value=19
    port-api-option enable-take-address=false, indirect-api=false, port=PS_NVM_BLOCK_SER_RESPONEVENTACTVSTATE:
      port-arg-values:
        integer literal NvM_ServiceBlockId_25: type=NvM_BlockIdType, value=25
    port-api-option enable-take-address=false, indirect-api=false, port=PS_NVM_BLOCK_SER_VEHICLEINFO:
      port-arg-values:
        integer literal NvM_ServiceBlockId_28: type=NvM_BlockIdType, value=28
    port-api-option enable-take-address=false, indirect-api=false, port=PS_NVM_BLOCK_SER_VINCURRENT:
      port-arg-values:
        integer literal NvM_ServiceBlockId_30: type=NvM_BlockIdType, value=30
    port-api-option enable-take-address=false, indirect-api=false, port=PS_NVM_BLOCK_SER_VINODOMETERCOUNTER:
      port-arg-values:
        integer literal NvM_ServiceBlockId_26: type=NvM_BlockIdType, value=26
    port-api-option enable-take-address=false, indirect-api=false, port=PS_NVM_BLOCK_SER_VINORIGINAL:
      port-arg-values:
        integer literal NvM_ServiceBlockId_31: type=NvM_BlockIdType, value=31
    port-api-option enable-take-address=false, indirect-api=false, port=PS_NVM_BLOCK_SWFINGERPRINT:
      port-arg-values:
        integer literal NvM_ServiceBlockId_48: type=NvM_BlockIdType, value=48
    port-api-option enable-take-address=false, indirect-api=false, port=PS_Rte_NvmBlock_Ap_AstLmt_SteerAsstDefeat:
      port-arg-values:
        integer literal NvM_ServiceBlockId_46: type=NvM_BlockIdType, value=46
    port-api-option enable-take-address=false, indirect-api=false, port=PS_Rte_NvmBlock_Ap_AvgFricLrn_AvgFricLrnData:
      port-arg-values:
        integer literal NvM_ServiceBlockId_41: type=NvM_BlockIdType, value=41
    port-api-option enable-take-address=false, indirect-api=false, port=PS_Rte_NvmBlock_Ap_TrqCanc_CogTrqRplComp:
      port-arg-values:
        integer literal NvM_ServiceBlockId_45: type=NvM_BlockIdType, value=45
    port-api-option enable-take-address=false, indirect-api=false, port=PS_Rte_NvmBlock_BatteryVoltage_OvervoltageData:
      port-arg-values:
        integer literal NvM_ServiceBlockId_42: type=NvM_BlockIdType, value=42
    port-api-option enable-take-address=false, indirect-api=false, port=PS_Rte_NvmBlock_CmMtrCurr_CurrTempOffset:
      port-arg-values:
        integer literal NvM_ServiceBlockId_11: type=NvM_BlockIdType, value=11
    port-api-option enable-take-address=false, indirect-api=false, port=PS_Rte_NvmBlock_CmMtrCurr_ShCurrCal:
      port-arg-values:
        integer literal NvM_ServiceBlockId_12: type=NvM_BlockIdType, value=12
    port-api-option enable-take-address=false, indirect-api=false, port=PS_Rte_NvmBlock_CurrParamComp_EOLNomMtrParam:
      port-arg-values:
        integer literal NvM_ServiceBlockId_13: type=NvM_BlockIdType, value=13
    port-api-option enable-take-address=false, indirect-api=false, port=PS_Rte_NvmBlock_HwTrq_EOLTrqStepData:
      port-arg-values:
        integer literal NvM_ServiceBlockId_16: type=NvM_BlockIdType, value=16
    port-api-option enable-take-address=false, indirect-api=false, port=PS_Rte_NvmBlock_HwTrq_HwTrqScaleData:
      port-arg-values:
        integer literal NvM_ServiceBlockId_4: type=NvM_BlockIdType, value=4
    port-api-option enable-take-address=false, indirect-api=false, port=PS_Rte_NvmBlock_HwTrq_HwTrqTrimData:
      port-arg-values:
        integer literal NvM_ServiceBlockId_6: type=NvM_BlockIdType, value=6
    port-api-option enable-take-address=false, indirect-api=false, port=PS_Rte_NvmBlock_IPMTrqCanc_CogTrqCal:
      port-arg-values:
        integer literal NvM_ServiceBlockId_15: type=NvM_BlockIdType, value=15
    port-api-option enable-take-address=false, indirect-api=false, port=PS_Rte_NvmBlock_LrnEOT_LearnedEOT:
      port-arg-values:
        integer literal NvM_ServiceBlockId_14: type=NvM_BlockIdType, value=14
    port-api-option enable-take-address=false, indirect-api=false, port=PS_Rte_NvmBlock_MtrPos_MtrPosSnsr_EOLData:
      port-arg-values:
        integer literal NvM_ServiceBlockId_3: type=NvM_BlockIdType, value=3
    port-api-option enable-take-address=false, indirect-api=false, port=PS_Rte_NvmBlock_Polarity_EOLCtrlPolarity:
      port-arg-values:
        integer literal NvM_ServiceBlockId_5: type=NvM_BlockIdType, value=5
    port-api-option enable-take-address=false, indirect-api=false, port=PS_Rte_NvmBlock_StaMd_CloseCheckData:
      port-arg-values:
        integer literal NvM_ServiceBlockId_39: type=NvM_BlockIdType, value=39
    port-api-option enable-take-address=false, indirect-api=false, port=PS_Rte_NvmBlock_StaMd_TypeHRamBuffer:
      port-arg-values:
        integer literal NvM_ServiceBlockId_9: type=NvM_BlockIdType, value=9
    port-api-option enable-take-address=false, indirect-api=false, port=PS_Rte_NvmBlock_TrqCmdScl_TorqueCmdSF_Uls_f32:
      port-arg-values:
        integer literal NvM_ServiceBlockId_10: type=NvM_BlockIdType, value=10
    8 x runnable:
      EraseBlock: can-be-invoked-concurrently=true, symbol=NvM_EraseNvBlock
      GetErrorStatus: can-be-invoked-concurrently=true, symbol=NvM_GetErrorStatus
      InvalidateNvBlock: can-be-invoked-concurrently=true, symbol=NvM_InvalidateNvBlock
      NvM_MainFunction
      ReadBlock: can-be-invoked-concurrently=true, symbol=NvM_ReadBlock
      SetBlockProtection: can-be-invoked-concurrently=true, symbol=NvM_SetBlockProtection
      SetRamBlockStatus: can-be-invoked-concurrently=true, symbol=NvM_SetRamBlockStatus
      WriteBlock: can-be-invoked-concurrently=true, symbol=NvM_WriteBlock
  service component type NvM: category=ServiceComponent  # Software Component description for NvM generated from Ecuc Package: DaVinci_Project
    100 x provide port:
      PAdmin_ConfigBlock: server-com-spec{operation=SetBlockProtection, queue-length=1}, provided-interface=NvM_Administration  # P-Port Prototype of NvM_Administration for NVRAM Block ConfigBlock
      PAdmin_NVM_BLOCK_CMS_ECUHWPN: server-com-spec{operation=SetBlockProtection, queue-length=1}, provided-interface=NvM_Administration  # P-Port Prototype of NvM_Administration for NVRAM Block NVM_BLOCK_CMS_ECUHWPN
      PAdmin_NVM_BLOCK_CMS_ECUSRLNUM: server-com-spec{operation=SetBlockProtection, queue-length=1}, provided-interface=NvM_Administration  # P-Port Prototype of NvM_Administration for NVRAM Block NVM_BLOCK_CMS_ECUSRLNUM
      PAdmin_NVM_BLOCK_CMS_EPSSRLNUM: server-com-spec{operation=SetBlockProtection, queue-length=1}, provided-interface=NvM_Administration  # P-Port Prototype of NvM_Administration for NVRAM Block NVM_BLOCK_CMS_EPSSRLNUM
      PAdmin_NVM_BLOCK_CMS_IGNCNTR: server-com-spec{operation=SetBlockProtection, queue-length=1}, provided-interface=NvM_Administration  # P-Port Prototype of NvM_Administration for NVRAM Block NVM_BLOCK_CMS_IGNCNTR
      PAdmin_NVM_BLOCK_CMS_NXTRMANUFSCRATCHPAD: server-com-spec{operation=SetBlockProtection, queue-length=1}, provided-interface=NvM_Administration  # P-Port Prototype of NvM_Administration for NVRAM Block NVM_BLOCK_CMS_NXTRMANUFSCRATCHPAD
      PAdmin_NVM_BLOCK_CMS_NXTRMEC: server-com-spec{operation=SetBlockProtection, queue-length=1}, provided-interface=NvM_Administration  # P-Port Prototype of NvM_Administration for NVRAM Block NVM_BLOCK_CMS_NXTRMEC
      PAdmin_NVM_BLOCK_DIAGMGR_BLACKBOX: server-com-spec{operation=SetBlockProtection, queue-length=1}, provided-interface=NvM_Administration  # P-Port Prototype of NvM_Administration for NVRAM Block NVM_BLOCK_DIAGMGR_BLACKBOX
      PAdmin_NVM_BLOCK_DIAGMGR_LATCHCNTRS: server-com-spec{operation=SetBlockProtection, queue-length=1}, provided-interface=NvM_Administration  # P-Port Prototype of NvM_Administration for NVRAM Block NVM_BLOCK_DIAGMGR_LATCHCNTRS
      PAdmin_NVM_BLOCK_DIAGMGR_NTCSTRG: server-com-spec{operation=SetBlockProtection, queue-length=1}, provided-interface=NvM_Administration  # P-Port Prototype of NvM_Administration for NVRAM Block NVM_BLOCK_DIAGMGR_NTCSTRG
      PAdmin_NVM_BLOCK_EPSDEFEATS: server-com-spec{operation=SetBlockProtection, queue-length=1}, provided-interface=NvM_Administration  # P-Port Prototype of NvM_Administration for NVRAM Block NVM_BLOCK_EPSDEFEATS
      PAdmin_NVM_BLOCK_NXTRWIRSELECT: server-com-spec{operation=SetBlockProtection, queue-length=1}, provided-interface=NvM_Administration  # P-Port Prototype of NvM_Administration for NVRAM Block NVM_BLOCK_NXTRWIRSELECT
      PAdmin_NVM_BLOCK_PROGREQCNT: server-com-spec{operation=SetBlockProtection, queue-length=1}, provided-interface=NvM_Administration  # P-Port Prototype of NvM_Administration for NVRAM Block NVM_BLOCK_PROGREQCNT
      PAdmin_NVM_BLOCK_RESETRESP: server-com-spec{operation=SetBlockProtection, queue-length=1}, provided-interface=NvM_Administration  # P-Port Prototype of NvM_Administration for NVRAM Block NVM_BLOCK_RESETRESP
      PAdmin_NVM_BLOCK_SECDLYEN: server-com-spec{operation=SetBlockProtection, queue-length=1}, provided-interface=NvM_Administration  # P-Port Prototype of NvM_Administration for NVRAM Block NVM_BLOCK_SECDLYEN
      PAdmin_NVM_BLOCK_SER_ACTIVEDIAGINFO_APPL: server-com-spec{operation=SetBlockProtection, queue-length=1}, provided-interface=NvM_Administration  # P-Port Prototype of NvM_Administration for NVRAM Block NVM_BLOCK_SER_ACTIVEDIAGINFO_APPL
      PAdmin_NVM_BLOCK_SER_ACTIVEDIAGINFO_BOOT: server-com-spec{operation=SetBlockProtection, queue-length=1}, provided-interface=NvM_Administration  # P-Port Prototype of NvM_Administration for NVRAM Block NVM_BLOCK_SER_ACTIVEDIAGINFO_BOOT
      PAdmin_NVM_BLOCK_SER_BOOTSWVERSIONINFO: server-com-spec{operation=SetBlockProtection, queue-length=1}, provided-interface=NvM_Administration  # P-Port Prototype of NvM_Administration for NVRAM Block NVM_BLOCK_SER_BOOTSWVERSIONINFO
      PAdmin_NVM_BLOCK_SER_DIAGSPECINFO: server-com-spec{operation=SetBlockProtection, queue-length=1}, provided-interface=NvM_Administration  # P-Port Prototype of NvM_Administration for NVRAM Block NVM_BLOCK_SER_DIAGSPECINFO
      PAdmin_NVM_BLOCK_SER_ECUPN: server-com-spec{operation=SetBlockProtection, queue-length=1}, provided-interface=NvM_Administration  # P-Port Prototype of NvM_Administration for NVRAM Block NVM_BLOCK_SER_ECUPN
      PAdmin_NVM_BLOCK_SER_ECUSERIALNUMBER: server-com-spec{operation=SetBlockProtection, queue-length=1}, provided-interface=NvM_Administration  # P-Port Prototype of NvM_Administration for NVRAM Block NVM_BLOCK_SER_ECUSERIALNUMBER
      PAdmin_NVM_BLOCK_SER_HWPARTNUMBER: server-com-spec{operation=SetBlockProtection, queue-length=1}, provided-interface=NvM_Administration  # P-Port Prototype of NvM_Administration for NVRAM Block NVM_BLOCK_SER_HWPARTNUMBER
      PAdmin_NVM_BLOCK_SER_HWSUPPID: server-com-spec{operation=SetBlockProtection, queue-length=1}, provided-interface=NvM_Administration  # P-Port Prototype of NvM_Administration for NVRAM Block NVM_BLOCK_SER_HWSUPPID
      PAdmin_NVM_BLOCK_SER_HWVERSIONINFO: server-com-spec{operation=SetBlockProtection, queue-length=1}, provided-interface=NvM_Administration  # P-Port Prototype of NvM_Administration for NVRAM Block NVM_BLOCK_SER_HWVERSIONINFO
      PAdmin_NVM_BLOCK_SER_METADATA_APPLICATION: server-com-spec{operation=SetBlockProtection, queue-length=1}, provided-interface=NvM_Administration  # P-Port Prototype of NvM_Administration for NVRAM Block NVM_BLOCK_SER_METADATA_APPLICATION
      PAdmin_NVM_BLOCK_SER_METADATA_CAL1: server-com-spec{operation=SetBlockProtection, queue-length=1}, provided-interface=NvM_Administration  # P-Port Prototype of NvM_Administration for NVRAM Block NVM_BLOCK_SER_METADATA_CAL1
      PAdmin_NVM_BLOCK_SER_METADATA_CAL2: server-com-spec{operation=SetBlockProtection, queue-length=1}, provided-interface=NvM_Administration  # P-Port Prototype of NvM_Administration for NVRAM Block NVM_BLOCK_SER_METADATA_CAL2
      PAdmin_NVM_BLOCK_SER_RESPONEVENTACTVSTATE: server-com-spec{operation=SetBlockProtection, queue-length=1}, provided-interface=NvM_Administration  # P-Port Prototype of NvM_Administration for NVRAM Block NVM_BLOCK_SER_RESPONEVENTACTVSTATE
      PAdmin_NVM_BLOCK_SER_VEHICLEINFO: server-com-spec{operation=SetBlockProtection, queue-length=1}, provided-interface=NvM_Administration  # P-Port Prototype of NvM_Administration for NVRAM Block NVM_BLOCK_SER_VEHICLEINFO
      PAdmin_NVM_BLOCK_SER_VINCURRENT: server-com-spec{operation=SetBlockProtection, queue-length=1}, provided-interface=NvM_Administration  # P-Port Prototype of NvM_Administration for NVRAM Block NVM_BLOCK_SER_VINCURRENT
      PAdmin_NVM_BLOCK_SER_VINODOMETERCOUNTER: server-com-spec{operation=SetBlockProtection, queue-length=1}, provided-interface=NvM_Administration  # P-Port Prototype of NvM_Administration for NVRAM Block NVM_BLOCK_SER_VINODOMETERCOUNTER
      PAdmin_NVM_BLOCK_SER_VINORIGINAL: server-com-spec{operation=SetBlockProtection, queue-length=1}, provided-interface=NvM_Administration  # P-Port Prototype of NvM_Administration for NVRAM Block NVM_BLOCK_SER_VINORIGINAL
      PAdmin_NVM_BLOCK_SWFINGERPRINT: server-com-spec{operation=SetBlockProtection, queue-length=1}, provided-interface=NvM_Administration  # P-Port Prototype of NvM_Administration for NVRAM Block NVM_BLOCK_SWFINGERPRINT
      PAdmin_Rte_NvmBlock_Ap_AstLmt_SteerAsstDefeat: server-com-spec{operation=SetBlockProtection, queue-length=1}, provided-interface=NvM_Administration  # P-Port Prototype of NvM_Administration for NVRAM Block Rte_NvmBlock_Ap_AstLmt_SteerAsstDefeat
      PAdmin_Rte_NvmBlock_Ap_AvgFricLrn_AvgFricLrnData: server-com-spec{operation=SetBlockProtection, queue-length=1}, provided-interface=NvM_Administration  # P-Port Prototype of NvM_Administration for NVRAM Block Rte_NvmBlock_Ap_AvgFricLrn_AvgFricLrnData
      PAdmin_Rte_NvmBlock_Ap_TrqCanc_CogTrqRplComp: server-com-spec{operation=SetBlockProtection, queue-length=1}, provided-interface=NvM_Administration  # P-Port Prototype of NvM_Administration for NVRAM Block Rte_NvmBlock_Ap_TrqCanc_CogTrqRplComp
      PAdmin_Rte_NvmBlock_BatteryVoltage_OvervoltageData: server-com-spec{operation=SetBlockProtection, queue-length=1}, provided-interface=NvM_Administration  # P-Port Prototype of NvM_Administration for NVRAM Block Rte_NvmBlock_BatteryVoltage_OvervoltageData
      PAdmin_Rte_NvmBlock_CmMtrCurr_CurrTempOffset: server-com-spec{operation=SetBlockProtection, queue-length=1}, provided-interface=NvM_Administration  # P-Port Prototype of NvM_Administration for NVRAM Block Rte_NvmBlock_CmMtrCurr_CurrTempOffset
      PAdmin_Rte_NvmBlock_CmMtrCurr_ShCurrCal: server-com-spec{operation=SetBlockProtection, queue-length=1}, provided-interface=NvM_Administration  # P-Port Prototype of NvM_Administration for NVRAM Block Rte_NvmBlock_CmMtrCurr_ShCurrCal
      PAdmin_Rte_NvmBlock_CurrParamComp_EOLNomMtrParam: server-com-spec{operation=SetBlockProtection, queue-length=1}, provided-interface=NvM_Administration  # P-Port Prototype of NvM_Administration for NVRAM Block Rte_NvmBlock_CurrParamComp_EOLNomMtrParam
      PAdmin_Rte_NvmBlock_HwTrq_EOLTrqStepData: server-com-spec{operation=SetBlockProtection, queue-length=1}, provided-interface=NvM_Administration  # P-Port Prototype of NvM_Administration for NVRAM Block Rte_NvmBlock_HwTrq_EOLTrqStepData
      PAdmin_Rte_NvmBlock_HwTrq_HwTrqScaleData: server-com-spec{operation=SetBlockProtection, queue-length=1}, provided-interface=NvM_Administration  # P-Port Prototype of NvM_Administration for NVRAM Block Rte_NvmBlock_HwTrq_HwTrqScaleData
      PAdmin_Rte_NvmBlock_HwTrq_HwTrqTrimData: server-com-spec{operation=SetBlockProtection, queue-length=1}, provided-interface=NvM_Administration  # P-Port Prototype of NvM_Administration for NVRAM Block Rte_NvmBlock_HwTrq_HwTrqTrimData
      PAdmin_Rte_NvmBlock_IPMTrqCanc_CogTrqCal: server-com-spec{operation=SetBlockProtection, queue-length=1}, provided-interface=NvM_Administration  # P-Port Prototype of NvM_Administration for NVRAM Block Rte_NvmBlock_IPMTrqCanc_CogTrqCal
      PAdmin_Rte_NvmBlock_LrnEOT_LearnedEOT: server-com-spec{operation=SetBlockProtection, queue-length=1}, provided-interface=NvM_Administration  # P-Port Prototype of NvM_Administration for NVRAM Block Rte_NvmBlock_LrnEOT_LearnedEOT
      PAdmin_Rte_NvmBlock_MtrPos_MtrPosSnsr_EOLData: server-com-spec{operation=SetBlockProtection, queue-length=1}, provided-interface=NvM_Administration  # P-Port Prototype of NvM_Administration for NVRAM Block Rte_NvmBlock_MtrPos_MtrPosSnsr_EOLData
      PAdmin_Rte_NvmBlock_Polarity_EOLCtrlPolarity: server-com-spec{operation=SetBlockProtection, queue-length=1}, provided-interface=NvM_Administration  # P-Port Prototype of NvM_Administration for NVRAM Block Rte_NvmBlock_Polarity_EOLCtrlPolarity
      PAdmin_Rte_NvmBlock_StaMd_CloseCheckData: server-com-spec{operation=SetBlockProtection, queue-length=1}, provided-interface=NvM_Administration  # P-Port Prototype of NvM_Administration for NVRAM Block Rte_NvmBlock_StaMd_CloseCheckData
      PAdmin_Rte_NvmBlock_StaMd_TypeHRamBuffer: server-com-spec{operation=SetBlockProtection, queue-length=1}, provided-interface=NvM_Administration  # P-Port Prototype of NvM_Administration for NVRAM Block Rte_NvmBlock_StaMd_TypeHRamBuffer
      PAdmin_Rte_NvmBlock_TrqCmdScl_TorqueCmdSF_Uls_f32: server-com-spec{operation=SetBlockProtection, queue-length=1}, provided-interface=NvM_Administration  # P-Port Prototype of NvM_Administration for NVRAM Block Rte_NvmBlock_TrqCmdScl_TorqueCmdSF_Uls_f32
      PS_ConfigBlock: provided-interface=NvM_AC3_SRBS_Srv  # P-Port Prototype of NvM_AC3_SRBS_Srv for NVRAM Block ConfigBlock
        provided-com-specs:
          operation=EraseBlock, queue-length=1
          operation=GetErrorStatus, queue-length=1
          operation=InvalidateNvBlock, queue-length=1
          operation=ReadBlock, queue-length=1
          operation=SetRamBlockStatus, queue-length=1
          operation=WriteBlock, queue-length=1
      PS_NVM_BLOCK_CMS_ECUHWPN: provided-interface=NvM_AC3_SRBS_Srv  # P-Port Prototype of NvM_AC3_SRBS_Srv for NVRAM Block NVM_BLOCK_CMS_ECUHWPN
        provided-com-specs:
          operation=EraseBlock, queue-length=1
          operation=GetErrorStatus, queue-length=1
          operation=InvalidateNvBlock, queue-length=1
          operation=ReadBlock, queue-length=1
          operation=SetRamBlockStatus, queue-length=1
          operation=WriteBlock, queue-length=1
      PS_NVM_BLOCK_CMS_ECUSRLNUM: provided-interface=NvM_AC3_SRBS_Srv  # P-Port Prototype of NvM_AC3_SRBS_Srv for NVRAM Block NVM_BLOCK_CMS_ECUSRLNUM
        provided-com-specs:
          operation=EraseBlock, queue-length=1
          operation=GetErrorStatus, queue-length=1
          operation=InvalidateNvBlock, queue-length=1
          operation=ReadBlock, queue-length=1
          operation=SetRamBlockStatus, queue-length=1
          operation=WriteBlock, queue-length=1
      PS_NVM_BLOCK_CMS_EPSSRLNUM: provided-interface=NvM_AC3_SRBS_Srv  # P-Port Prototype of NvM_AC3_SRBS_Srv for NVRAM Block NVM_BLOCK_CMS_EPSSRLNUM
        provided-com-specs:
          operation=EraseBlock, queue-length=1
          operation=GetErrorStatus, queue-length=1
          operation=InvalidateNvBlock, queue-length=1
          operation=ReadBlock, queue-length=1
          operation=SetRamBlockStatus, queue-length=1
          operation=WriteBlock, queue-length=1
      PS_NVM_BLOCK_CMS_IGNCNTR: provided-interface=NvM_AC3_SRBS_Srv  # P-Port Prototype of NvM_AC3_SRBS_Srv for NVRAM Block NVM_BLOCK_CMS_IGNCNTR
        provided-com-specs:
          operation=EraseBlock, queue-length=1
          operation=GetErrorStatus, queue-length=1
          operation=InvalidateNvBlock, queue-length=1
          operation=ReadBlock, queue-length=1
          operation=SetRamBlockStatus, queue-length=1
          operation=WriteBlock, queue-length=1
      PS_NVM_BLOCK_CMS_NXTRMANUFSCRATCHPAD: provided-interface=NvM_AC3_SRBS_Srv  # P-Port Prototype of NvM_AC3_SRBS_Srv for NVRAM Block NVM_BLOCK_CMS_NXTRMANUFSCRATCHPAD
        provided-com-specs:
          operation=EraseBlock, queue-length=1
          operation=GetErrorStatus, queue-length=1
          operation=InvalidateNvBlock, queue-length=1
          operation=ReadBlock, queue-length=1
          operation=SetRamBlockStatus, queue-length=1
          operation=WriteBlock, queue-length=1
      PS_NVM_BLOCK_CMS_NXTRMEC: provided-interface=NvM_AC3_SRBS_Srv  # P-Port Prototype of NvM_AC3_SRBS_Srv for NVRAM Block NVM_BLOCK_CMS_NXTRMEC
        provided-com-specs:
          operation=EraseBlock, queue-length=1
          operation=GetErrorStatus, queue-length=1
          operation=InvalidateNvBlock, queue-length=1
          operation=ReadBlock, queue-length=1
          operation=SetRamBlockStatus, queue-length=1
          operation=WriteBlock, queue-length=1
      PS_NVM_BLOCK_DIAGMGR_BLACKBOX: provided-interface=NvM_AC3_SRBS_Srv  # P-Port Prototype of NvM_AC3_SRBS_Srv for NVRAM Block NVM_BLOCK_DIAGMGR_BLACKBOX
        provided-com-specs:
          operation=EraseBlock, queue-length=1
          operation=GetErrorStatus, queue-length=1
          operation=InvalidateNvBlock, queue-length=1
          operation=ReadBlock, queue-length=1
          operation=SetRamBlockStatus, queue-length=1
          operation=WriteBlock, queue-length=1
      PS_NVM_BLOCK_DIAGMGR_LATCHCNTRS: provided-interface=NvM_AC3_SRBS_Srv  # P-Port Prototype of NvM_AC3_SRBS_Srv for NVRAM Block NVM_BLOCK_DIAGMGR_LATCHCNTRS
        provided-com-specs:
          operation=EraseBlock, queue-length=1
          operation=GetErrorStatus, queue-length=1
          operation=InvalidateNvBlock, queue-length=1
          operation=ReadBlock, queue-length=1
          operation=SetRamBlockStatus, queue-length=1
          operation=WriteBlock, queue-length=1
      PS_NVM_BLOCK_DIAGMGR_NTCSTRG: provided-interface=NvM_AC3_SRBS_Srv  # P-Port Prototype of NvM_AC3_SRBS_Srv for NVRAM Block NVM_BLOCK_DIAGMGR_NTCSTRG
        provided-com-specs:
          operation=EraseBlock, queue-length=1
          operation=GetErrorStatus, queue-length=1
          operation=InvalidateNvBlock, queue-length=1
          operation=ReadBlock, queue-length=1
          operation=SetRamBlockStatus, queue-length=1
          operation=WriteBlock, queue-length=1
      PS_NVM_BLOCK_EPSDEFEATS: provided-interface=NvM_AC3_SRBS_Srv  # P-Port Prototype of NvM_AC3_SRBS_Srv for NVRAM Block NVM_BLOCK_EPSDEFEATS
        provided-com-specs:
          operation=EraseBlock, queue-length=1
          operation=GetErrorStatus, queue-length=1
          operation=InvalidateNvBlock, queue-length=1
          operation=ReadBlock, queue-length=1
          operation=SetRamBlockStatus, queue-length=1
          operation=WriteBlock, queue-length=1
      PS_NVM_BLOCK_NXTRWIRSELECT: provided-interface=NvM_AC3_SRBS_Srv  # P-Port Prototype of NvM_AC3_SRBS_Srv for NVRAM Block NVM_BLOCK_NXTRWIRSELECT
        provided-com-specs:
          operation=EraseBlock, queue-length=1
          operation=GetErrorStatus, queue-length=1
          operation=InvalidateNvBlock, queue-length=1
          operation=ReadBlock, queue-length=1
          operation=SetRamBlockStatus, queue-length=1
          operation=WriteBlock, queue-length=1
      PS_NVM_BLOCK_PROGREQCNT: provided-interface=NvM_AC3_SRBS_Srv  # P-Port Prototype of NvM_AC3_SRBS_Srv for NVRAM Block NVM_BLOCK_PROGREQCNT
        provided-com-specs:
          operation=EraseBlock, queue-length=1
          operation=GetErrorStatus, queue-length=1
          operation=InvalidateNvBlock, queue-length=1
          operation=ReadBlock, queue-length=1
          operation=SetRamBlockStatus, queue-length=1
          operation=WriteBlock, queue-length=1
      PS_NVM_BLOCK_RESETRESP: provided-interface=NvM_AC3_SRBS_Srv  # P-Port Prototype of NvM_AC3_SRBS_Srv for NVRAM Block NVM_BLOCK_RESETRESP
        provided-com-specs:
          operation=EraseBlock, queue-length=1
          operation=GetErrorStatus, queue-length=1
          operation=InvalidateNvBlock, queue-length=1
          operation=ReadBlock, queue-length=1
          operation=SetRamBlockStatus, queue-length=1
          operation=WriteBlock, queue-length=1
      PS_NVM_BLOCK_SECDLYEN: provided-interface=NvM_AC3_SRBS_Srv  # P-Port Prototype of NvM_AC3_SRBS_Srv for NVRAM Block NVM_BLOCK_SECDLYEN
        provided-com-specs:
          operation=EraseBlock, queue-length=1
          operation=GetErrorStatus, queue-length=1
          operation=InvalidateNvBlock, queue-length=1
          operation=ReadBlock, queue-length=1
          operation=SetRamBlockStatus, queue-length=1
          operation=WriteBlock, queue-length=1
      PS_NVM_BLOCK_SER_ACTIVEDIAGINFO_APPL: provided-interface=NvM_AC3_SRBS_Srv  # P-Port Prototype of NvM_AC3_SRBS_Srv for NVRAM Block NVM_BLOCK_SER_ACTIVEDIAGINFO_APPL
        provided-com-specs:
          operation=EraseBlock, queue-length=1
          operation=GetErrorStatus, queue-length=1
          operation=InvalidateNvBlock, queue-length=1
          operation=ReadBlock, queue-length=1
          operation=SetRamBlockStatus, queue-length=1
          operation=WriteBlock, queue-length=1
      PS_NVM_BLOCK_SER_ACTIVEDIAGINFO_BOOT: provided-interface=NvM_AC3_SRBS_Srv  # P-Port Prototype of NvM_AC3_SRBS_Srv for NVRAM Block NVM_BLOCK_SER_ACTIVEDIAGINFO_BOOT
        provided-com-specs:
          operation=EraseBlock, queue-length=1
          operation=GetErrorStatus, queue-length=1
          operation=InvalidateNvBlock, queue-length=1
          operation=ReadBlock, queue-length=1
          operation=SetRamBlockStatus, queue-length=1
          operation=WriteBlock, queue-length=1
      PS_NVM_BLOCK_SER_BOOTSWVERSIONINFO: provided-interface=NvM_AC3_SRBS_Srv  # P-Port Prototype of NvM_AC3_SRBS_Srv for NVRAM Block NVM_BLOCK_SER_BOOTSWVERSIONINFO
        provided-com-specs:
          operation=EraseBlock, queue-length=1
          operation=GetErrorStatus, queue-length=1
          operation=InvalidateNvBlock, queue-length=1
          operation=ReadBlock, queue-length=1
          operation=SetRamBlockStatus, queue-length=1
          operation=WriteBlock, queue-length=1
      PS_NVM_BLOCK_SER_DIAGSPECINFO: provided-interface=NvM_AC3_SRBS_Srv  # P-Port Prototype of NvM_AC3_SRBS_Srv for NVRAM Block NVM_BLOCK_SER_DIAGSPECINFO
        provided-com-specs:
          operation=EraseBlock, queue-length=1
          operation=GetErrorStatus, queue-length=1
          operation=InvalidateNvBlock, queue-length=1
          operation=ReadBlock, queue-length=1
          operation=SetRamBlockStatus, queue-length=1
          operation=WriteBlock, queue-length=1
      PS_NVM_BLOCK_SER_ECUPN: provided-interface=NvM_AC3_SRBS_Srv  # P-Port Prototype of NvM_AC3_SRBS_Srv for NVRAM Block NVM_BLOCK_SER_ECUPN
        provided-com-specs:
          operation=EraseBlock, queue-length=1
          operation=GetErrorStatus, queue-length=1
          operation=InvalidateNvBlock, queue-length=1
          operation=ReadBlock, queue-length=1
          operation=SetRamBlockStatus, queue-length=1
          operation=WriteBlock, queue-length=1
      PS_NVM_BLOCK_SER_ECUSERIALNUMBER: provided-interface=NvM_AC3_SRBS_Srv  # P-Port Prototype of NvM_AC3_SRBS_Srv for NVRAM Block NVM_BLOCK_SER_ECUSERIALNUMBER
        provided-com-specs:
          operation=EraseBlock, queue-length=1
          operation=GetErrorStatus, queue-length=1
          operation=InvalidateNvBlock, queue-length=1
          operation=ReadBlock, queue-length=1
          operation=SetRamBlockStatus, queue-length=1
          operation=WriteBlock, queue-length=1
      PS_NVM_BLOCK_SER_HWPARTNUMBER: provided-interface=NvM_AC3_SRBS_Srv  # P-Port Prototype of NvM_AC3_SRBS_Srv for NVRAM Block NVM_BLOCK_SER_HWPARTNUMBER
        provided-com-specs:
          operation=EraseBlock, queue-length=1
          operation=GetErrorStatus, queue-length=1
          operation=InvalidateNvBlock, queue-length=1
          operation=ReadBlock, queue-length=1
          operation=SetRamBlockStatus, queue-length=1
          operation=WriteBlock, queue-length=1
      PS_NVM_BLOCK_SER_HWSUPPID: provided-interface=NvM_AC3_SRBS_Srv  # P-Port Prototype of NvM_AC3_SRBS_Srv for NVRAM Block NVM_BLOCK_SER_HWSUPPID
        provided-com-specs:
          operation=EraseBlock, queue-length=1
          operation=GetErrorStatus, queue-length=1
          operation=InvalidateNvBlock, queue-length=1
          operation=ReadBlock, queue-length=1
          operation=SetRamBlockStatus, queue-length=1
          operation=WriteBlock, queue-length=1
      PS_NVM_BLOCK_SER_HWVERSIONINFO: provided-interface=NvM_AC3_SRBS_Srv  # P-Port Prototype of NvM_AC3_SRBS_Srv for NVRAM Block NVM_BLOCK_SER_HWVERSIONINFO
        provided-com-specs:
          operation=EraseBlock, queue-length=1
          operation=GetErrorStatus, queue-length=1
          operation=InvalidateNvBlock, queue-length=1
          operation=ReadBlock, queue-length=1
          operation=SetRamBlockStatus, queue-length=1
          operation=WriteBlock, queue-length=1
      PS_NVM_BLOCK_SER_METADATA_APPLICATION: provided-interface=NvM_AC3_SRBS_Srv  # P-Port Prototype of NvM_AC3_SRBS_Srv for NVRAM Block NVM_BLOCK_SER_METADATA_APPLICATION
        provided-com-specs:
          operation=EraseBlock, queue-length=1
          operation=GetErrorStatus, queue-length=1
          operation=InvalidateNvBlock, queue-length=1
          operation=ReadBlock, queue-length=1
          operation=SetRamBlockStatus, queue-length=1
          operation=WriteBlock, queue-length=1
      PS_NVM_BLOCK_SER_METADATA_CAL1: provided-interface=NvM_AC3_SRBS_Srv  # P-Port Prototype of NvM_AC3_SRBS_Srv for NVRAM Block NVM_BLOCK_SER_METADATA_CAL1
        provided-com-specs:
          operation=EraseBlock, queue-length=1
          operation=GetErrorStatus, queue-length=1
          operation=InvalidateNvBlock, queue-length=1
          operation=ReadBlock, queue-length=1
          operation=SetRamBlockStatus, queue-length=1
          operation=WriteBlock, queue-length=1
      PS_NVM_BLOCK_SER_METADATA_CAL2: provided-interface=NvM_AC3_SRBS_Srv  # P-Port Prototype of NvM_AC3_SRBS_Srv for NVRAM Block NVM_BLOCK_SER_METADATA_CAL2
        provided-com-specs:
          operation=EraseBlock, queue-length=1
          operation=GetErrorStatus, queue-length=1
          operation=InvalidateNvBlock, queue-length=1
          operation=ReadBlock, queue-length=1
          operation=SetRamBlockStatus, queue-length=1
          operation=WriteBlock, queue-length=1
      PS_NVM_BLOCK_SER_RESPONEVENTACTVSTATE: provided-interface=NvM_AC3_SRBS_Srv  # P-Port Prototype of NvM_AC3_SRBS_Srv for NVRAM Block NVM_BLOCK_SER_RESPONEVENTACTVSTATE
        provided-com-specs:
          operation=EraseBlock, queue-length=1
          operation=GetErrorStatus, queue-length=1
          operation=InvalidateNvBlock, queue-length=1
          operation=ReadBlock, queue-length=1
          operation=SetRamBlockStatus, queue-length=1
          operation=WriteBlock, queue-length=1
      PS_NVM_BLOCK_SER_VEHICLEINFO: provided-interface=NvM_AC3_SRBS_Srv  # P-Port Prototype of NvM_AC3_SRBS_Srv for NVRAM Block NVM_BLOCK_SER_VEHICLEINFO
        provided-com-specs:
          operation=EraseBlock, queue-length=1
          operation=GetErrorStatus, queue-length=1
          operation=InvalidateNvBlock, queue-length=1
          operation=ReadBlock, queue-length=1
          operation=SetRamBlockStatus, queue-length=1
          operation=WriteBlock, queue-length=1
      PS_NVM_BLOCK_SER_VINCURRENT: provided-interface=NvM_AC3_SRBS_Srv  # P-Port Prototype of NvM_AC3_SRBS_Srv for NVRAM Block NVM_BLOCK_SER_VINCURRENT
        provided-com-specs:
          operation=EraseBlock, queue-length=1
          operation=GetErrorStatus, queue-length=1
          operation=InvalidateNvBlock, queue-length=1
          operation=ReadBlock, queue-length=1
          operation=SetRamBlockStatus, queue-length=1
          operation=WriteBlock, queue-length=1
      PS_NVM_BLOCK_SER_VINODOMETERCOUNTER: provided-interface=NvM_AC3_SRBS_Srv  # P-Port Prototype of NvM_AC3_SRBS_Srv for NVRAM Block NVM_BLOCK_SER_VINODOMETERCOUNTER
        provided-com-specs:
          operation=EraseBlock, queue-length=1
          operation=GetErrorStatus, queue-length=1
          operation=InvalidateNvBlock, queue-length=1
          operation=ReadBlock, queue-length=1
          operation=SetRamBlockStatus, queue-length=1
          operation=WriteBlock, queue-length=1
      PS_NVM_BLOCK_SER_VINORIGINAL: provided-interface=NvM_AC3_SRBS_Srv  # P-Port Prototype of NvM_AC3_SRBS_Srv for NVRAM Block NVM_BLOCK_SER_VINORIGINAL
        provided-com-specs:
          operation=EraseBlock, queue-length=1
          operation=GetErrorStatus, queue-length=1
          operation=InvalidateNvBlock, queue-length=1
          operation=ReadBlock, queue-length=1
          operation=SetRamBlockStatus, queue-length=1
          operation=WriteBlock, queue-length=1
      PS_NVM_BLOCK_SWFINGERPRINT: provided-interface=NvM_AC3_SRBS_Srv  # P-Port Prototype of NvM_AC3_SRBS_Srv for NVRAM Block NVM_BLOCK_SWFINGERPRINT
        provided-com-specs:
          operation=EraseBlock, queue-length=1
          operation=GetErrorStatus, queue-length=1
          operation=InvalidateNvBlock, queue-length=1
          operation=ReadBlock, queue-length=1
          operation=SetRamBlockStatus, queue-length=1
          operation=WriteBlock, queue-length=1
      PS_Rte_NvmBlock_Ap_AstLmt_SteerAsstDefeat: provided-interface=NvM_AC3_SRBS_Srv  # P-Port Prototype of NvM_AC3_SRBS_Srv for NVRAM Block Rte_NvmBlock_Ap_AstLmt_SteerAsstDefeat
        provided-com-specs:
          operation=EraseBlock, queue-length=1
          operation=GetErrorStatus, queue-length=1
          operation=InvalidateNvBlock, queue-length=1
          operation=ReadBlock, queue-length=1
          operation=SetRamBlockStatus, queue-length=1
          operation=WriteBlock, queue-length=1
      PS_Rte_NvmBlock_Ap_AvgFricLrn_AvgFricLrnData: provided-interface=NvM_AC3_SRBS_Srv  # P-Port Prototype of NvM_AC3_SRBS_Srv for NVRAM Block Rte_NvmBlock_Ap_AvgFricLrn_AvgFricLrnData
        provided-com-specs:
          operation=EraseBlock, queue-length=1
          operation=GetErrorStatus, queue-length=1
          operation=InvalidateNvBlock, queue-length=1
          operation=ReadBlock, queue-length=1
          operation=SetRamBlockStatus, queue-length=1
          operation=WriteBlock, queue-length=1
      PS_Rte_NvmBlock_Ap_TrqCanc_CogTrqRplComp: provided-interface=NvM_AC3_SRBS_Srv  # P-Port Prototype of NvM_AC3_SRBS_Srv for NVRAM Block Rte_NvmBlock_Ap_TrqCanc_CogTrqRplComp
        provided-com-specs:
          operation=EraseBlock, queue-length=1
          operation=GetErrorStatus, queue-length=1
          operation=InvalidateNvBlock, queue-length=1
          operation=ReadBlock, queue-length=1
          operation=SetRamBlockStatus, queue-length=1
          operation=WriteBlock, queue-length=1
      PS_Rte_NvmBlock_BatteryVoltage_OvervoltageData: provided-interface=NvM_AC3_SRBS_Srv  # P-Port Prototype of NvM_AC3_SRBS_Srv for NVRAM Block Rte_NvmBlock_BatteryVoltage_OvervoltageData
        provided-com-specs:
          operation=EraseBlock, queue-length=1
          operation=GetErrorStatus, queue-length=1
          operation=InvalidateNvBlock, queue-length=1
          operation=ReadBlock, queue-length=1
          operation=SetRamBlockStatus, queue-length=1
          operation=WriteBlock, queue-length=1
      PS_Rte_NvmBlock_CmMtrCurr_CurrTempOffset: provided-interface=NvM_AC3_SRBS_Srv  # P-Port Prototype of NvM_AC3_SRBS_Srv for NVRAM Block Rte_NvmBlock_CmMtrCurr_CurrTempOffset
        provided-com-specs:
          operation=EraseBlock, queue-length=1
          operation=GetErrorStatus, queue-length=1
          operation=InvalidateNvBlock, queue-length=1
          operation=ReadBlock, queue-length=1
          operation=SetRamBlockStatus, queue-length=1
          operation=WriteBlock, queue-length=1
      PS_Rte_NvmBlock_CmMtrCurr_ShCurrCal: provided-interface=NvM_AC3_SRBS_Srv  # P-Port Prototype of NvM_AC3_SRBS_Srv for NVRAM Block Rte_NvmBlock_CmMtrCurr_ShCurrCal
        provided-com-specs:
          operation=EraseBlock, queue-length=1
          operation=GetErrorStatus, queue-length=1
          operation=InvalidateNvBlock, queue-length=1
          operation=ReadBlock, queue-length=1
          operation=SetRamBlockStatus, queue-length=1
          operation=WriteBlock, queue-length=1
      PS_Rte_NvmBlock_CurrParamComp_EOLNomMtrParam: provided-interface=NvM_AC3_SRBS_Srv  # P-Port Prototype of NvM_AC3_SRBS_Srv for NVRAM Block Rte_NvmBlock_CurrParamComp_EOLNomMtrParam
        provided-com-specs:
          operation=EraseBlock, queue-length=1
          operation=GetErrorStatus, queue-length=1
          operation=InvalidateNvBlock, queue-length=1
          operation=ReadBlock, queue-length=1
          operation=SetRamBlockStatus, queue-length=1
          operation=WriteBlock, queue-length=1
      PS_Rte_NvmBlock_HwTrq_EOLTrqStepData: provided-interface=NvM_AC3_SRBS_Srv  # P-Port Prototype of NvM_AC3_SRBS_Srv for NVRAM Block Rte_NvmBlock_HwTrq_EOLTrqStepData
        provided-com-specs:
          operation=EraseBlock, queue-length=1
          operation=GetErrorStatus, queue-length=1
          operation=InvalidateNvBlock, queue-length=1
          operation=ReadBlock, queue-length=1
          operation=SetRamBlockStatus, queue-length=1
          operation=WriteBlock, queue-length=1
      PS_Rte_NvmBlock_HwTrq_HwTrqScaleData: provided-interface=NvM_AC3_SRBS_Srv  # P-Port Prototype of NvM_AC3_SRBS_Srv for NVRAM Block Rte_NvmBlock_HwTrq_HwTrqScaleData
        provided-com-specs:
          operation=EraseBlock, queue-length=1
          operation=GetErrorStatus, queue-length=1
          operation=InvalidateNvBlock, queue-length=1
          operation=ReadBlock, queue-length=1
          operation=SetRamBlockStatus, queue-length=1
          operation=WriteBlock, queue-length=1
      PS_Rte_NvmBlock_HwTrq_HwTrqTrimData: provided-interface=NvM_AC3_SRBS_Srv  # P-Port Prototype of NvM_AC3_SRBS_Srv for NVRAM Block Rte_NvmBlock_HwTrq_HwTrqTrimData
        provided-com-specs:
          operation=EraseBlock, queue-length=1
          operation=GetErrorStatus, queue-length=1
          operation=InvalidateNvBlock, queue-length=1
          operation=ReadBlock, queue-length=1
          operation=SetRamBlockStatus, queue-length=1
          operation=WriteBlock, queue-length=1
      PS_Rte_NvmBlock_IPMTrqCanc_CogTrqCal: provided-interface=NvM_AC3_SRBS_Srv  # P-Port Prototype of NvM_AC3_SRBS_Srv for NVRAM Block Rte_NvmBlock_IPMTrqCanc_CogTrqCal
        provided-com-specs:
          operation=EraseBlock, queue-length=1
          operation=GetErrorStatus, queue-length=1
          operation=InvalidateNvBlock, queue-length=1
          operation=ReadBlock, queue-length=1
          operation=SetRamBlockStatus, queue-length=1
          operation=WriteBlock, queue-length=1
      PS_Rte_NvmBlock_LrnEOT_LearnedEOT: provided-interface=NvM_AC3_SRBS_Srv  # P-Port Prototype of NvM_AC3_SRBS_Srv for NVRAM Block Rte_NvmBlock_LrnEOT_LearnedEOT
        provided-com-specs:
          operation=EraseBlock, queue-length=1
          operation=GetErrorStatus, queue-length=1
          operation=InvalidateNvBlock, queue-length=1
          operation=ReadBlock, queue-length=1
          operation=SetRamBlockStatus, queue-length=1
          operation=WriteBlock, queue-length=1
      PS_Rte_NvmBlock_MtrPos_MtrPosSnsr_EOLData: provided-interface=NvM_AC3_SRBS_Srv  # P-Port Prototype of NvM_AC3_SRBS_Srv for NVRAM Block Rte_NvmBlock_MtrPos_MtrPosSnsr_EOLData
        provided-com-specs:
          operation=EraseBlock, queue-length=1
          operation=GetErrorStatus, queue-length=1
          operation=InvalidateNvBlock, queue-length=1
          operation=ReadBlock, queue-length=1
          operation=SetRamBlockStatus, queue-length=1
          operation=WriteBlock, queue-length=1
      PS_Rte_NvmBlock_Polarity_EOLCtrlPolarity: provided-interface=NvM_AC3_SRBS_Srv  # P-Port Prototype of NvM_AC3_SRBS_Srv for NVRAM Block Rte_NvmBlock_Polarity_EOLCtrlPolarity
        provided-com-specs:
          operation=EraseBlock, queue-length=1
          operation=GetErrorStatus, queue-length=1
          operation=InvalidateNvBlock, queue-length=1
          operation=ReadBlock, queue-length=1
          operation=SetRamBlockStatus, queue-length=1
          operation=WriteBlock, queue-length=1
      PS_Rte_NvmBlock_StaMd_CloseCheckData: provided-interface=NvM_AC3_SRBS_Srv  # P-Port Prototype of NvM_AC3_SRBS_Srv for NVRAM Block Rte_NvmBlock_StaMd_CloseCheckData
        provided-com-specs:
          operation=EraseBlock, queue-length=1
          operation=GetErrorStatus, queue-length=1
          operation=InvalidateNvBlock, queue-length=1
          operation=ReadBlock, queue-length=1
          operation=SetRamBlockStatus, queue-length=1
          operation=WriteBlock, queue-length=1
      PS_Rte_NvmBlock_StaMd_TypeHRamBuffer: provided-interface=NvM_AC3_SRBS_Srv  # P-Port Prototype of NvM_AC3_SRBS_Srv for NVRAM Block Rte_NvmBlock_StaMd_TypeHRamBuffer
        provided-com-specs:
          operation=EraseBlock, queue-length=1
          operation=GetErrorStatus, queue-length=1
          operation=InvalidateNvBlock, queue-length=1
          operation=ReadBlock, queue-length=1
          operation=SetRamBlockStatus, queue-length=1
          operation=WriteBlock, queue-length=1
      PS_Rte_NvmBlock_TrqCmdScl_TorqueCmdSF_Uls_f32: provided-interface=NvM_AC3_SRBS_Srv  # P-Port Prototype of NvM_AC3_SRBS_Srv for NVRAM Block Rte_NvmBlock_TrqCmdScl_TorqueCmdSF_Uls_f32
        provided-com-specs:
          operation=EraseBlock, queue-length=1
          operation=GetErrorStatus, queue-length=1
          operation=InvalidateNvBlock, queue-length=1
          operation=ReadBlock, queue-length=1
          operation=SetRamBlockStatus, queue-length=1
          operation=WriteBlock, queue-length=1
  swc implementation NvM_Implementation: behavior=NvM_InternalBehavior
    code-descriptors:
      code Code: type=SRC
