AUTOSAR XML (schema 302)
standard types defined: Boolean, UInt8
package /ComponentType
  internal behavior Dem_InternalBehavior: component=Dem
    timing event TMT_Dem_MainFunction: start-on-event=Dem_MainFunction, period=0.01
    145 x operation invoked event:
      OIT_GetDTCOfEvent_Event_BCM_MISSING_MSG_GetDTCOfEvent: start-on-event=GetDTCOfEvent, operation=Event_BCM_MISSING_MSG.GetDTCOfEvent
      OIT_GetDTCOfEvent_Event_BUS_OFF_GetDTCOfEvent: start-on-event=GetDTCOfEvent, operation=Event_BUS_OFF.GetDTCOfEvent
      OIT_GetDTCOfEvent_Event_COMM_ENABLE_FAILURE_GetDTCOfEvent: start-on-event=GetDTCOfEvent, operation=Event_COMM_ENABLE_FAILURE.GetDTCOfEvent
      OIT_GetDTCOfEvent_Event_EBCM_INVALID_DATA_GetDTCOfEvent: start-on-event=GetDTCOfEvent, operation=Event_EBCM_INVALID_DATA.GetDTCOfEvent
      OIT_GetDTCOfEvent_Event_EBCM_MISSING_MSG_GetDTCOfEvent: start-on-event=GetDTCOfEvent, operation=Event_EBCM_MISSING_MSG.GetDTCOfEvent
      OIT_GetDTCOfEvent_Event_ECM_INVALID_DATA_GetDTCOfEvent: start-on-event=GetDTCOfEvent, operation=Event_ECM_INVALID_DATA.GetDTCOfEvent
      OIT_GetDTCOfEvent_Event_ECM_MISSING_MSG_GetDTCOfEvent: start-on-event=GetDTCOfEvent, operation=Event_ECM_MISSING_MSG.GetDTCOfEvent
      OIT_GetDTCOfEvent_Event_ECU_INCORRECT_COMP_GetDTCOfEvent: start-on-event=GetDTCOfEvent, operation=Event_ECU_INCORRECT_COMP.GetDTCOfEvent
      OIT_GetDTCOfEvent_Event_ECU_INTERNAL_FAILURE_GetDTCOfEvent: start-on-event=GetDTCOfEvent, operation=Event_ECU_INTERNAL_FAILURE.GetDTCOfEvent
      OIT_GetDTCOfEvent_Event_ECU_NO_VEH_CONFIG_GetDTCOfEvent: start-on-event=GetDTCOfEvent, operation=Event_ECU_NO_VEH_CONFIG.GetDTCOfEvent
      OIT_GetDTCOfEvent_Event_EEPROM_ERROR_GetDTCOfEvent: start-on-event=GetDTCOfEvent, operation=Event_EEPROM_ERROR.GetDTCOfEvent
      OIT_GetDTCOfEvent_Event_HIGH_VOLTAGE_GetDTCOfEvent: start-on-event=GetDTCOfEvent, operation=Event_HIGH_VOLTAGE.GetDTCOfEvent
      OIT_GetDTCOfEvent_Event_LOW_VOLTAGE_GetDTCOfEvent: start-on-event=GetDTCOfEvent, operation=Event_LOW_VOLTAGE.GetDTCOfEvent
      OIT_GetDTCOfEvent_Event_MTR_CIR_ELEC_FAILURE_GetDTCOfEvent: start-on-event=GetDTCOfEvent, operation=Event_MTR_CIR_ELEC_FAILURE.GetDTCOfEvent
      OIT_GetDTCOfEvent_Event_MTR_CIR_MECH_FAILURE_GetDTCOfEvent: start-on-event=GetDTCOfEvent, operation=Event_MTR_CIR_MECH_FAILURE.GetDTCOfEvent
      OIT_GetDTCOfEvent_Event_SRS_ATTEMPTS_EXCEEDED_GetDTCOfEvent: start-on-event=GetDTCOfEvent, operation=Event_SRS_ATTEMPTS_EXCEEDED.GetDTCOfEvent
      OIT_GetDTCOfEvent_Event_STR_WHL_ANG_MISSING_MSG_GetDTCOfEvent: start-on-event=GetDTCOfEvent, operation=Event_STR_WHL_ANG_MISSING_MSG.GetDTCOfEvent
      OIT_GetDTCOfEvent_Event_TEMPERATURE_TOO_HIGH_GetDTCOfEvent: start-on-event=GetDTCOfEvent, operation=Event_TEMPERATURE_TOO_HIGH.GetDTCOfEvent
      OIT_GetDTCOfEvent_Event_TRQ_SEN_CAL_NOT_LEARNED_GetDTCOfEvent: start-on-event=GetDTCOfEvent, operation=Event_TRQ_SEN_CAL_NOT_LEARNED.GetDTCOfEvent
      OIT_GetDTCOfEvent_Event_TRQ_SEN_ELEC_FAILURE_GetDTCOfEvent: start-on-event=GetDTCOfEvent, operation=Event_TRQ_SEN_ELEC_FAILURE.GetDTCOfEvent
      OIT_GetEventFailed_Event_BCM_MISSING_MSG_GetEventFailed: start-on-event=GetEventFailed, operation=Event_BCM_MISSING_MSG.GetEventFailed
      OIT_GetEventFailed_Event_BUS_OFF_GetEventFailed: start-on-event=GetEventFailed, operation=Event_BUS_OFF.GetEventFailed
      OIT_GetEventFailed_Event_COMM_ENABLE_FAILURE_GetEventFailed: start-on-event=GetEventFailed, operation=Event_COMM_ENABLE_FAILURE.GetEventFailed
      OIT_GetEventFailed_Event_EBCM_INVALID_DATA_GetEventFailed: start-on-event=GetEventFailed, operation=Event_EBCM_INVALID_DATA.GetEventFailed
      OIT_GetEventFailed_Event_EBCM_MISSING_MSG_GetEventFailed: start-on-event=GetEventFailed, operation=Event_EBCM_MISSING_MSG.GetEventFailed
      OIT_GetEventFailed_Event_ECM_INVALID_DATA_GetEventFailed: start-on-event=GetEventFailed, operation=Event_ECM_INVALID_DATA.GetEventFailed
      OIT_GetEventFailed_Event_ECM_MISSING_MSG_GetEventFailed: start-on-event=GetEventFailed, operation=Event_ECM_MISSING_MSG.GetEventFailed
      OIT_GetEventFailed_Event_ECU_INCORRECT_COMP_GetEventFailed: start-on-event=GetEventFailed, operation=Event_ECU_INCORRECT_COMP.GetEventFailed
      OIT_GetEventFailed_Event_ECU_INTERNAL_FAILURE_GetEventFailed: start-on-event=GetEventFailed, operation=Event_ECU_INTERNAL_FAILURE.GetEventFailed
      OIT_GetEventFailed_Event_ECU_NO_VEH_CONFIG_GetEventFailed: start-on-event=GetEventFailed, operation=Event_ECU_NO_VEH_CONFIG.GetEventFailed
      OIT_GetEventFailed_Event_EEPROM_ERROR_GetEventFailed: start-on-event=GetEventFailed, operation=Event_EEPROM_ERROR.GetEventFailed
      OIT_GetEventFailed_Event_HIGH_VOLTAGE_GetEventFailed: start-on-event=GetEventFailed, operation=Event_HIGH_VOLTAGE.GetEventFailed
      OIT_GetEventFailed_Event_LOW_VOLTAGE_GetEventFailed: start-on-event=GetEventFailed, operation=Event_LOW_VOLTAGE.GetEventFailed
      OIT_GetEventFailed_Event_MTR_CIR_ELEC_FAILURE_GetEventFailed: start-on-event=GetEventFailed, operation=Event_MTR_CIR_ELEC_FAILURE.GetEventFailed
      OIT_GetEventFailed_Event_MTR_CIR_MECH_FAILURE_GetEventFailed: start-on-event=GetEventFailed, operation=Event_MTR_CIR_MECH_FAILURE.GetEventFailed
      OIT_GetEventFailed_Event_SRS_ATTEMPTS_EXCEEDED_GetEventFailed: start-on-event=GetEventFailed, operation=Event_SRS_ATTEMPTS_EXCEEDED.GetEventFailed
      OIT_GetEventFailed_Event_STR_WHL_ANG_MISSING_MSG_GetEventFailed: start-on-event=GetEventFailed, operation=Event_STR_WHL_ANG_MISSING_MSG.GetEventFailed
      OIT_GetEventFailed_Event_TEMPERATURE_TOO_HIGH_GetEventFailed: start-on-event=GetEventFailed, operation=Event_TEMPERATURE_TOO_HIGH.GetEventFailed
      OIT_GetEventFailed_Event_TRQ_SEN_CAL_NOT_LEARNED_GetEventFailed: start-on-event=GetEventFailed, operation=Event_TRQ_SEN_CAL_NOT_LEARNED.GetEventFailed
      OIT_GetEventFailed_Event_TRQ_SEN_ELEC_FAILURE_GetEventFailed: start-on-event=GetEventFailed, operation=Event_TRQ_SEN_ELEC_FAILURE.GetEventFailed
      OIT_GetEventStatus_Event_BCM_MISSING_MSG_GetEventStatus: start-on-event=GetEventStatus, operation=Event_BCM_MISSING_MSG.GetEventStatus
      OIT_GetEventStatus_Event_BUS_OFF_GetEventStatus: start-on-event=GetEventStatus, operation=Event_BUS_OFF.GetEventStatus
      OIT_GetEventStatus_Event_COMM_ENABLE_FAILURE_GetEventStatus: start-on-event=GetEventStatus, operation=Event_COMM_ENABLE_FAILURE.GetEventStatus
      OIT_GetEventStatus_Event_EBCM_INVALID_DATA_GetEventStatus: start-on-event=GetEventStatus, operation=Event_EBCM_INVALID_DATA.GetEventStatus
      OIT_GetEventStatus_Event_EBCM_MISSING_MSG_GetEventStatus: start-on-event=GetEventStatus, operation=Event_EBCM_MISSING_MSG.GetEventStatus
      OIT_GetEventStatus_Event_ECM_INVALID_DATA_GetEventStatus: start-on-event=GetEventStatus, operation=Event_ECM_INVALID_DATA.GetEventStatus
      OIT_GetEventStatus_Event_ECM_MISSING_MSG_GetEventStatus: start-on-event=GetEventStatus, operation=Event_ECM_MISSING_MSG.GetEventStatus
      OIT_GetEventStatus_Event_ECU_INCORRECT_COMP_GetEventStatus: start-on-event=GetEventStatus, operation=Event_ECU_INCORRECT_COMP.GetEventStatus
      OIT_GetEventStatus_Event_ECU_INTERNAL_FAILURE_GetEventStatus: start-on-event=GetEventStatus, operation=Event_ECU_INTERNAL_FAILURE.GetEventStatus
      OIT_GetEventStatus_Event_ECU_NO_VEH_CONFIG_GetEventStatus: start-on-event=GetEventStatus, operation=Event_ECU_NO_VEH_CONFIG.GetEventStatus
      OIT_GetEventStatus_Event_EEPROM_ERROR_GetEventStatus: start-on-event=GetEventStatus, operation=Event_EEPROM_ERROR.GetEventStatus
      OIT_GetEventStatus_Event_HIGH_VOLTAGE_GetEventStatus: start-on-event=GetEventStatus, operation=Event_HIGH_VOLTAGE.GetEventStatus
      OIT_GetEventStatus_Event_LOW_VOLTAGE_GetEventStatus: start-on-event=GetEventStatus, operation=Event_LOW_VOLTAGE.GetEventStatus
      OIT_GetEventStatus_Event_MTR_CIR_ELEC_FAILURE_GetEventStatus: start-on-event=GetEventStatus, operation=Event_MTR_CIR_ELEC_FAILURE.GetEventStatus
      OIT_GetEventStatus_Event_MTR_CIR_MECH_FAILURE_GetEventStatus: start-on-event=GetEventStatus, operation=Event_MTR_CIR_MECH_FAILURE.GetEventStatus
      OIT_GetEventStatus_Event_SRS_ATTEMPTS_EXCEEDED_GetEventStatus: start-on-event=GetEventStatus, operation=Event_SRS_ATTEMPTS_EXCEEDED.GetEventStatus
      OIT_GetEventStatus_Event_STR_WHL_ANG_MISSING_MSG_GetEventStatus: start-on-event=GetEventStatus, operation=Event_STR_WHL_ANG_MISSING_MSG.GetEventStatus
      OIT_GetEventStatus_Event_TEMPERATURE_TOO_HIGH_GetEventStatus: start-on-event=GetEventStatus, operation=Event_TEMPERATURE_TOO_HIGH.GetEventStatus
      OIT_GetEventStatus_Event_TRQ_SEN_CAL_NOT_LEARNED_GetEventStatus: start-on-event=GetEventStatus, operation=Event_TRQ_SEN_CAL_NOT_LEARNED.GetEventStatus
      OIT_GetEventStatus_Event_TRQ_SEN_ELEC_FAILURE_GetEventStatus: start-on-event=GetEventStatus, operation=Event_TRQ_SEN_ELEC_FAILURE.GetEventStatus
      OIT_GetEventTested_Event_BCM_MISSING_MSG_GetEventTested: start-on-event=GetEventTested, operation=Event_BCM_MISSING_MSG.GetEventTested
      OIT_GetEventTested_Event_BUS_OFF_GetEventTested: start-on-event=GetEventTested, operation=Event_BUS_OFF.GetEventTested
      OIT_GetEventTested_Event_COMM_ENABLE_FAILURE_GetEventTested: start-on-event=GetEventTested, operation=Event_COMM_ENABLE_FAILURE.GetEventTested
      OIT_GetEventTested_Event_EBCM_INVALID_DATA_GetEventTested: start-on-event=GetEventTested, operation=Event_EBCM_INVALID_DATA.GetEventTested
      OIT_GetEventTested_Event_EBCM_MISSING_MSG_GetEventTested: start-on-event=GetEventTested, operation=Event_EBCM_MISSING_MSG.GetEventTested
      OIT_GetEventTested_Event_ECM_INVALID_DATA_GetEventTested: start-on-event=GetEventTested, operation=Event_ECM_INVALID_DATA.GetEventTested
      OIT_GetEventTested_Event_ECM_MISSING_MSG_GetEventTested: start-on-event=GetEventTested, operation=Event_ECM_MISSING_MSG.GetEventTested
      OIT_GetEventTested_Event_ECU_INCORRECT_COMP_GetEventTested: start-on-event=GetEventTested, operation=Event_ECU_INCORRECT_COMP.GetEventTested
      OIT_GetEventTested_Event_ECU_INTERNAL_FAILURE_GetEventTested: start-on-event=GetEventTested, operation=Event_ECU_INTERNAL_FAILURE.GetEventTested
      OIT_GetEventTested_Event_ECU_NO_VEH_CONFIG_GetEventTested: start-on-event=GetEventTested, operation=Event_ECU_NO_VEH_CONFIG.GetEventTested
      OIT_GetEventTested_Event_EEPROM_ERROR_GetEventTested: start-on-event=GetEventTested, operation=Event_EEPROM_ERROR.GetEventTested
      OIT_GetEventTested_Event_HIGH_VOLTAGE_GetEventTested: start-on-event=GetEventTested, operation=Event_HIGH_VOLTAGE.GetEventTested
      OIT_GetEventTested_Event_LOW_VOLTAGE_GetEventTested: start-on-event=GetEventTested, operation=Event_LOW_VOLTAGE.GetEventTested
      OIT_GetEventTested_Event_MTR_CIR_ELEC_FAILURE_GetEventTested: start-on-event=GetEventTested, operation=Event_MTR_CIR_ELEC_FAILURE.GetEventTested
      OIT_GetEventTested_Event_MTR_CIR_MECH_FAILURE_GetEventTested: start-on-event=GetEventTested, operation=Event_MTR_CIR_MECH_FAILURE.GetEventTested
      OIT_GetEventTested_Event_SRS_ATTEMPTS_EXCEEDED_GetEventTested: start-on-event=GetEventTested, operation=Event_SRS_ATTEMPTS_EXCEEDED.GetEventTested
      OIT_GetEventTested_Event_STR_WHL_ANG_MISSING_MSG_GetEventTested: start-on-event=GetEventTested, operation=Event_STR_WHL_ANG_MISSING_MSG.GetEventTested
      OIT_GetEventTested_Event_TEMPERATURE_TOO_HIGH_GetEventTested: start-on-event=GetEventTested, operation=Event_TEMPERATURE_TOO_HIGH.GetEventTested
      OIT_GetEventTested_Event_TRQ_SEN_CAL_NOT_LEARNED_GetEventTested: start-on-event=GetEventTested, operation=Event_TRQ_SEN_CAL_NOT_LEARNED.GetEventTested
      OIT_GetEventTested_Event_TRQ_SEN_ELEC_FAILURE_GetEventTested: start-on-event=GetEventTested, operation=Event_TRQ_SEN_ELEC_FAILURE.GetEventTested
      OIT_GetFaultDetectionCounter_Event_BCM_MISSING_MSG_GetFaultDetectionCounter: start-on-event=GetFaultDetectionCounter, operation=Event_BCM_MISSING_MSG.GetFaultDetectionCounter
      OIT_GetFaultDetectionCounter_Event_BUS_OFF_GetFaultDetectionCounter: start-on-event=GetFaultDetectionCounter, operation=Event_BUS_OFF.GetFaultDetectionCounter
      OIT_GetFaultDetectionCounter_Event_COMM_ENABLE_FAILURE_GetFaultDetectionCounter: start-on-event=GetFaultDetectionCounter, operation=Event_COMM_ENABLE_FAILURE.GetFaultDetectionCounter
      OIT_GetFaultDetectionCounter_Event_EBCM_INVALID_DATA_GetFaultDetectionCounter: start-on-event=GetFaultDetectionCounter, operation=Event_EBCM_INVALID_DATA.GetFaultDetectionCounter
      OIT_GetFaultDetectionCounter_Event_EBCM_MISSING_MSG_GetFaultDetectionCounter: start-on-event=GetFaultDetectionCounter, operation=Event_EBCM_MISSING_MSG.GetFaultDetectionCounter
      OIT_GetFaultDetectionCounter_Event_ECM_INVALID_DATA_GetFaultDetectionCounter: start-on-event=GetFaultDetectionCounter, operation=Event_ECM_INVALID_DATA.GetFaultDetectionCounter
      OIT_GetFaultDetectionCounter_Event_ECM_MISSING_MSG_GetFaultDetectionCounter: start-on-event=GetFaultDetectionCounter, operation=Event_ECM_MISSING_MSG.GetFaultDetectionCounter
      OIT_GetFaultDetectionCounter_Event_ECU_INCORRECT_COMP_GetFaultDetectionCounter: start-on-event=GetFaultDetectionCounter, operation=Event_ECU_INCORRECT_COMP.GetFaultDetectionCounter
      OIT_GetFaultDetectionCounter_Event_ECU_INTERNAL_FAILURE_GetFaultDetectionCounter: start-on-event=GetFaultDetectionCounter, operation=Event_ECU_INTERNAL_FAILURE.GetFaultDetectionCounter
      OIT_GetFaultDetectionCounter_Event_ECU_NO_VEH_CONFIG_GetFaultDetectionCounter: start-on-event=GetFaultDetectionCounter, operation=Event_ECU_NO_VEH_CONFIG.GetFaultDetectionCounter
      OIT_GetFaultDetectionCounter_Event_EEPROM_ERROR_GetFaultDetectionCounter: start-on-event=GetFaultDetectionCounter, operation=Event_EEPROM_ERROR.GetFaultDetectionCounter
      OIT_GetFaultDetectionCounter_Event_HIGH_VOLTAGE_GetFaultDetectionCounter: start-on-event=GetFaultDetectionCounter, operation=Event_HIGH_VOLTAGE.GetFaultDetectionCounter
      OIT_GetFaultDetectionCounter_Event_LOW_VOLTAGE_GetFaultDetectionCounter: start-on-event=GetFaultDetectionCounter, operation=Event_LOW_VOLTAGE.GetFaultDetectionCounter
      OIT_GetFaultDetectionCounter_Event_MTR_CIR_ELEC_FAILURE_GetFaultDetectionCounter: start-on-event=GetFaultDetectionCounter, operation=Event_MTR_CIR_ELEC_FAILURE.GetFaultDetectionCounter
      OIT_GetFaultDetectionCounter_Event_MTR_CIR_MECH_FAILURE_GetFaultDetectionCounter: start-on-event=GetFaultDetectionCounter, operation=Event_MTR_CIR_MECH_FAILURE.GetFaultDetectionCounter
      OIT_GetFaultDetectionCounter_Event_SRS_ATTEMPTS_EXCEEDED_GetFaultDetectionCounter: start-on-event=GetFaultDetectionCounter, operation=Event_SRS_ATTEMPTS_EXCEEDED.GetFaultDetectionCounter
      OIT_GetFaultDetectionCounter_Event_STR_WHL_ANG_MISSING_MSG_GetFaultDetectionCounter: start-on-event=GetFaultDetectionCounter, operation=Event_STR_WHL_ANG_MISSING_MSG.GetFaultDetectionCounter
      OIT_GetFaultDetectionCounter_Event_TEMPERATURE_TOO_HIGH_GetFaultDetectionCounter: start-on-event=GetFaultDetectionCounter, operation=Event_TEMPERATURE_TOO_HIGH.GetFaultDetectionCounter
      OIT_GetFaultDetectionCounter_Event_TRQ_SEN_CAL_NOT_LEARNED_GetFaultDetectionCounter: start-on-event=GetFaultDetectionCounter, operation=Event_TRQ_SEN_CAL_NOT_LEARNED.GetFaultDetectionCounter
      OIT_GetFaultDetectionCounter_Event_TRQ_SEN_ELEC_FAILURE_GetFaultDetectionCounter: start-on-event=GetFaultDetectionCounter, operation=Event_TRQ_SEN_ELEC_FAILURE.GetFaultDetectionCounter
      OIT_GetIndicatorStatus_IndStatus_Warning_Indicator_GetIndicatorStatus: start-on-event=GetIndicatorStatus, operation=IndStatus_Warning_Indicator.GetIndicatorStatus
      OIT_ResetEventStatus_Event_BCM_MISSING_MSG_ResetEventStatus: start-on-event=ResetEventStatus, operation=Event_BCM_MISSING_MSG.ResetEventStatus
      OIT_ResetEventStatus_Event_BUS_OFF_ResetEventStatus: start-on-event=ResetEventStatus, operation=Event_BUS_OFF.ResetEventStatus
      OIT_ResetEventStatus_Event_COMM_ENABLE_FAILURE_ResetEventStatus: start-on-event=ResetEventStatus, operation=Event_COMM_ENABLE_FAILURE.ResetEventStatus
      OIT_ResetEventStatus_Event_EBCM_INVALID_DATA_ResetEventStatus: start-on-event=ResetEventStatus, operation=Event_EBCM_INVALID_DATA.ResetEventStatus
      OIT_ResetEventStatus_Event_EBCM_MISSING_MSG_ResetEventStatus: start-on-event=ResetEventStatus, operation=Event_EBCM_MISSING_MSG.ResetEventStatus
      OIT_ResetEventStatus_Event_ECM_INVALID_DATA_ResetEventStatus: start-on-event=ResetEventStatus, operation=Event_ECM_INVALID_DATA.ResetEventStatus
      OIT_ResetEventStatus_Event_ECM_MISSING_MSG_ResetEventStatus: start-on-event=ResetEventStatus, operation=Event_ECM_MISSING_MSG.ResetEventStatus
      OIT_ResetEventStatus_Event_ECU_INCORRECT_COMP_ResetEventStatus: start-on-event=ResetEventStatus, operation=Event_ECU_INCORRECT_COMP.ResetEventStatus
      OIT_ResetEventStatus_Event_ECU_INTERNAL_FAILURE_ResetEventStatus: start-on-event=ResetEventStatus, operation=Event_ECU_INTERNAL_FAILURE.ResetEventStatus
      OIT_ResetEventStatus_Event_ECU_NO_VEH_CONFIG_ResetEventStatus: start-on-event=ResetEventStatus, operation=Event_ECU_NO_VEH_CONFIG.ResetEventStatus
      OIT_ResetEventStatus_Event_EEPROM_ERROR_ResetEventStatus: start-on-event=ResetEventStatus, operation=Event_EEPROM_ERROR.ResetEventStatus
      OIT_ResetEventStatus_Event_HIGH_VOLTAGE_ResetEventStatus: start-on-event=ResetEventStatus, operation=Event_HIGH_VOLTAGE.ResetEventStatus
      OIT_ResetEventStatus_Event_LOW_VOLTAGE_ResetEventStatus: start-on-event=ResetEventStatus, operation=Event_LOW_VOLTAGE.ResetEventStatus
      OIT_ResetEventStatus_Event_MTR_CIR_ELEC_FAILURE_ResetEventStatus: start-on-event=ResetEventStatus, operation=Event_MTR_CIR_ELEC_FAILURE.ResetEventStatus
      OIT_ResetEventStatus_Event_MTR_CIR_MECH_FAILURE_ResetEventStatus: start-on-event=ResetEventStatus, operation=Event_MTR_CIR_MECH_FAILURE.ResetEventStatus
      OIT_ResetEventStatus_Event_SRS_ATTEMPTS_EXCEEDED_ResetEventStatus: start-on-event=ResetEventStatus, operation=Event_SRS_ATTEMPTS_EXCEEDED.ResetEventStatus
      OIT_ResetEventStatus_Event_STR_WHL_ANG_MISSING_MSG_ResetEventStatus: start-on-event=ResetEventStatus, operation=Event_STR_WHL_ANG_MISSING_MSG.ResetEventStatus
      OIT_ResetEventStatus_Event_TEMPERATURE_TOO_HIGH_ResetEventStatus: start-on-event=ResetEventStatus, operation=Event_TEMPERATURE_TOO_HIGH.ResetEventStatus
      OIT_ResetEventStatus_Event_TRQ_SEN_CAL_NOT_LEARNED_ResetEventStatus: start-on-event=ResetEventStatus, operation=Event_TRQ_SEN_CAL_NOT_LEARNED.ResetEventStatus
      OIT_ResetEventStatus_Event_TRQ_SEN_ELEC_FAILURE_ResetEventStatus: start-on-event=ResetEventStatus, operation=Event_TRQ_SEN_ELEC_FAILURE.ResetEventStatus
      OIT_SetEventStatus_Event_BCM_MISSING_MSG_SetEventStatus: start-on-event=SetEventStatus, operation=Event_BCM_MISSING_MSG.SetEventStatus
      OIT_SetEventStatus_Event_BUS_OFF_SetEventStatus: start-on-event=SetEventStatus, operation=Event_BUS_OFF.SetEventStatus
      OIT_SetEventStatus_Event_COMM_ENABLE_FAILURE_SetEventStatus: start-on-event=SetEventStatus, operation=Event_COMM_ENABLE_FAILURE.SetEventStatus
      OIT_SetEventStatus_Event_EBCM_INVALID_DATA_SetEventStatus: start-on-event=SetEventStatus, operation=Event_EBCM_INVALID_DATA.SetEventStatus
      OIT_SetEventStatus_Event_EBCM_MISSING_MSG_SetEventStatus: start-on-event=SetEventStatus, operation=Event_EBCM_MISSING_MSG.SetEventStatus
      OIT_SetEventStatus_Event_ECM_INVALID_DATA_SetEventStatus: start-on-event=SetEventStatus, operation=Event_ECM_INVALID_DATA.SetEventStatus
      OIT_SetEventStatus_Event_ECM_MISSING_MSG_SetEventStatus: start-on-event=SetEventStatus, operation=Event_ECM_MISSING_MSG.SetEventStatus
      OIT_SetEventStatus_Event_ECU_INCORRECT_COMP_SetEventStatus: start-on-event=SetEventStatus, operation=Event_ECU_INCORRECT_COMP.SetEventStatus
      OIT_SetEventStatus_Event_ECU_INTERNAL_FAILURE_SetEventStatus: start-on-event=SetEventStatus, operation=Event_ECU_INTERNAL_FAILURE.SetEventStatus
      OIT_SetEventStatus_Event_ECU_NO_VEH_CONFIG_SetEventStatus: start-on-event=SetEventStatus, operation=Event_ECU_NO_VEH_CONFIG.SetEventStatus
      OIT_SetEventStatus_Event_EEPROM_ERROR_SetEventStatus: start-on-event=SetEventStatus, operation=Event_EEPROM_ERROR.SetEventStatus
      OIT_SetEventStatus_Event_HIGH_VOLTAGE_SetEventStatus: start-on-event=SetEventStatus, operation=Event_HIGH_VOLTAGE.SetEventStatus
      OIT_SetEventStatus_Event_LOW_VOLTAGE_SetEventStatus: start-on-event=SetEventStatus, operation=Event_LOW_VOLTAGE.SetEventStatus
      OIT_SetEventStatus_Event_MTR_CIR_ELEC_FAILURE_SetEventStatus: start-on-event=SetEventStatus, operation=Event_MTR_CIR_ELEC_FAILURE.SetEventStatus
      OIT_SetEventStatus_Event_MTR_CIR_MECH_FAILURE_SetEventStatus: start-on-event=SetEventStatus, operation=Event_MTR_CIR_MECH_FAILURE.SetEventStatus
      OIT_SetEventStatus_Event_SRS_ATTEMPTS_EXCEEDED_SetEventStatus: start-on-event=SetEventStatus, operation=Event_SRS_ATTEMPTS_EXCEEDED.SetEventStatus
      OIT_SetEventStatus_Event_STR_WHL_ANG_MISSING_MSG_SetEventStatus: start-on-event=SetEventStatus, operation=Event_STR_WHL_ANG_MISSING_MSG.SetEventStatus
      OIT_SetEventStatus_Event_TEMPERATURE_TOO_HIGH_SetEventStatus: start-on-event=SetEventStatus, operation=Event_TEMPERATURE_TOO_HIGH.SetEventStatus
      OIT_SetEventStatus_Event_TRQ_SEN_CAL_NOT_LEARNED_SetEventStatus: start-on-event=SetEventStatus, operation=Event_TRQ_SEN_CAL_NOT_LEARNED.SetEventStatus
      OIT_SetEventStatus_Event_TRQ_SEN_ELEC_FAILURE_SetEventStatus: start-on-event=SetEventStatus, operation=Event_TRQ_SEN_ELEC_FAILURE.SetEventStatus
      OIT_SetOperationCycleState_OpCycle_DEM_IGNITION_SetOperationCycleState: start-on-event=SetOperationCycleState, operation=OpCycle_DEM_IGNITION.SetOperationCycleState
      OIT_SetOperationCycleState_OpCycle_DEM_OBD_DCY_SetOperationCycleState: start-on-event=SetOperationCycleState, operation=OpCycle_DEM_OBD_DCY.SetOperationCycleState
      OIT_SetOperationCycleState_OpCycle_DEM_POWER_SetOperationCycleState: start-on-event=SetOperationCycleState, operation=OpCycle_DEM_POWER.SetOperationCycleState
      OIT_SetOperationCycleState_OpCycle_DEM_WARMUP_SetOperationCycleState: start-on-event=SetOperationCycleState, operation=OpCycle_DEM_WARMUP.SetOperationCycleState
    port-api-option enable-take-address=true, indirect-api=false, port=Event_BCM_MISSING_MSG:
      port-arg-values:
        integer literal Event_BCM_MISSING_MSG: type=Dem_EventIdType, value=2
    port-api-option enable-take-address=true, indirect-api=false, port=Event_BUS_OFF:
      port-arg-values:
        integer literal Event_BUS_OFF: type=Dem_EventIdType, value=8
    port-api-option enable-take-address=true, indirect-api=false, port=Event_COMM_ENABLE_FAILURE:
      port-arg-values:
        integer literal Event_COMM_ENABLE_FAILURE: type=Dem_EventIdType, value=1
    port-api-option enable-take-address=true, indirect-api=false, port=Event_EBCM_INVALID_DATA:
      port-arg-values:
        integer literal Event_EBCM_INVALID_DATA: type=Dem_EventIdType, value=4
    port-api-option enable-take-address=true, indirect-api=false, port=Event_EBCM_MISSING_MSG:
      port-arg-values:
        integer literal Event_EBCM_MISSING_MSG: type=Dem_EventIdType, value=5
    port-api-option enable-take-address=true, indirect-api=false, port=Event_ECM_INVALID_DATA:
      port-arg-values:
        integer literal Event_ECM_INVALID_DATA: type=Dem_EventIdType, value=6
    port-api-option enable-take-address=true, indirect-api=false, port=Event_ECM_MISSING_MSG:
      port-arg-values:
        integer literal Event_ECM_MISSING_MSG: type=Dem_EventIdType, value=7
    port-api-option enable-take-address=true, indirect-api=false, port=Event_ECU_INCORRECT_COMP:
      port-arg-values:
        integer literal Event_ECU_INCORRECT_COMP: type=Dem_EventIdType, value=12
    port-api-option enable-take-address=true, indirect-api=false, port=Event_ECU_INTERNAL_FAILURE:
      port-arg-values:
        integer literal Event_ECU_INTERNAL_FAILURE: type=Dem_EventIdType, value=13
    port-api-option enable-take-address=true, indirect-api=false, port=Event_ECU_NO_VEH_CONFIG:
      port-arg-values:
        integer literal Event_ECU_NO_VEH_CONFIG: type=Dem_EventIdType, value=11
    port-api-option enable-take-address=true, indirect-api=false, port=Event_EEPROM_ERROR:
      port-arg-values:
        integer literal Event_EEPROM_ERROR: type=Dem_EventIdType, value=14
    port-api-option enable-take-address=true, indirect-api=false, port=Event_HIGH_VOLTAGE:
      port-arg-values:
        integer literal Event_HIGH_VOLTAGE: type=Dem_EventIdType, value=10
    port-api-option enable-take-address=true, indirect-api=false, port=Event_LOW_VOLTAGE:
      port-arg-values:
        integer literal Event_LOW_VOLTAGE: type=Dem_EventIdType, value=9
    port-api-option enable-take-address=true, indirect-api=false, port=Event_MTR_CIR_ELEC_FAILURE:
      port-arg-values:
        integer literal Event_MTR_CIR_ELEC_FAILURE: type=Dem_EventIdType, value=18
    port-api-option enable-take-address=true, indirect-api=false, port=Event_MTR_CIR_MECH_FAILURE:
      port-arg-values:
        integer literal Event_MTR_CIR_MECH_FAILURE: type=Dem_EventIdType, value=17
    port-api-option enable-take-address=true, indirect-api=false, port=Event_SRS_ATTEMPTS_EXCEEDED:
      port-arg-values:
        integer literal Event_SRS_ATTEMPTS_EXCEEDED: type=Dem_EventIdType, value=19
    port-api-option enable-take-address=true, indirect-api=false, port=Event_STR_WHL_ANG_MISSING_MSG:
      port-arg-values:
        integer literal Event_STR_WHL_ANG_MISSING_MSG: type=Dem_EventIdType, value=3
    port-api-option enable-take-address=true, indirect-api=false, port=Event_TEMPERATURE_TOO_HIGH:
      port-arg-values:
        integer literal Event_TEMPERATURE_TOO_HIGH: type=Dem_EventIdType, value=20
    port-api-option enable-take-address=true, indirect-api=false, port=Event_TRQ_SEN_CAL_NOT_LEARNED:
      port-arg-values:
        integer literal Event_TRQ_SEN_CAL_NOT_LEARNED: type=Dem_EventIdType, value=15
    port-api-option enable-take-address=true, indirect-api=false, port=Event_TRQ_SEN_ELEC_FAILURE:
      port-arg-values:
        integer literal Event_TRQ_SEN_ELEC_FAILURE: type=Dem_EventIdType, value=16
    port-api-option enable-take-address=true, indirect-api=false, port=IndStatus_Warning_Indicator:
      port-arg-values:
        integer literal IndStatus_Warning_Indicator: type=UInt8, value=0
    port-api-option enable-take-address=true, indirect-api=false, port=OpCycle_DEM_IGNITION:
      port-arg-values:
        integer literal OpCycle_DEM_IGNITION: type=Dem_OperationCycleIdType, value=0
    port-api-option enable-take-address=true, indirect-api=false, port=OpCycle_DEM_OBD_DCY:
      port-arg-values:
        integer literal OpCycle_DEM_OBD_DCY: type=Dem_OperationCycleIdType, value=1
    port-api-option enable-take-address=true, indirect-api=false, port=OpCycle_DEM_POWER:
      port-arg-values:
        integer literal OpCycle_DEM_POWER: type=Dem_OperationCycleIdType, value=3
    port-api-option enable-take-address=true, indirect-api=false, port=OpCycle_DEM_WARMUP:
      port-arg-values:
        integer literal OpCycle_DEM_WARMUP: type=Dem_OperationCycleIdType, value=2
    10 x runnable:
      Dem_MainFunction
      GetDTCOfEvent: can-be-invoked-concurrently=true, symbol=Dem_GetDTCOfEvent
      GetEventFailed: can-be-invoked-concurrently=true, symbol=Dem_GetEventFailed
      GetEventStatus: can-be-invoked-concurrently=true, symbol=Dem_GetEventStatus
      GetEventTested: can-be-invoked-concurrently=true, symbol=Dem_GetEventTested
      GetFaultDetectionCounter: can-be-invoked-concurrently=true, symbol=Dem_GetFaultDetectionCounter
      GetIndicatorStatus: can-be-invoked-concurrently=true, symbol=Dem_GetIndicatorStatus
      ResetEventStatus: can-be-invoked-concurrently=true, symbol=Dem_ResetEventStatus
      SetEventStatus: can-be-invoked-concurrently=true, symbol=Dem_SetEventStatus
      SetOperationCycleState: can-be-invoked-concurrently=true, symbol=Dem_SetOperationCycleState
  service component type Dem: category=ServiceComponent
    25 x provide port:
      Event_BCM_MISSING_MSG: provided-interface=DiagnosticMonitor
        provided-com-specs:
          operation=GetDTCOfEvent, queue-length=1
          operation=GetEventFailed, queue-length=1
          operation=GetEventStatus, queue-length=1
          operation=GetEventTested, queue-length=1
          operation=GetFaultDetectionCounter, queue-length=1
          operation=ResetEventStatus, queue-length=1
          operation=SetEventStatus, queue-length=1
      Event_BUS_OFF: provided-interface=DiagnosticMonitor
        provided-com-specs:
          operation=GetDTCOfEvent, queue-length=1
          operation=GetEventFailed, queue-length=1
          operation=GetEventStatus, queue-length=1
          operation=GetEventTested, queue-length=1
          operation=GetFaultDetectionCounter, queue-length=1
          operation=ResetEventStatus, queue-length=1
          operation=SetEventStatus, queue-length=1
      Event_COMM_ENABLE_FAILURE: provided-interface=DiagnosticMonitor
        provided-com-specs:
          operation=GetDTCOfEvent, queue-length=1
          operation=GetEventFailed, queue-length=1
          operation=GetEventStatus, queue-length=1
          operation=GetEventTested, queue-length=1
          operation=GetFaultDetectionCounter, queue-length=1
          operation=ResetEventStatus, queue-length=1
          operation=SetEventStatus, queue-length=1
      Event_EBCM_INVALID_DATA: provided-interface=DiagnosticMonitor
        provided-com-specs:
          operation=GetDTCOfEvent, queue-length=1
          operation=GetEventFailed, queue-length=1
          operation=GetEventStatus, queue-length=1
          operation=GetEventTested, queue-length=1
          operation=GetFaultDetectionCounter, queue-length=1
          operation=ResetEventStatus, queue-length=1
          operation=SetEventStatus, queue-length=1
      Event_EBCM_MISSING_MSG: provided-interface=DiagnosticMonitor
        provided-com-specs:
          operation=GetDTCOfEvent, queue-length=1
          operation=GetEventFailed, queue-length=1
          operation=GetEventStatus, queue-length=1
          operation=GetEventTested, queue-length=1
          operation=GetFaultDetectionCounter, queue-length=1
          operation=ResetEventStatus, queue-length=1
          operation=SetEventStatus, queue-length=1
      Event_ECM_INVALID_DATA: provided-interface=DiagnosticMonitor
        provided-com-specs:
          operation=GetDTCOfEvent, queue-length=1
          operation=GetEventFailed, queue-length=1
          operation=GetEventStatus, queue-length=1
          operation=GetEventTested, queue-length=1
          operation=GetFaultDetectionCounter, queue-length=1
          operation=ResetEventStatus, queue-length=1
          operation=SetEventStatus, queue-length=1
      Event_ECM_MISSING_MSG: provided-interface=DiagnosticMonitor
        provided-com-specs:
          operation=GetDTCOfEvent, queue-length=1
          operation=GetEventFailed, queue-length=1
          operation=GetEventStatus, queue-length=1
          operation=GetEventTested, queue-length=1
          operation=GetFaultDetectionCounter, queue-length=1
          operation=ResetEventStatus, queue-length=1
          operation=SetEventStatus, queue-length=1
      Event_ECU_INCORRECT_COMP: provided-interface=DiagnosticMonitor
        provided-com-specs:
          operation=GetDTCOfEvent, queue-length=1
          operation=GetEventFailed, queue-length=1
          operation=GetEventStatus, queue-length=1
          operation=GetEventTested, queue-length=1
          operation=GetFaultDetectionCounter, queue-length=1
          operation=ResetEventStatus, queue-length=1
          operation=SetEventStatus, queue-length=1
      Event_ECU_INTERNAL_FAILURE: provided-interface=DiagnosticMonitor
        provided-com-specs:
          operation=GetDTCOfEvent, queue-length=1
          operation=GetEventFailed, queue-length=1
          operation=GetEventStatus, queue-length=1
          operation=GetEventTested, queue-length=1
          operation=GetFaultDetectionCounter, queue-length=1
          operation=ResetEventStatus, queue-length=1
          operation=SetEventStatus, queue-length=1
      Event_ECU_NO_VEH_CONFIG: provided-interface=DiagnosticMonitor
        provided-com-specs:
          operation=GetDTCOfEvent, queue-length=1
          operation=GetEventFailed, queue-length=1
          operation=GetEventStatus, queue-length=1
          operation=GetEventTested, queue-length=1
          operation=GetFaultDetectionCounter, queue-length=1
          operation=ResetEventStatus, queue-length=1
          operation=SetEventStatus, queue-length=1
      Event_EEPROM_ERROR: provided-interface=DiagnosticMonitor
        provided-com-specs:
          operation=GetDTCOfEvent, queue-length=1
          operation=GetEventFailed, queue-length=1
          operation=GetEventStatus, queue-length=1
          operation=GetEventTested, queue-length=1
          operation=GetFaultDetectionCounter, queue-length=1
          operation=ResetEventStatus, queue-length=1
          operation=SetEventStatus, queue-length=1
      Event_HIGH_VOLTAGE: provided-interface=DiagnosticMonitor
        provided-com-specs:
          operation=GetDTCOfEvent, queue-length=1
          operation=GetEventFailed, queue-length=1
          operation=GetEventStatus, queue-length=1
          operation=GetEventTested, queue-length=1
          operation=GetFaultDetectionCounter, queue-length=1
          operation=ResetEventStatus, queue-length=1
          operation=SetEventStatus, queue-length=1
      Event_LOW_VOLTAGE: provided-interface=DiagnosticMonitor
        provided-com-specs:
          operation=GetDTCOfEvent, queue-length=1
          operation=GetEventFailed, queue-length=1
          operation=GetEventStatus, queue-length=1
          operation=GetEventTested, queue-length=1
          operation=GetFaultDetectionCounter, queue-length=1
          operation=ResetEventStatus, queue-length=1
          operation=SetEventStatus, queue-length=1
      Event_MTR_CIR_ELEC_FAILURE: provided-interface=DiagnosticMonitor
        provided-com-specs:
          operation=GetDTCOfEvent, queue-length=1
          operation=GetEventFailed, queue-length=1
          operation=GetEventStatus, queue-length=1
          operation=GetEventTested, queue-length=1
          operation=GetFaultDetectionCounter, queue-length=1
          operation=ResetEventStatus, queue-length=1
          operation=SetEventStatus, queue-length=1
      Event_MTR_CIR_MECH_FAILURE: provided-interface=DiagnosticMonitor
        provided-com-specs:
          operation=GetDTCOfEvent, queue-length=1
          operation=GetEventFailed, queue-length=1
          operation=GetEventStatus, queue-length=1
          operation=GetEventTested, queue-length=1
          operation=GetFaultDetectionCounter, queue-length=1
          operation=ResetEventStatus, queue-length=1
          operation=SetEventStatus, queue-length=1
      Event_SRS_ATTEMPTS_EXCEEDED: provided-interface=DiagnosticMonitor
        provided-com-specs:
          operation=GetDTCOfEvent, queue-length=1
          operation=GetEventFailed, queue-length=1
          operation=GetEventStatus, queue-length=1
          operation=GetEventTested, queue-length=1
          operation=GetFaultDetectionCounter, queue-length=1
          operation=ResetEventStatus, queue-length=1
          operation=SetEventStatus, queue-length=1
      Event_STR_WHL_ANG_MISSING_MSG: provided-interface=DiagnosticMonitor
        provided-com-specs:
          operation=GetDTCOfEvent, queue-length=1
          operation=GetEventFailed, queue-length=1
          operation=GetEventStatus, queue-length=1
          operation=GetEventTested, queue-length=1
          operation=GetFaultDetectionCounter, queue-length=1
          operation=ResetEventStatus, queue-length=1
          operation=SetEventStatus, queue-length=1
      Event_TEMPERATURE_TOO_HIGH: provided-interface=DiagnosticMonitor
        provided-com-specs:
          operation=GetDTCOfEvent, queue-length=1
          operation=GetEventFailed, queue-length=1
          operation=GetEventStatus, queue-length=1
          operation=GetEventTested, queue-length=1
          operation=GetFaultDetectionCounter, queue-length=1
          operation=ResetEventStatus, queue-length=1
          operation=SetEventStatus, queue-length=1
      Event_TRQ_SEN_CAL_NOT_LEARNED: provided-interface=DiagnosticMonitor
        provided-com-specs:
          operation=GetDTCOfEvent, queue-length=1
          operation=GetEventFailed, queue-length=1
          operation=GetEventStatus, queue-length=1
          operation=GetEventTested, queue-length=1
          operation=GetFaultDetectionCounter, queue-length=1
          operation=ResetEventStatus, queue-length=1
          operation=SetEventStatus, queue-length=1
      Event_TRQ_SEN_ELEC_FAILURE: provided-interface=DiagnosticMonitor
        provided-com-specs:
          operation=GetDTCOfEvent, queue-length=1
          operation=GetEventFailed, queue-length=1
          operation=GetEventStatus, queue-length=1
          operation=GetEventTested, queue-length=1
          operation=GetFaultDetectionCounter, queue-length=1
          operation=ResetEventStatus, queue-length=1
          operation=SetEventStatus, queue-length=1
      IndStatus_Warning_Indicator: server-com-spec{operation=GetIndicatorStatus, queue-length=1}, provided-interface=IndicatorStatus
      OpCycle_DEM_IGNITION: server-com-spec{operation=SetOperationCycleState, queue-length=1}, provided-interface=OperationCycle
      OpCycle_DEM_OBD_DCY: server-com-spec{operation=SetOperationCycleState, queue-length=1}, provided-interface=OperationCycle
      OpCycle_DEM_POWER: server-com-spec{operation=SetOperationCycleState, queue-length=1}, provided-interface=OperationCycle
      OpCycle_DEM_WARMUP: server-com-spec{operation=SetOperationCycleState, queue-length=1}, provided-interface=OperationCycle
  swc implementation Dem_Implementation: behavior=Dem_InternalBehavior
    code-descriptors:
      code Code: type=SRC
package /DataType
  9 x integer type:
    Dem_DTCKindType: compu {1=DEM_DTC_KIND_ALL_DTCS, 2=DEM_DTC_KIND_EMISSION_REL_DTCS}, lower-limit=1, upper-limit=2
    Dem_DTCType: lower-limit=0, upper-limit=4294967295
    Dem_EventIdType: lower-limit=0, upper-limit=255
    Dem_EventStatusExtendedType: lower-limit=0, upper-limit=255
    Dem_EventStatusType: compu {0=DEM_EVENT_STATUS_PASSED, 1=DEM_EVENT_STATUS_FAILED, 2=DEM_EVENT_STATUS_PREPASSED, 3=DEM_EVENT_STATUS_PREFAILED}, lower-limit=0, upper-limit=255
    Dem_FaultDetectionCounterType: lower-limit=-128, upper-limit=127
    Dem_IndicatorStatusType: compu {0=DEM_INDICATOR_OFF, 1=DEM_INDICATOR_CONTINUOUS, 2=DEM_INDICATOR_BLINKING, 3=DEM_INDICATOR_BLINK_CONT}, lower-limit=0, upper-limit=3
    Dem_OperationCycleIdType: lower-limit=0, upper-limit=255
    Dem_OperationCycleStateType: compu {1=DEM_CYCLE_STATE_START, 2=DEM_CYCLE_STATE_END}, lower-limit=1, upper-limit=2
package /PortInterface
  client server interface DiagnosticMonitor: is-service=true
    7 x operation:
      GetDTCOfEvent: possible-error=[DEM_GET_DTCOFEVENT_WRONG_DTCKIND, DEM_GET_DTCOFEVENT_WRONG_EVENTID, DiagnosticMonitor/E_NOT_OK]
        arg DTCKind: type=Dem_DTCKindType, direction=IN
        arg DTC: type=Dem_DTCType, direction=OUT
      GetEventFailed: possible-error=DiagnosticMonitor/E_NOT_OK
        arg Failed: type=Boolean, direction=OUT
      GetEventStatus: possible-error=DiagnosticMonitor/E_NOT_OK
        arg EventStatus: type=Dem_EventStatusExtendedType, direction=OUT
      GetEventTested: possible-error=DiagnosticMonitor/E_NOT_OK
        arg Failed: type=Boolean, direction=OUT
      GetFaultDetectionCounter: possible-error=DiagnosticMonitor/E_NOT_OK
        arg EventIdFaultDetectionCounter: type=Dem_FaultDetectionCounterType, direction=OUT
      ResetEventStatus: possible-error=[DiagnosticMonitor/DEM_E_QUEUE_OVERFLOW, DiagnosticMonitor/E_NOT_OK]
      SetEventStatus: possible-error=[DiagnosticMonitor/DEM_E_QUEUE_OVERFLOW, DiagnosticMonitor/E_NOT_OK]
        arg EventStatus: type=Dem_EventStatusType, direction=IN
    4 x error:
      DEM_E_QUEUE_OVERFLOW: error-code=15
      DEM_GET_DTCOFEVENT_WRONG_DTCKIND: error-code=4
      DEM_GET_DTCOFEVENT_WRONG_EVENTID: error-code=5
      E_NOT_OK: error-code=1
  client server interface IndicatorStatus: is-service=true
    operation GetIndicatorStatus: possible-error=IndicatorStatus/E_NOT_OK
      arg IndicatorStatus: type=Dem_IndicatorStatusType, direction=OUT
    error E_NOT_OK: error-code=1
  client server interface OperationCycle: is-service=true
    operation SetOperationCycleState: possible-error=[OperationCycle/DEM_E_QUEUE_OVERFLOW, OperationCycle/E_NOT_OK]
      arg CycleState: type=Dem_OperationCycleStateType, direction=IN
    error DEM_E_QUEUE_OVERFLOW: error-code=15
    error E_NOT_OK: error-code=1
