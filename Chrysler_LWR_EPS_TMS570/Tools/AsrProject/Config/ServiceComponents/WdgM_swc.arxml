AUTOSAR XML (schema 3.1.4)
standard types defined: UInt8, UInt16
package /ComponentType
  service component type WdgM: category=ServiceComponent
    32 x provide port:
      SE000_SE100ms_9_CP000_CtrlTemp_Per2_CP0: provided-interface=WdgM_AliveSupervision  # P-Port Prototype for Supervised Entity SE100ms_9 with ID 0 and Checkpoint CtrlTemp_Per2_CP0 with ID 0.
      SE000_SE100ms_9_CP001_ThrmlDutyCycle_Per1_CP1: provided-interface=WdgM_AliveSupervision  # P-Port Prototype for Supervised Entity SE100ms_9 with ID 0 and Checkpoint ThrmlDutyCycle_Per1_CP1 with ID 1.
      SE000_SE100ms_9: provided-interface=WdgM_IndividualMode  # P-Port Prototype for Supervised Entity SE100ms_9 with ID 0
      SE001_SE100ms_10_CP000_HwTrq_Per3_CP0: provided-interface=WdgM_AliveSupervision  # P-Port Prototype for Supervised Entity SE100ms_10 with ID 1 and Checkpoint HwTrq_Per3_CP0 with ID 0.
      SE001_SE100ms_10_CP001_uDiagStaticRegs_Per_CP1: provided-interface=WdgM_AliveSupervision  # P-Port Prototype for Supervised Entity SE100ms_10 with ID 1 and Checkpoint uDiagStaticRegs_Per_CP1 with ID 1.
      SE001_SE100ms_10: provided-interface=WdgM_IndividualMode  # P-Port Prototype for Supervised Entity SE100ms_10 with ID 1
      SE002_SE100ms_8_CP000_HwTrq2_Per3_CP0: provided-interface=WdgM_AliveSupervision  # P-Port Prototype for Supervised Entity SE100ms_8 with ID 2 and Checkpoint HwTrq2_Per3_CP0 with ID 0.
      SE002_SE100ms_8: provided-interface=WdgM_IndividualMode  # P-Port Prototype for Supervised Entity SE100ms_8 with ID 2
      SE003_SE10ms_10_CP000_TuningSelAuth_Per1_CP0: provided-interface=WdgM_AliveSupervision  # P-Port Prototype for Supervised Entity SE10ms_10 with ID 3 and Checkpoint TuningSelAuth_Per1_CP0 with ID 0.
      SE003_SE10ms_10_CP001_PAwTO_Per2_CP1: provided-interface=WdgM_AliveSupervision  # P-Port Prototype for Supervised Entity SE10ms_10 with ID 3 and Checkpoint PAwTO_Per2_CP1 with ID 1.
      SE003_SE10ms_10: provided-interface=WdgM_IndividualMode  # P-Port Prototype for Supervised Entity SE10ms_10 with ID 3
      SE004_SE10ms_9_CP000_SrlComInput_Per1_CP0: provided-interface=WdgM_AliveSupervision  # P-Port Prototype for Supervised Entity SE10ms_9 with ID 4 and Checkpoint SrlComInput_Per1_CP0 with ID 0.
      SE004_SE10ms_9_CP001_BVDiag_Per1_CP1: provided-interface=WdgM_AliveSupervision  # P-Port Prototype for Supervised Entity SE10ms_9 with ID 4 and Checkpoint BVDiag_Per1_CP1 with ID 1.
      SE004_SE10ms_9: provided-interface=WdgM_IndividualMode  # P-Port Prototype for Supervised Entity SE10ms_9 with ID 4
      SE005_SE4ms_8_CP000_MtrVel2_Per2_CP0: provided-interface=WdgM_AliveSupervision  # P-Port Prototype for Supervised Entity SE4ms_8 with ID 5 and Checkpoint MtrVel2_Per2_CP0 with ID 0.
      SE005_SE4ms_8_CP001_MtrPos3_Per2_CP1: provided-interface=WdgM_AliveSupervision  # P-Port Prototype for Supervised Entity SE4ms_8 with ID 5 and Checkpoint MtrPos3_Per2_CP1 with ID 1.
      SE005_SE4ms_8: provided-interface=WdgM_IndividualMode  # P-Port Prototype for Supervised Entity SE4ms_8 with ID 5
      SE006_SE4ms_10_CP000_uDiagLossOfExec_per3_CP0: provided-interface=WdgM_AliveSupervision  # P-Port Prototype for Supervised Entity SE4ms_10 with ID 6 and Checkpoint uDiagLossOfExec_per3_CP0 with ID 0.
      SE006_SE4ms_10_CP001_ArbLmt_Per1_CP1: provided-interface=WdgM_AliveSupervision  # P-Port Prototype for Supervised Entity SE4ms_10 with ID 6 and Checkpoint ArbLmt_Per1_CP1 with ID 1.
      SE006_SE4ms_10: provided-interface=WdgM_IndividualMode  # P-Port Prototype for Supervised Entity SE4ms_10 with ID 6
      SE007_SE2ms_10_CP000_MtrVel_Per1_CP0: provided-interface=WdgM_AliveSupervision  # P-Port Prototype for Supervised Entity SE2ms_10 with ID 7 and Checkpoint MtrVel_Per1_CP0 with ID 0.
      SE007_SE2ms_10_CP001_StaMd_Per1_CP1: provided-interface=WdgM_AliveSupervision  # P-Port Prototype for Supervised Entity SE2ms_10 with ID 7 and Checkpoint StaMd_Per1_CP1 with ID 1.
      SE007_SE2ms_10_CP002_GlbFinal_CP0: provided-interface=WdgM_AliveSupervision  # P-Port Prototype for Supervised Entity SE2ms_10 with ID 7 and Checkpoint GlbFinal_CP0 with ID 2.
      SE007_SE2ms_10: provided-interface=WdgM_IndividualMode  # P-Port Prototype for Supervised Entity SE2ms_10 with ID 7
      SE008_SE2ms_9_CP000_BatterVoltage_Per1_CP0: provided-interface=WdgM_AliveSupervision  # P-Port Prototype for Supervised Entity SE2ms_9 with ID 8 and Checkpoint BatterVoltage_Per1_CP0 with ID 0.
      SE008_SE2ms_9_CP001_VehPwrMd_Per1_CP1: provided-interface=WdgM_AliveSupervision  # P-Port Prototype for Supervised Entity SE2ms_9 with ID 8 and Checkpoint VehPwrMd_Per1_CP1 with ID 1.
      SE008_SE2ms_9: provided-interface=WdgM_IndividualMode  # P-Port Prototype for Supervised Entity SE2ms_9 with ID 8
      SE009_SE2ms_8_CP000_MtrVel2_Per1_CP0: provided-interface=WdgM_AliveSupervision  # P-Port Prototype for Supervised Entity SE2ms_8 with ID 9 and Checkpoint MtrVel2_Per1_CP0 with ID 0.
      SE009_SE2ms_8_CP001_TmprlMon2_Per1_CP1: provided-interface=WdgM_AliveSupervision  # P-Port Prototype for Supervised Entity SE2ms_8 with ID 9 and Checkpoint TmprlMon2_Per1_CP1 with ID 1.
      SE009_SE2ms_8: provided-interface=WdgM_IndividualMode  # P-Port Prototype for Supervised Entity SE2ms_8 with ID 9
      Global: provided-interface=WdgM_GlobalMode  # P-Port Prototype for Global Mode
      MODE_0_CALLER_ID_0: provided-interface=WdgM_GlobalMode  # P-Port Prototype for Trigger Mode 0 and Caller ID 0
  swc implementation WdgM_Implementation: behavior=WdgM_InternalBehavior
  internal behavior WdgM_InternalBehavior: component=WdgM
    5 x operation invoked event:
      V_WDGM_GMO: start-on-event=GetMode, operation=Global.GetMode
      V_WDGM_0_CALLER_ID_0_SMO: start-on-event=SetMode, operation=MODE_0_CALLER_ID_0.SetMode
      V_WDGM_GGS: start-on-event=GetGlobalStatus, operation=Global.GetGlobalStatus
      V_WDGM_PRE: start-on-event=PerformReset, operation=Global.PerformReset
      V_WDGM_GSC: start-on-event=GlobalStateChangeCbk, operation=Global.GlobalStateChangeCbk
    timing event V_WDGM_MAI: start-on-event=MainFunction, period=0.004
    50 x operation invoked event:
      V_WDGM_SE000_SE100ms_9_GLS: start-on-event=GetLocalStatus, operation=SE000_SE100ms_9.GetLocalStatus
      V_WDGM_SE000_SE100ms_9_ASE: start-on-event=ActivateSupervisionEntity, operation=SE000_SE100ms_9.ActivateSupervisionEntity
      V_WDGM_SE000_SE100ms_9_DSE: start-on-event=DeactivateSupervisionEntity, operation=SE000_SE100ms_9.DeactivateSupervisionEntity
      V_WDGM_SE000_SE100ms_9_CP000_CtrlTemp_Per2_CP0_CPR: start-on-event=CheckpointReached, operation=SE000_SE100ms_9_CP000_CtrlTemp_Per2_CP0.CheckpointReached
      V_WDGM_SE000_SE100ms_9_CP001_ThrmlDutyCycle_Per1_CP1_CPR: start-on-event=CheckpointReached, operation=SE000_SE100ms_9_CP001_ThrmlDutyCycle_Per1_CP1.CheckpointReached
      V_WDGM_SE001_SE100ms_10_GLS: start-on-event=GetLocalStatus, operation=SE001_SE100ms_10.GetLocalStatus
      V_WDGM_SE001_SE100ms_10_ASE: start-on-event=ActivateSupervisionEntity, operation=SE001_SE100ms_10.ActivateSupervisionEntity
      V_WDGM_SE001_SE100ms_10_DSE: start-on-event=DeactivateSupervisionEntity, operation=SE001_SE100ms_10.DeactivateSupervisionEntity
      V_WDGM_SE001_SE100ms_10_CP000_HwTrq_Per3_CP0_CPR: start-on-event=CheckpointReached, operation=SE001_SE100ms_10_CP000_HwTrq_Per3_CP0.CheckpointReached
      V_WDGM_SE001_SE100ms_10_CP001_uDiagStaticRegs_Per_CP1_CPR: start-on-event=CheckpointReached, operation=SE001_SE100ms_10_CP001_uDiagStaticRegs_Per_CP1.CheckpointReached
      V_WDGM_SE002_SE100ms_8_GLS: start-on-event=GetLocalStatus, operation=SE002_SE100ms_8.GetLocalStatus
      V_WDGM_SE002_SE100ms_8_ASE: start-on-event=ActivateSupervisionEntity, operation=SE002_SE100ms_8.ActivateSupervisionEntity
      V_WDGM_SE002_SE100ms_8_DSE: start-on-event=DeactivateSupervisionEntity, operation=SE002_SE100ms_8.DeactivateSupervisionEntity
      V_WDGM_SE002_SE100ms_8_CP000_HwTrq2_Per3_CP0_CPR: start-on-event=CheckpointReached, operation=SE002_SE100ms_8_CP000_HwTrq2_Per3_CP0.CheckpointReached
      V_WDGM_SE003_SE10ms_10_GLS: start-on-event=GetLocalStatus, operation=SE003_SE10ms_10.GetLocalStatus
      V_WDGM_SE003_SE10ms_10_ASE: start-on-event=ActivateSupervisionEntity, operation=SE003_SE10ms_10.ActivateSupervisionEntity
      V_WDGM_SE003_SE10ms_10_DSE: start-on-event=DeactivateSupervisionEntity, operation=SE003_SE10ms_10.DeactivateSupervisionEntity
      V_WDGM_SE003_SE10ms_10_CP000_TuningSelAuth_Per1_CP0_CPR: start-on-event=CheckpointReached, operation=SE003_SE10ms_10_CP000_TuningSelAuth_Per1_CP0.CheckpointReached
      V_WDGM_SE003_SE10ms_10_CP001_PAwTO_Per2_CP1_CPR: start-on-event=CheckpointReached, operation=SE003_SE10ms_10_CP001_PAwTO_Per2_CP1.CheckpointReached
      V_WDGM_SE004_SE10ms_9_GLS: start-on-event=GetLocalStatus, operation=SE004_SE10ms_9.GetLocalStatus
      V_WDGM_SE004_SE10ms_9_ASE: start-on-event=ActivateSupervisionEntity, operation=SE004_SE10ms_9.ActivateSupervisionEntity
      V_WDGM_SE004_SE10ms_9_DSE: start-on-event=DeactivateSupervisionEntity, operation=SE004_SE10ms_9.DeactivateSupervisionEntity
      V_WDGM_SE004_SE10ms_9_CP000_SrlComInput_Per1_CP0_CPR: start-on-event=CheckpointReached, operation=SE004_SE10ms_9_CP000_SrlComInput_Per1_CP0.CheckpointReached
      V_WDGM_SE004_SE10ms_9_CP001_BVDiag_Per1_CP1_CPR: start-on-event=CheckpointReached, operation=SE004_SE10ms_9_CP001_BVDiag_Per1_CP1.CheckpointReached
      V_WDGM_SE005_SE4ms_8_GLS: start-on-event=GetLocalStatus, operation=SE005_SE4ms_8.GetLocalStatus
      V_WDGM_SE005_SE4ms_8_ASE: start-on-event=ActivateSupervisionEntity, operation=SE005_SE4ms_8.ActivateSupervisionEntity
      V_WDGM_SE005_SE4ms_8_DSE: start-on-event=DeactivateSupervisionEntity, operation=SE005_SE4ms_8.DeactivateSupervisionEntity
      V_WDGM_SE005_SE4ms_8_CP000_MtrVel2_Per2_CP0_CPR: start-on-event=CheckpointReached, operation=SE005_SE4ms_8_CP000_MtrVel2_Per2_CP0.CheckpointReached
      V_WDGM_SE005_SE4ms_8_CP001_MtrPos3_Per2_CP1_CPR: start-on-event=CheckpointReached, operation=SE005_SE4ms_8_CP001_MtrPos3_Per2_CP1.CheckpointReached
      V_WDGM_SE006_SE4ms_10_GLS: start-on-event=GetLocalStatus, operation=SE006_SE4ms_10.GetLocalStatus
      V_WDGM_SE006_SE4ms_10_ASE: start-on-event=ActivateSupervisionEntity, operation=SE006_SE4ms_10.ActivateSupervisionEntity
      V_WDGM_SE006_SE4ms_10_DSE: start-on-event=DeactivateSupervisionEntity, operation=SE006_SE4ms_10.DeactivateSupervisionEntity
      V_WDGM_SE006_SE4ms_10_CP000_uDiagLossOfExec_per3_CP0_CPR: start-on-event=CheckpointReached, operation=SE006_SE4ms_10_CP000_uDiagLossOfExec_per3_CP0.CheckpointReached
      V_WDGM_SE006_SE4ms_10_CP001_ArbLmt_Per1_CP1_CPR: start-on-event=CheckpointReached, operation=SE006_SE4ms_10_CP001_ArbLmt_Per1_CP1.CheckpointReached
      V_WDGM_SE007_SE2ms_10_GLS: start-on-event=GetLocalStatus, operation=SE007_SE2ms_10.GetLocalStatus
      V_WDGM_SE007_SE2ms_10_ASE: start-on-event=ActivateSupervisionEntity, operation=SE007_SE2ms_10.ActivateSupervisionEntity
      V_WDGM_SE007_SE2ms_10_DSE: start-on-event=DeactivateSupervisionEntity, operation=SE007_SE2ms_10.DeactivateSupervisionEntity
      V_WDGM_SE007_SE2ms_10_CP000_MtrVel_Per1_CP0_CPR: start-on-event=CheckpointReached, operation=SE007_SE2ms_10_CP000_MtrVel_Per1_CP0.CheckpointReached
      V_WDGM_SE007_SE2ms_10_CP001_StaMd_Per1_CP1_CPR: start-on-event=CheckpointReached, operation=SE007_SE2ms_10_CP001_StaMd_Per1_CP1.CheckpointReached
      V_WDGM_SE007_SE2ms_10_CP002_GlbFinal_CP0_CPR: start-on-event=CheckpointReached, operation=SE007_SE2ms_10_CP002_GlbFinal_CP0.CheckpointReached
      V_WDGM_SE008_SE2ms_9_GLS: start-on-event=GetLocalStatus, operation=SE008_SE2ms_9.GetLocalStatus
      V_WDGM_SE008_SE2ms_9_ASE: start-on-event=ActivateSupervisionEntity, operation=SE008_SE2ms_9.ActivateSupervisionEntity
      V_WDGM_SE008_SE2ms_9_DSE: start-on-event=DeactivateSupervisionEntity, operation=SE008_SE2ms_9.DeactivateSupervisionEntity
      V_WDGM_SE008_SE2ms_9_CP000_BatterVoltage_Per1_CP0_CPR: start-on-event=CheckpointReached, operation=SE008_SE2ms_9_CP000_BatterVoltage_Per1_CP0.CheckpointReached
      V_WDGM_SE008_SE2ms_9_CP001_VehPwrMd_Per1_CP1_CPR: start-on-event=CheckpointReached, operation=SE008_SE2ms_9_CP001_VehPwrMd_Per1_CP1.CheckpointReached
      V_WDGM_SE009_SE2ms_8_GLS: start-on-event=GetLocalStatus, operation=SE009_SE2ms_8.GetLocalStatus
      V_WDGM_SE009_SE2ms_8_ASE: start-on-event=ActivateSupervisionEntity, operation=SE009_SE2ms_8.ActivateSupervisionEntity
      V_WDGM_SE009_SE2ms_8_DSE: start-on-event=DeactivateSupervisionEntity, operation=SE009_SE2ms_8.DeactivateSupervisionEntity
      V_WDGM_SE009_SE2ms_8_CP000_MtrVel2_Per1_CP0_CPR: start-on-event=CheckpointReached, operation=SE009_SE2ms_8_CP000_MtrVel2_Per1_CP0.CheckpointReached
      V_WDGM_SE009_SE2ms_8_CP001_TmprlMon2_Per1_CP1_CPR: start-on-event=CheckpointReached, operation=SE009_SE2ms_8_CP001_TmprlMon2_Per1_CP1.CheckpointReached
    port-api-option port=SE000_SE100ms_9_CP000_CtrlTemp_Per2_CP0:
      port-arg-values:
        integer literal SE000_SE100ms_9_0: type=WdgM_SupervisedEntityIdType, value=0
        integer literal CP000_CtrlTemp_Per2_CP0: type=WdgM_CheckpointIdType, value=0
    port-api-option port=SE000_SE100ms_9_CP001_ThrmlDutyCycle_Per1_CP1:
      port-arg-values:
        integer literal SE000_SE100ms_9_1: type=WdgM_SupervisedEntityIdType, value=0
        integer literal CP001_ThrmlDutyCycle_Per1_CP1: type=WdgM_CheckpointIdType, value=1
    port-api-option port=SE000_SE100ms_9:
      port-arg-values:
        integer literal SE000_SE100ms_9_GLS: type=WdgM_SupervisedEntityIdType, value=0
    port-api-option port=SE001_SE100ms_10_CP000_HwTrq_Per3_CP0:
      port-arg-values:
        integer literal SE001_SE100ms_10_0: type=WdgM_SupervisedEntityIdType, value=1
        integer literal CP000_HwTrq_Per3_CP0: type=WdgM_CheckpointIdType, value=0
    port-api-option port=SE001_SE100ms_10_CP001_uDiagStaticRegs_Per_CP1:
      port-arg-values:
        integer literal SE001_SE100ms_10_1: type=WdgM_SupervisedEntityIdType, value=1
        integer literal CP001_uDiagStaticRegs_Per_CP1: type=WdgM_CheckpointIdType, value=1
    port-api-option port=SE001_SE100ms_10:
      port-arg-values:
        integer literal SE001_SE100ms_10_GLS: type=WdgM_SupervisedEntityIdType, value=1
    port-api-option port=SE002_SE100ms_8_CP000_HwTrq2_Per3_CP0:
      port-arg-values:
        integer literal SE002_SE100ms_8_0: type=WdgM_SupervisedEntityIdType, value=2
        integer literal CP000_HwTrq2_Per3_CP0: type=WdgM_CheckpointIdType, value=0
    port-api-option port=SE002_SE100ms_8:
      port-arg-values:
        integer literal SE002_SE100ms_8_GLS: type=WdgM_SupervisedEntityIdType, value=2
    port-api-option port=SE003_SE10ms_10_CP000_TuningSelAuth_Per1_CP0:
      port-arg-values:
        integer literal SE003_SE10ms_10_0: type=WdgM_SupervisedEntityIdType, value=3
        integer literal CP000_TuningSelAuth_Per1_CP0: type=WdgM_CheckpointIdType, value=0
    port-api-option port=SE003_SE10ms_10_CP001_PAwTO_Per2_CP1:
      port-arg-values:
        integer literal SE003_SE10ms_10_1: type=WdgM_SupervisedEntityIdType, value=3
        integer literal CP001_PAwTO_Per2_CP1: type=WdgM_CheckpointIdType, value=1
    port-api-option port=SE003_SE10ms_10:
      port-arg-values:
        integer literal SE003_SE10ms_10_GLS: type=WdgM_SupervisedEntityIdType, value=3
    port-api-option port=SE004_SE10ms_9_CP000_SrlComInput_Per1_CP0:
      port-arg-values:
        integer literal SE004_SE10ms_9_0: type=WdgM_SupervisedEntityIdType, value=4
        integer literal CP000_SrlComInput_Per1_CP0: type=WdgM_CheckpointIdType, value=0
    port-api-option port=SE004_SE10ms_9_CP001_BVDiag_Per1_CP1:
      port-arg-values:
        integer literal SE004_SE10ms_9_1: type=WdgM_SupervisedEntityIdType, value=4
        integer literal CP001_BVDiag_Per1_CP1: type=WdgM_CheckpointIdType, value=1
    port-api-option port=SE004_SE10ms_9:
      port-arg-values:
        integer literal SE004_SE10ms_9_GLS: type=WdgM_SupervisedEntityIdType, value=4
    port-api-option port=SE005_SE4ms_8_CP000_MtrVel2_Per2_CP0:
      port-arg-values:
        integer literal SE005_SE4ms_8_0: type=WdgM_SupervisedEntityIdType, value=5
        integer literal CP000_MtrVel2_Per2_CP0: type=WdgM_CheckpointIdType, value=0
    port-api-option port=SE005_SE4ms_8_CP001_MtrPos3_Per2_CP1:
      port-arg-values:
        integer literal SE005_SE4ms_8_1: type=WdgM_SupervisedEntityIdType, value=5
        integer literal CP001_MtrPos3_Per2_CP1: type=WdgM_CheckpointIdType, value=1
    port-api-option port=SE005_SE4ms_8:
      port-arg-values:
        integer literal SE005_SE4ms_8_GLS: type=WdgM_SupervisedEntityIdType, value=5
    port-api-option port=SE006_SE4ms_10_CP000_uDiagLossOfExec_per3_CP0:
      port-arg-values:
        integer literal SE006_SE4ms_10_0: type=WdgM_SupervisedEntityIdType, value=6
        integer literal CP000_uDiagLossOfExec_per3_CP0: type=WdgM_CheckpointIdType, value=0
    port-api-option port=SE006_SE4ms_10_CP001_ArbLmt_Per1_CP1:
      port-arg-values:
        integer literal SE006_SE4ms_10_1: type=WdgM_SupervisedEntityIdType, value=6
        integer literal CP001_ArbLmt_Per1_CP1: type=WdgM_CheckpointIdType, value=1
    port-api-option port=SE006_SE4ms_10:
      port-arg-values:
        integer literal SE006_SE4ms_10_GLS: type=WdgM_SupervisedEntityIdType, value=6
    port-api-option port=SE007_SE2ms_10_CP000_MtrVel_Per1_CP0:
      port-arg-values:
        integer literal SE007_SE2ms_10_0: type=WdgM_SupervisedEntityIdType, value=7
        integer literal CP000_MtrVel_Per1_CP0: type=WdgM_CheckpointIdType, value=0
    port-api-option port=SE007_SE2ms_10_CP001_StaMd_Per1_CP1:
      port-arg-values:
        integer literal SE007_SE2ms_10_1: type=WdgM_SupervisedEntityIdType, value=7
        integer literal CP001_StaMd_Per1_CP1: type=WdgM_CheckpointIdType, value=1
    port-api-option port=SE007_SE2ms_10_CP002_GlbFinal_CP0:
      port-arg-values:
        integer literal SE007_SE2ms_10_2: type=WdgM_SupervisedEntityIdType, value=7
        integer literal CP002_GlbFinal_CP0: type=WdgM_CheckpointIdType, value=2
    port-api-option port=SE007_SE2ms_10:
      port-arg-values:
        integer literal SE007_SE2ms_10_GLS: type=WdgM_SupervisedEntityIdType, value=7
    port-api-option port=SE008_SE2ms_9_CP000_BatterVoltage_Per1_CP0:
      port-arg-values:
        integer literal SE008_SE2ms_9_0: type=WdgM_SupervisedEntityIdType, value=8
        integer literal CP000_BatterVoltage_Per1_CP0: type=WdgM_CheckpointIdType, value=0
    port-api-option port=SE008_SE2ms_9_CP001_VehPwrMd_Per1_CP1:
      port-arg-values:
        integer literal SE008_SE2ms_9_1: type=WdgM_SupervisedEntityIdType, value=8
        integer literal CP001_VehPwrMd_Per1_CP1: type=WdgM_CheckpointIdType, value=1
    port-api-option port=SE008_SE2ms_9:
      port-arg-values:
        integer literal SE008_SE2ms_9_GLS: type=WdgM_SupervisedEntityIdType, value=8
    port-api-option port=SE009_SE2ms_8_CP000_MtrVel2_Per1_CP0:
      port-arg-values:
        integer literal SE009_SE2ms_8_0: type=WdgM_SupervisedEntityIdType, value=9
        integer literal CP000_MtrVel2_Per1_CP0: type=WdgM_CheckpointIdType, value=0
    port-api-option port=SE009_SE2ms_8_CP001_TmprlMon2_Per1_CP1:
      port-arg-values:
        integer literal SE009_SE2ms_8_1: type=WdgM_SupervisedEntityIdType, value=9
        integer literal CP001_TmprlMon2_Per1_CP1: type=WdgM_CheckpointIdType, value=1
    port-api-option port=SE009_SE2ms_8:
      port-arg-values:
        integer literal SE009_SE2ms_8_GLS: type=WdgM_SupervisedEntityIdType, value=9
    port-api-option port=MODE_0_CALLER_ID_0:
      port-arg-values:
        integer literal MODE_0: type=WdgM_ModeType, value=0
        integer literal CALLER_0: type=UInt16, value=0
    10 x runnable, all with can-be-invoked-concurrently=true:
      GetMode: symbol=WdgM_GetMode
      SetMode: symbol=WdgM_SetMode
      CheckpointReached: symbol=WdgM_CheckpointReached
      GetLocalStatus: symbol=WdgM_GetLocalStatus
      ActivateSupervisionEntity: symbol=WdgM_ActivateSupervisionEntity
      DeactivateSupervisionEntity: symbol=WdgM_DeactivateSupervisionEntity
      GetGlobalStatus: symbol=WdgM_GetGlobalStatus
      PerformReset: symbol=WdgM_PerformReset
      MainFunction: symbol=WdgM_MainFunction
      GlobalStateChangeCbk
package /PortInterface
  client server interface WdgM_AliveSupervision: is-service=true
    operation CheckpointReached: possible-error=WdgM_AliveSupervision/E_NOT_OK  # Indicates to the Watchdog Manager that a Checkpoint within a Supervised Entity has been reached.
    error E_NOT_OK: error-code=1
  client server interface WdgM_IndividualMode: is-service=true
    operation GetLocalStatus: possible-error=WdgM_IndividualMode/E_NOT_OK  # Returns the monitoring status of an individual Supervised Entity.
      arg Status: type=WdgM_LocalStatusType, direction=OUT
    operation ActivateSupervisionEntity: possible-error=WdgM_IndividualMode/E_NOT_OK  # This function activates the monitoring of the given Supervised Entity
    operation DeactivateSupervisionEntity: possible-error=WdgM_IndividualMode/E_NOT_OK  # This function deactivates the monitoring of the given Supervised Entity
    error E_NOT_OK: error-code=1
  client server interface WdgM_GlobalMode: is-service=true
    7 x operation, all with possible-error=WdgM_GlobalMode/E_NOT_OK:
      GetMode  # Returns the current mode of the Watchdog Manager.
        arg Mode: type=WdgM_ModeType, direction=OUT
      SetMode  # Sets the mode of the Watchdog Manager if the caller is allowed to do so.
      MainFunction  # Performs the processing of the cyclic Watchdog Manager jobs.
      GetGlobalStatus  # Returns the global monitoring status of the Watchdog Manager.
        arg Status: type=WdgM_GlobalStatusType, direction=OUT
      GlobalStateChangeCbk  # Global state change callback notification
        arg Status: type=WdgM_GlobalStatusType, direction=IN
      LocalStateChangeCbk  # Local state change callback notification
        arg Status: type=WdgM_LocalStatusType, direction=IN
      PerformReset  # Instructs the Watchdog Manager to cause a watchdog reset.
    error E_NOT_OK: error-code=1
package /DataType
  5 x integer type, all with lower-limit=0:
    WdgM_SupervisedEntityIdType: upper-limit=65535
    WdgM_CheckpointIdType: upper-limit=65535
    WdgM_ModeType: upper-limit=255
    WdgM_LocalStatusType: compu {0=WDGM_LOCAL_STATUS_OK, 1=WDGM_LOCAL_STATUS_FAILED, 2=WDGM_LOCAL_STATUS_EXPIRED, 4=WDGM_LOCAL_STATUS_DEACTIVATED}, upper-limit=255
    WdgM_GlobalStatusType: compu {0=WDGM_GLOBAL_STATUS_OK, 1=WDGM_GLOBAL_STATUS_FAILED, 2=WDGM_GLOBAL_STATUS_EXPIRED, 3=WDGM_GLOBAL_STATUS_STOPPED, 4=WDGM_GLOBAL_STATUS_DEACTIVATED}, upper-limit=255
