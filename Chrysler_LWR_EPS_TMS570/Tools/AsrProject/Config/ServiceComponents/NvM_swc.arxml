AUTOSAR XML (schema 3.0.1)
standard types defined: Boolean, UInt8
package /ComponentType
  service component type NvM: category=ServiceComponent  # Software Component description for NvM generated from Ecuc Package: DaVinci_Project
    102 x provide port:
      PS_NVM_BLOCK_NXTRWIRSELECT: provided-interface=NvM_AC3_SRBS_Srv  # PPort_NVM_BLOCK_NXTRWIRSELECT : NvM_AC3_SRBS_Srv | P-Port Prototype of NvM_AC3_SRBS_Srv for NVRAM Block NVM_BLOCK_NXTRWIRSELECT
      PS_Rte_NvmBlock_MtrPos_MtrPosSnsr_EOLData: provided-interface=NvM_AC3_SRBS_Srv  # PPort_Rte_NvmBlock_MtrPos_MtrPosSnsr_EOLData : NvM_AC3_SRBS_Srv | P-Port Prototype of NvM_AC3_SRBS_Srv for NVRAM Block Rte_NvmBlock_MtrPos_MtrPosSnsr_EOLData
      PS_Rte_NvmBlock_HwTrq_HwTrqScaleData: provided-interface=NvM_AC3_SRBS_Srv  # PPort_Rte_NvmBlock_HwTrq_HwTrqScaleData : NvM_AC3_SRBS_Srv | P-Port Prototype of NvM_AC3_SRBS_Srv for NVRAM Block Rte_NvmBlock_HwTrq_HwTrqScaleData
      PS_Rte_NvmBlock_Polarity_EOLCtrlPolarity: provided-interface=NvM_AC3_SRBS_Srv  # PPort_Rte_NvmBlock_Polarity_EOLCtrlPolarity : NvM_AC3_SRBS_Srv | P-Port Prototype of NvM_AC3_SRBS_Srv for NVRAM Block Rte_NvmBlock_Polarity_EOLCtrlPolarity
      PS_Rte_NvmBlock_HwTrq_HwTrqTrimData: provided-interface=NvM_AC3_SRBS_Srv  # PPort_Rte_NvmBlock_HwTrq_HwTrqTrimData : NvM_AC3_SRBS_Srv | P-Port Prototype of NvM_AC3_SRBS_Srv for NVRAM Block Rte_NvmBlock_HwTrq_HwTrqTrimData
      PS_NVM_BLOCK_DIAGMGR_NTCSTRG: provided-interface=NvM_AC3_SRBS_Srv  # PPort_NVM_BLOCK_DIAGMGR_NTCSTRG : NvM_AC3_SRBS_Srv | P-Port Prototype of NvM_AC3_SRBS_Srv for NVRAM Block NVM_BLOCK_DIAGMGR_NTCSTRG
      PS_NVM_BLOCK_EPSDEFEATS: provided-interface=NvM_AC3_SRBS_Srv  # PPort_NVM_BLOCK_EPSDEFEATS : NvM_AC3_SRBS_Srv | P-Port Prototype of NvM_AC3_SRBS_Srv for NVRAM Block NVM_BLOCK_EPSDEFEATS
      PS_Rte_NvmBlock_StaMd_TypeHRamBuffer: provided-interface=NvM_AC3_SRBS_Srv  # PPort_Rte_NvmBlock_StaMd_TypeHRamBuffer : NvM_AC3_SRBS_Srv | P-Port Prototype of NvM_AC3_SRBS_Srv for NVRAM Block Rte_NvmBlock_StaMd_TypeHRamBuffer
      PS_Rte_NvmBlock_TrqCmdScl_TorqueCmdSF_Uls_f32: provided-interface=NvM_AC3_SRBS_Srv  # PPort_Rte_NvmBlock_TrqCmdScl_TorqueCmdSF_Uls_f32 : NvM_AC3_SRBS_Srv | P-Port Prototype of NvM_AC3_SRBS_Srv for NVRAM Block Rte_NvmBlock_TrqCmdScl_TorqueCmdSF_Uls_f32
      PS_Rte_NvmBlock_CmMtrCurr_CurrTempOffset: provided-interface=NvM_AC3_SRBS_Srv  # PPort_Rte_NvmBlock_CmMtrCurr_CurrTempOffset : NvM_AC3_SRBS_Srv | P-Port Prototype of NvM_AC3_SRBS_Srv for NVRAM Block Rte_NvmBlock_CmMtrCurr_CurrTempOffset
      PS_Rte_NvmBlock_CmMtrCurr_ShCurrCal: provided-interface=NvM_AC3_SRBS_Srv  # PPort_Rte_NvmBlock_CmMtrCurr_ShCurrCal : NvM_AC3_SRBS_Srv | P-Port Prototype of NvM_AC3_SRBS_Srv for NVRAM Block Rte_NvmBlock_CmMtrCurr_ShCurrCal
      PS_Rte_NvmBlock_CurrParamComp_EOLNomMtrParam: provided-interface=NvM_AC3_SRBS_Srv  # PPort_Rte_NvmBlock_CurrParamComp_EOLNomMtrParam : NvM_AC3_SRBS_Srv | P-Port Prototype of NvM_AC3_SRBS_Srv for NVRAM Block Rte_NvmBlock_CurrParamComp_EOLNomMtrParam
      PS_Rte_NvmBlock_LrnEOT_LearnedEOT: provided-interface=NvM_AC3_SRBS_Srv  # PPort_Rte_NvmBlock_LrnEOT_LearnedEOT : NvM_AC3_SRBS_Srv | P-Port Prototype of NvM_AC3_SRBS_Srv for NVRAM Block Rte_NvmBlock_LrnEOT_LearnedEOT
      PS_Rte_NvmBlock_IPMTrqCanc_CogTrqCal: provided-interface=NvM_AC3_SRBS_Srv  # PPort_Rte_NvmBlock_IPMTrqCanc_CogTrqCal : NvM_AC3_SRBS_Srv | P-Port Prototype of NvM_AC3_SRBS_Srv for NVRAM Block Rte_NvmBlock_IPMTrqCanc_CogTrqCal
      PS_Rte_NvmBlock_HwTrq_EOLTrqStepData: provided-interface=NvM_AC3_SRBS_Srv  # PPort_Rte_NvmBlock_HwTrq_EOLTrqStepData : NvM_AC3_SRBS_Srv | P-Port Prototype of NvM_AC3_SRBS_Srv for NVRAM Block Rte_NvmBlock_HwTrq_EOLTrqStepData
      PS_NVM_BLOCK_SER_METADATA_APPLICATION: provided-interface=NvM_AC3_SRBS_Srv  # PPort_NVM_BLOCK_SER_METADATA_APPLICATION : NvM_AC3_SRBS_Srv | P-Port Prototype of NvM_AC3_SRBS_Srv for NVRAM Block NVM_BLOCK_SER_METADATA_APPLICATION
      PS_NVM_BLOCK_SER_METADATA_CAL1: provided-interface=NvM_AC3_SRBS_Srv  # PPort_NVM_BLOCK_SER_METADATA_CAL1 : NvM_AC3_SRBS_Srv | P-Port Prototype of NvM_AC3_SRBS_Srv for NVRAM Block NVM_BLOCK_SER_METADATA_CAL1
      PS_NVM_BLOCK_SER_METADATA_CAL2: provided-interface=NvM_AC3_SRBS_Srv  # PPort_NVM_BLOCK_SER_METADATA_CAL2 : NvM_AC3_SRBS_Srv | P-Port Prototype of NvM_AC3_SRBS_Srv for NVRAM Block NVM_BLOCK_SER_METADATA_CAL2
      PS_NVM_BLOCK_SER_ACTIVEDIAGINFO_BOOT: provided-interface=NvM_AC3_SRBS_Srv  # PPort_NVM_BLOCK_SER_ACTIVEDIAGINFO_BOOT : NvM_AC3_SRBS_Srv | P-Port Prototype of NvM_AC3_SRBS_Srv for NVRAM Block NVM_BLOCK_SER_ACTIVEDIAGINFO_BOOT
      PS_NVM_BLOCK_SER_HWPARTNUMBER: provided-interface=NvM_AC3_SRBS_Srv  # PPort_NVM_BLOCK_SER_HWPARTNUMBER : NvM_AC3_SRBS_Srv | P-Port Prototype of NvM_AC3_SRBS_Srv for NVRAM Block NVM_BLOCK_SER_HWPARTNUMBER
      PS_NVM_BLOCK_SER_HWVERSIONINFO: provided-interface=NvM_AC3_SRBS_Srv  # PPort_NVM_BLOCK_SER_HWVERSIONINFO : NvM_AC3_SRBS_Srv | P-Port Prototype of NvM_AC3_SRBS_Srv for NVRAM Block NVM_BLOCK_SER_HWVERSIONINFO
      PS_NVM_BLOCK_SER_BOOTSWVERSIONINFO: provided-interface=NvM_AC3_SRBS_Srv  # PPort_NVM_BLOCK_SER_BOOTSWVERSIONINFO : NvM_AC3_SRBS_Srv | P-Port Prototype of NvM_AC3_SRBS_Srv for NVRAM Block NVM_BLOCK_SER_BOOTSWVERSIONINFO
      PS_NVM_BLOCK_SER_HWSUPPID: provided-interface=NvM_AC3_SRBS_Srv  # PPort_NVM_BLOCK_SER_HWSUPPID : NvM_AC3_SRBS_Srv | P-Port Prototype of NvM_AC3_SRBS_Srv for NVRAM Block NVM_BLOCK_SER_HWSUPPID
      PS_NVM_BLOCK_SER_RESPONEVENTACTVSTATE: provided-interface=NvM_AC3_SRBS_Srv  # PPort_NVM_BLOCK_SER_RESPONEVENTACTVSTATE : NvM_AC3_SRBS_Srv | P-Port Prototype of NvM_AC3_SRBS_Srv for NVRAM Block NVM_BLOCK_SER_RESPONEVENTACTVSTATE
      PS_NVM_BLOCK_SER_VINODOMETERCOUNTER: provided-interface=NvM_AC3_SRBS_Srv  # PPort_NVM_BLOCK_SER_VINODOMETERCOUNTER : NvM_AC3_SRBS_Srv | P-Port Prototype of NvM_AC3_SRBS_Srv for NVRAM Block NVM_BLOCK_SER_VINODOMETERCOUNTER
      PS_NVM_BLOCK_SER_DIAGSPECINFO: provided-interface=NvM_AC3_SRBS_Srv  # PPort_NVM_BLOCK_SER_DIAGSPECINFO : NvM_AC3_SRBS_Srv | P-Port Prototype of NvM_AC3_SRBS_Srv for NVRAM Block NVM_BLOCK_SER_DIAGSPECINFO
      PS_NVM_BLOCK_SER_VEHICLEINFO: provided-interface=NvM_AC3_SRBS_Srv  # PPort_NVM_BLOCK_SER_VEHICLEINFO : NvM_AC3_SRBS_Srv | P-Port Prototype of NvM_AC3_SRBS_Srv for NVRAM Block NVM_BLOCK_SER_VEHICLEINFO
      PS_NVM_BLOCK_SER_ECUSERIALNUMBER: provided-interface=NvM_AC3_SRBS_Srv  # PPort_NVM_BLOCK_SER_ECUSERIALNUMBER : NvM_AC3_SRBS_Srv | P-Port Prototype of NvM_AC3_SRBS_Srv for NVRAM Block NVM_BLOCK_SER_ECUSERIALNUMBER
      PS_NVM_BLOCK_SER_VINCURRENT: provided-interface=NvM_AC3_SRBS_Srv  # PPort_NVM_BLOCK_SER_VINCURRENT : NvM_AC3_SRBS_Srv | P-Port Prototype of NvM_AC3_SRBS_Srv for NVRAM Block NVM_BLOCK_SER_VINCURRENT
      PS_NVM_BLOCK_SER_VINORIGINAL: provided-interface=NvM_AC3_SRBS_Srv  # PPort_NVM_BLOCK_SER_VINORIGINAL : NvM_AC3_SRBS_Srv | P-Port Prototype of NvM_AC3_SRBS_Srv for NVRAM Block NVM_BLOCK_SER_VINORIGINAL
      PS_NVM_BLOCK_SER_ACTIVEDIAGINFO_APPL: provided-interface=NvM_AC3_SRBS_Srv  # PPort_NVM_BLOCK_SER_ACTIVEDIAGINFO_APPL : NvM_AC3_SRBS_Srv | P-Port Prototype of NvM_AC3_SRBS_Srv for NVRAM Block NVM_BLOCK_SER_ACTIVEDIAGINFO_APPL
      PS_NVM_BLOCK_CMS_NXTRMEC: provided-interface=NvM_AC3_SRBS_Srv  # PPort_NVM_BLOCK_CMS_NXTRMEC : NvM_AC3_SRBS_Srv | P-Port Prototype of NvM_AC3_SRBS_Srv for NVRAM Block NVM_BLOCK_CMS_NXTRMEC
      PS_NVM_BLOCK_CMS_ECUSRLNUM: provided-interface=NvM_AC3_SRBS_Srv  # PPort_NVM_BLOCK_CMS_ECUSRLNUM : NvM_AC3_SRBS_Srv | P-Port Prototype of NvM_AC3_SRBS_Srv for NVRAM Block NVM_BLOCK_CMS_ECUSRLNUM
      PS_NVM_BLOCK_CMS_EPSSRLNUM: provided-interface=NvM_AC3_SRBS_Srv  # PPort_NVM_BLOCK_CMS_EPSSRLNUM : NvM_AC3_SRBS_Srv | P-Port Prototype of NvM_AC3_SRBS_Srv for NVRAM Block NVM_BLOCK_CMS_EPSSRLNUM
      PS_NVM_BLOCK_SER_ECUPN: provided-interface=NvM_AC3_SRBS_Srv  # PPort_NVM_BLOCK_SER_ECUPN : NvM_AC3_SRBS_Srv | P-Port Prototype of NvM_AC3_SRBS_Srv for NVRAM Block NVM_BLOCK_SER_ECUPN
      PS_NVM_BLOCK_CMS_NXTRMANUFSCRATCHPAD: provided-interface=NvM_AC3_SRBS_Srv  # PPort_NVM_BLOCK_CMS_NXTRMANUFSCRATCHPAD : NvM_AC3_SRBS_Srv | P-Port Prototype of NvM_AC3_SRBS_Srv for NVRAM Block NVM_BLOCK_CMS_NXTRMANUFSCRATCHPAD
      PS_NVM_BLOCK_CMS_IGNCNTR: provided-interface=NvM_AC3_SRBS_Srv  # PPort_NVM_BLOCK_CMS_IGNCNTR : NvM_AC3_SRBS_Srv | P-Port Prototype of NvM_AC3_SRBS_Srv for NVRAM Block NVM_BLOCK_CMS_IGNCNTR
      PS_Rte_NvmBlock_StaMd_CloseCheckData: provided-interface=NvM_AC3_SRBS_Srv  # PPort_Rte_NvmBlock_StaMd_CloseCheckData : NvM_AC3_SRBS_Srv | P-Port Prototype of NvM_AC3_SRBS_Srv for NVRAM Block Rte_NvmBlock_StaMd_CloseCheckData
      PS_NVM_BLOCK_DIAGMGR_BLACKBOX: provided-interface=NvM_AC3_SRBS_Srv  # PPort_NVM_BLOCK_DIAGMGR_BLACKBOX : NvM_AC3_SRBS_Srv | P-Port Prototype of NvM_AC3_SRBS_Srv for NVRAM Block NVM_BLOCK_DIAGMGR_BLACKBOX
      PS_Rte_NvmBlock_Ap_AvgFricLrn_AvgFricLrnData: provided-interface=NvM_AC3_SRBS_Srv  # PPort_Rte_NvmBlock_Ap_AvgFricLrn_AvgFricLrnData : NvM_AC3_SRBS_Srv | P-Port Prototype of NvM_AC3_SRBS_Srv for NVRAM Block Rte_NvmBlock_Ap_AvgFricLrn_AvgFricLrnData
      PS_Rte_NvmBlock_BatteryVoltage_OvervoltageData: provided-interface=NvM_AC3_SRBS_Srv  # PPort_Rte_NvmBlock_BatteryVoltage_OvervoltageData : NvM_AC3_SRBS_Srv | P-Port Prototype of NvM_AC3_SRBS_Srv for NVRAM Block Rte_NvmBlock_BatteryVoltage_OvervoltageData
      PS_NVM_BLOCK_DIAGMGR_LATCHCNTRS: provided-interface=NvM_AC3_SRBS_Srv  # PPort_NVM_BLOCK_DIAGMGR_LATCHCNTRS : NvM_AC3_SRBS_Srv | P-Port Prototype of NvM_AC3_SRBS_Srv for NVRAM Block NVM_BLOCK_DIAGMGR_LATCHCNTRS
      PS_NvM_NVM_BLOCK_DEM: provided-interface=NvM_AC3_SRBS_Srv  # PPort_NvM_NVM_BLOCK_DEM : NvM_AC3_SRBS_Srv | P-Port Prototype of NvM_AC3_SRBS_Srv for NVRAM Block NvM_NVM_BLOCK_DEM
      PS_Rte_NvmBlock_Ap_TrqCanc_CogTrqRplComp: provided-interface=NvM_AC3_SRBS_Srv  # PPort_Rte_NvmBlock_Ap_TrqCanc_CogTrqRplComp : NvM_AC3_SRBS_Srv | P-Port Prototype of NvM_AC3_SRBS_Srv for NVRAM Block Rte_NvmBlock_Ap_TrqCanc_CogTrqRplComp
      PS_Rte_NvmBlock_Ap_AstLmt_SteerAsstDefeat: provided-interface=NvM_AC3_SRBS_Srv  # PPort_Rte_NvmBlock_Ap_AstLmt_SteerAsstDefeat : NvM_AC3_SRBS_Srv | P-Port Prototype of NvM_AC3_SRBS_Srv for NVRAM Block Rte_NvmBlock_Ap_AstLmt_SteerAsstDefeat
      PS_NVM_BLOCK_CMS_ECUHWPN: provided-interface=NvM_AC3_SRBS_Srv  # PPort_NVM_BLOCK_CMS_ECUHWPN : NvM_AC3_SRBS_Srv | P-Port Prototype of NvM_AC3_SRBS_Srv for NVRAM Block NVM_BLOCK_CMS_ECUHWPN
      PS_NVM_BLOCK_SWFINGERPRINT: provided-interface=NvM_AC3_SRBS_Srv  # PPort_NVM_BLOCK_SWFINGERPRINT : NvM_AC3_SRBS_Srv | P-Port Prototype of NvM_AC3_SRBS_Srv for NVRAM Block NVM_BLOCK_SWFINGERPRINT
      PS_NVM_BLOCK_RESETRESP: provided-interface=NvM_AC3_SRBS_Srv  # PPort_NVM_BLOCK_RESETRESP : NvM_AC3_SRBS_Srv | P-Port Prototype of NvM_AC3_SRBS_Srv for NVRAM Block NVM_BLOCK_RESETRESP
      PS_NVM_BLOCK_PROGREQCNT: provided-interface=NvM_AC3_SRBS_Srv  # PPort_NVM_BLOCK_PROGREQCNT : NvM_AC3_SRBS_Srv | P-Port Prototype of NvM_AC3_SRBS_Srv for NVRAM Block NVM_BLOCK_PROGREQCNT
      PS_NVM_BLOCK_SECDLYEN: provided-interface=NvM_AC3_SRBS_Srv  # PPort_NVM_BLOCK_SECDLYEN : NvM_AC3_SRBS_Srv | P-Port Prototype of NvM_AC3_SRBS_Srv for NVRAM Block NVM_BLOCK_SECDLYEN
      PS_ConfigBlock: provided-interface=NvM_AC3_SRBS_Srv  # PPort_ConfigBlock : NvM_AC3_SRBS_Srv | P-Port Prototype of NvM_AC3_SRBS_Srv for NVRAM Block ConfigBlock
      PAdmin_NVM_BLOCK_NXTRWIRSELECT: provided-interface=NvM_Administration  # PPort_NVM_BLOCK_NXTRWIRSELECT : NvM_Administration | P-Port Prototype of NvM_Administration for NVRAM Block NVM_BLOCK_NXTRWIRSELECT
      PAdmin_Rte_NvmBlock_MtrPos_MtrPosSnsr_EOLData: provided-interface=NvM_Administration  # PPort_Rte_NvmBlock_MtrPos_MtrPosSnsr_EOLData : NvM_Administration | P-Port Prototype of NvM_Administration for NVRAM Block Rte_NvmBlock_MtrPos_MtrPosSnsr_EOLData
      PAdmin_Rte_NvmBlock_HwTrq_HwTrqScaleData: provided-interface=NvM_Administration  # PPort_Rte_NvmBlock_HwTrq_HwTrqScaleData : NvM_Administration | P-Port Prototype of NvM_Administration for NVRAM Block Rte_NvmBlock_HwTrq_HwTrqScaleData
      PAdmin_Rte_NvmBlock_Polarity_EOLCtrlPolarity: provided-interface=NvM_Administration  # PPort_Rte_NvmBlock_Polarity_EOLCtrlPolarity : NvM_Administration | P-Port Prototype of NvM_Administration for NVRAM Block Rte_NvmBlock_Polarity_EOLCtrlPolarity
      PAdmin_Rte_NvmBlock_HwTrq_HwTrqTrimData: provided-interface=NvM_Administration  # PPort_Rte_NvmBlock_HwTrq_HwTrqTrimData : NvM_Administration | P-Port Prototype of NvM_Administration for NVRAM Block Rte_NvmBlock_HwTrq_HwTrqTrimData
      PAdmin_NVM_BLOCK_DIAGMGR_NTCSTRG: provided-interface=NvM_Administration  # PPort_NVM_BLOCK_DIAGMGR_NTCSTRG : NvM_Administration | P-Port Prototype of NvM_Administration for NVRAM Block NVM_BLOCK_DIAGMGR_NTCSTRG
      PAdmin_NVM_BLOCK_EPSDEFEATS: provided-interface=NvM_Administration  # PPort_NVM_BLOCK_EPSDEFEATS : NvM_Administration | P-Port Prototype of NvM_Administration for NVRAM Block NVM_BLOCK_EPSDEFEATS
      PAdmin_Rte_NvmBlock_StaMd_TypeHRamBuffer: provided-interface=NvM_Administration  # PPort_Rte_NvmBlock_StaMd_TypeHRamBuffer : NvM_Administration | P-Port Prototype of NvM_Administration for NVRAM Block Rte_NvmBlock_StaMd_TypeHRamBuffer
      PAdmin_Rte_NvmBlock_TrqCmdScl_TorqueCmdSF_Uls_f32: provided-interface=NvM_Administration  # PPort_Rte_NvmBlock_TrqCmdScl_TorqueCmdSF_Uls_f32 : NvM_Administration | P-Port Prototype of NvM_Administration for NVRAM Block Rte_NvmBlock_TrqCmdScl_TorqueCmdSF_Uls_f32
      PAdmin_Rte_NvmBlock_CmMtrCurr_CurrTempOffset: provided-interface=NvM_Administration  # PPort_Rte_NvmBlock_CmMtrCurr_CurrTempOffset : NvM_Administration | P-Port Prototype of NvM_Administration for NVRAM Block Rte_NvmBlock_CmMtrCurr_CurrTempOffset
      PAdmin_Rte_NvmBlock_CmMtrCurr_ShCurrCal: provided-interface=NvM_Administration  # PPort_Rte_NvmBlock_CmMtrCurr_ShCurrCal : NvM_Administration | P-Port Prototype of NvM_Administration for NVRAM Block Rte_NvmBlock_CmMtrCurr_ShCurrCal
      PAdmin_Rte_NvmBlock_CurrParamComp_EOLNomMtrParam: provided-interface=NvM_Administration  # PPort_Rte_NvmBlock_CurrParamComp_EOLNomMtrParam : NvM_Administration | P-Port Prototype of NvM_Administration for NVRAM Block Rte_NvmBlock_CurrParamComp_EOLNomMtrParam
      PAdmin_Rte_NvmBlock_LrnEOT_LearnedEOT: provided-interface=NvM_Administration  # PPort_Rte_NvmBlock_LrnEOT_LearnedEOT : NvM_Administration | P-Port Prototype of NvM_Administration for NVRAM Block Rte_NvmBlock_LrnEOT_LearnedEOT
      PAdmin_Rte_NvmBlock_IPMTrqCanc_CogTrqCal: provided-interface=NvM_Administration  # PPort_Rte_NvmBlock_IPMTrqCanc_CogTrqCal : NvM_Administration | P-Port Prototype of NvM_Administration for NVRAM Block Rte_NvmBlock_IPMTrqCanc_CogTrqCal
      PAdmin_Rte_NvmBlock_HwTrq_EOLTrqStepData: provided-interface=NvM_Administration  # PPort_Rte_NvmBlock_HwTrq_EOLTrqStepData : NvM_Administration | P-Port Prototype of NvM_Administration for NVRAM Block Rte_NvmBlock_HwTrq_EOLTrqStepData
      PAdmin_NVM_BLOCK_SER_METADATA_APPLICATION: provided-interface=NvM_Administration  # PPort_NVM_BLOCK_SER_METADATA_APPLICATION : NvM_Administration | P-Port Prototype of NvM_Administration for NVRAM Block NVM_BLOCK_SER_METADATA_APPLICATION
      PAdmin_NVM_BLOCK_SER_METADATA_CAL1: provided-interface=NvM_Administration  # PPort_NVM_BLOCK_SER_METADATA_CAL1 : NvM_Administration | P-Port Prototype of NvM_Administration for NVRAM Block NVM_BLOCK_SER_METADATA_CAL1
      PAdmin_NVM_BLOCK_SER_METADATA_CAL2: provided-interface=NvM_Administration  # PPort_NVM_BLOCK_SER_METADATA_CAL2 : NvM_Administration | P-Port Prototype of NvM_Administration for NVRAM Block NVM_BLOCK_SER_METADATA_CAL2
      PAdmin_NVM_BLOCK_SER_ACTIVEDIAGINFO_BOOT: provided-interface=NvM_Administration  # PPort_NVM_BLOCK_SER_ACTIVEDIAGINFO_BOOT : NvM_Administration | P-Port Prototype of NvM_Administration for NVRAM Block NVM_BLOCK_SER_ACTIVEDIAGINFO_BOOT
      PAdmin_NVM_BLOCK_SER_HWPARTNUMBER: provided-interface=NvM_Administration  # PPort_NVM_BLOCK_SER_HWPARTNUMBER : NvM_Administration | P-Port Prototype of NvM_Administration for NVRAM Block NVM_BLOCK_SER_HWPARTNUMBER
      PAdmin_NVM_BLOCK_SER_HWVERSIONINFO: provided-interface=NvM_Administration  # PPort_NVM_BLOCK_SER_HWVERSIONINFO : NvM_Administration | P-Port Prototype of NvM_Administration for NVRAM Block NVM_BLOCK_SER_HWVERSIONINFO
      PAdmin_NVM_BLOCK_SER_BOOTSWVERSIONINFO: provided-interface=NvM_Administration  # PPort_NVM_BLOCK_SER_BOOTSWVERSIONINFO : NvM_Administration | P-Port Prototype of NvM_Administration for NVRAM Block NVM_BLOCK_SER_BOOTSWVERSIONINFO
      PAdmin_NVM_BLOCK_SER_HWSUPPID: provided-interface=NvM_Administration  # PPort_NVM_BLOCK_SER_HWSUPPID : NvM_Administration | P-Port Prototype of NvM_Administration for NVRAM Block NVM_BLOCK_SER_HWSUPPID
      PAdmin_NVM_BLOCK_SER_RESPONEVENTACTVSTATE: provided-interface=NvM_Administration  # PPort_NVM_BLOCK_SER_RESPONEVENTACTVSTATE : NvM_Administration | P-Port Prototype of NvM_Administration for NVRAM Block NVM_BLOCK_SER_RESPONEVENTACTVSTATE
      PAdmin_NVM_BLOCK_SER_VINODOMETERCOUNTER: provided-interface=NvM_Administration  # PPort_NVM_BLOCK_SER_VINODOMETERCOUNTER : NvM_Administration | P-Port Prototype of NvM_Administration for NVRAM Block NVM_BLOCK_SER_VINODOMETERCOUNTER
      PAdmin_NVM_BLOCK_SER_DIAGSPECINFO: provided-interface=NvM_Administration  # PPort_NVM_BLOCK_SER_DIAGSPECINFO : NvM_Administration | P-Port Prototype of NvM_Administration for NVRAM Block NVM_BLOCK_SER_DIAGSPECINFO
      PAdmin_NVM_BLOCK_SER_VEHICLEINFO: provided-interface=NvM_Administration  # PPort_NVM_BLOCK_SER_VEHICLEINFO : NvM_Administration | P-Port Prototype of NvM_Administration for NVRAM Block NVM_BLOCK_SER_VEHICLEINFO
      PAdmin_NVM_BLOCK_SER_ECUSERIALNUMBER: provided-interface=NvM_Administration  # PPort_NVM_BLOCK_SER_ECUSERIALNUMBER : NvM_Administration | P-Port Prototype of NvM_Administration for NVRAM Block NVM_BLOCK_SER_ECUSERIALNUMBER
      PAdmin_NVM_BLOCK_SER_VINCURRENT: provided-interface=NvM_Administration  # PPort_NVM_BLOCK_SER_VINCURRENT : NvM_Administration | P-Port Prototype of NvM_Administration for NVRAM Block NVM_BLOCK_SER_VINCURRENT
      PAdmin_NVM_BLOCK_SER_VINORIGINAL: provided-interface=NvM_Administration  # PPort_NVM_BLOCK_SER_VINORIGINAL : NvM_Administration | P-Port Prototype of NvM_Administration for NVRAM Block NVM_BLOCK_SER_VINORIGINAL
      PAdmin_NVM_BLOCK_SER_ACTIVEDIAGINFO_APPL: provided-interface=NvM_Administration  # PPort_NVM_BLOCK_SER_ACTIVEDIAGINFO_APPL : NvM_Administration | P-Port Prototype of NvM_Administration for NVRAM Block NVM_BLOCK_SER_ACTIVEDIAGINFO_APPL
      PAdmin_NVM_BLOCK_CMS_NXTRMEC: provided-interface=NvM_Administration  # PPort_NVM_BLOCK_CMS_NXTRMEC : NvM_Administration | P-Port Prototype of NvM_Administration for NVRAM Block NVM_BLOCK_CMS_NXTRMEC
      PAdmin_NVM_BLOCK_CMS_ECUSRLNUM: provided-interface=NvM_Administration  # PPort_NVM_BLOCK_CMS_ECUSRLNUM : NvM_Administration | P-Port Prototype of NvM_Administration for NVRAM Block NVM_BLOCK_CMS_ECUSRLNUM
      PAdmin_NVM_BLOCK_CMS_EPSSRLNUM: provided-interface=NvM_Administration  # PPort_NVM_BLOCK_CMS_EPSSRLNUM : NvM_Administration | P-Port Prototype of NvM_Administration for NVRAM Block NVM_BLOCK_CMS_EPSSRLNUM
      PAdmin_NVM_BLOCK_SER_ECUPN: provided-interface=NvM_Administration  # PPort_NVM_BLOCK_SER_ECUPN : NvM_Administration | P-Port Prototype of NvM_Administration for NVRAM Block NVM_BLOCK_SER_ECUPN
      PAdmin_NVM_BLOCK_CMS_NXTRMANUFSCRATCHPAD: provided-interface=NvM_Administration  # PPort_NVM_BLOCK_CMS_NXTRMANUFSCRATCHPAD : NvM_Administration | P-Port Prototype of NvM_Administration for NVRAM Block NVM_BLOCK_CMS_NXTRMANUFSCRATCHPAD
      PAdmin_NVM_BLOCK_CMS_IGNCNTR: provided-interface=NvM_Administration  # PPort_NVM_BLOCK_CMS_IGNCNTR : NvM_Administration | P-Port Prototype of NvM_Administration for NVRAM Block NVM_BLOCK_CMS_IGNCNTR
      PAdmin_Rte_NvmBlock_StaMd_CloseCheckData: provided-interface=NvM_Administration  # PPort_Rte_NvmBlock_StaMd_CloseCheckData : NvM_Administration | P-Port Prototype of NvM_Administration for NVRAM Block Rte_NvmBlock_StaMd_CloseCheckData
      PAdmin_NVM_BLOCK_DIAGMGR_BLACKBOX: provided-interface=NvM_Administration  # PPort_NVM_BLOCK_DIAGMGR_BLACKBOX : NvM_Administration | P-Port Prototype of NvM_Administration for NVRAM Block NVM_BLOCK_DIAGMGR_BLACKBOX
      PAdmin_Rte_NvmBlock_Ap_AvgFricLrn_AvgFricLrnData: provided-interface=NvM_Administration  # PPort_Rte_NvmBlock_Ap_AvgFricLrn_AvgFricLrnData : NvM_Administration | P-Port Prototype of NvM_Administration for NVRAM Block Rte_NvmBlock_Ap_AvgFricLrn_AvgFricLrnData
      PAdmin_Rte_NvmBlock_BatteryVoltage_OvervoltageData: provided-interface=NvM_Administration  # PPort_Rte_NvmBlock_BatteryVoltage_OvervoltageData : NvM_Administration | P-Port Prototype of NvM_Administration for NVRAM Block Rte_NvmBlock_BatteryVoltage_OvervoltageData
      PAdmin_NVM_BLOCK_DIAGMGR_LATCHCNTRS: provided-interface=NvM_Administration  # PPort_NVM_BLOCK_DIAGMGR_LATCHCNTRS : NvM_Administration | P-Port Prototype of NvM_Administration for NVRAM Block NVM_BLOCK_DIAGMGR_LATCHCNTRS
      PAdmin_NvM_NVM_BLOCK_DEM: provided-interface=NvM_Administration  # PPort_NvM_NVM_BLOCK_DEM : NvM_Administration | P-Port Prototype of NvM_Administration for NVRAM Block NvM_NVM_BLOCK_DEM
      PAdmin_Rte_NvmBlock_Ap_TrqCanc_CogTrqRplComp: provided-interface=NvM_Administration  # PPort_Rte_NvmBlock_Ap_TrqCanc_CogTrqRplComp : NvM_Administration | P-Port Prototype of NvM_Administration for NVRAM Block Rte_NvmBlock_Ap_TrqCanc_CogTrqRplComp
      PAdmin_Rte_NvmBlock_Ap_AstLmt_SteerAsstDefeat: provided-interface=NvM_Administration  # PPort_Rte_NvmBlock_Ap_AstLmt_SteerAsstDefeat : NvM_Administration | P-Port Prototype of NvM_Administration for NVRAM Block Rte_NvmBlock_Ap_AstLmt_SteerAsstDefeat
      PAdmin_NVM_BLOCK_CMS_ECUHWPN: provided-interface=NvM_Administration  # PPort_NVM_BLOCK_CMS_ECUHWPN : NvM_Administration | P-Port Prototype of NvM_Administration for NVRAM Block NVM_BLOCK_CMS_ECUHWPN
      PAdmin_NVM_BLOCK_SWFINGERPRINT: provided-interface=NvM_Administration  # PPort_NVM_BLOCK_SWFINGERPRINT : NvM_Administration | P-Port Prototype of NvM_Administration for NVRAM Block NVM_BLOCK_SWFINGERPRINT
      PAdmin_NVM_BLOCK_RESETRESP: provided-interface=NvM_Administration  # PPort_NVM_BLOCK_RESETRESP : NvM_Administration | P-Port Prototype of NvM_Administration for NVRAM Block NVM_BLOCK_RESETRESP
      PAdmin_NVM_BLOCK_PROGREQCNT: provided-interface=NvM_Administration  # PPort_NVM_BLOCK_PROGREQCNT : NvM_Administration | P-Port Prototype of NvM_Administration for NVRAM Block NVM_BLOCK_PROGREQCNT
      PAdmin_NVM_BLOCK_SECDLYEN: provided-interface=NvM_Administration  # PPort_NVM_BLOCK_SECDLYEN : NvM_Administration | P-Port Prototype of NvM_Administration for NVRAM Block NVM_BLOCK_SECDLYEN
      PAdmin_ConfigBlock: provided-interface=NvM_Administration  # PPort_ConfigBlock : NvM_Administration | P-Port Prototype of NvM_Administration for NVRAM Block ConfigBlock
  swc implementation NvM_Impl: behavior=NvM_Behavior
  internal behavior NvM_Behavior: component=NvM
    357 x operation invoked event:
      V_2_GetErrorStatus: start-on-event=GetErrorStatus, operation=PS_NVM_BLOCK_NXTRWIRSELECT.GetErrorStatus
      V_2_SetRamBlockStatus: start-on-event=SetRamBlockStatus, operation=PS_NVM_BLOCK_NXTRWIRSELECT.SetRamBlockStatus
      V_2_ReadBlock: start-on-event=ReadBlock, operation=PS_NVM_BLOCK_NXTRWIRSELECT.ReadBlock
      V_2_WriteBlock: start-on-event=WriteBlock, operation=PS_NVM_BLOCK_NXTRWIRSELECT.WriteBlock
      V_2_InvalidateNvBlock: start-on-event=InvalidateNvBlock, operation=PS_NVM_BLOCK_NXTRWIRSELECT.InvalidateNvBlock
      V_2_EraseBlock: start-on-event=EraseBlock, operation=PS_NVM_BLOCK_NXTRWIRSELECT.EraseBlock
      V_2_SetBlockProtection: start-on-event=SetBlockProtection, operation=PAdmin_NVM_BLOCK_NXTRWIRSELECT.SetBlockProtection
      V_3_GetErrorStatus: start-on-event=GetErrorStatus, operation=PS_Rte_NvmBlock_MtrPos_MtrPosSnsr_EOLData.GetErrorStatus
      V_3_SetRamBlockStatus: start-on-event=SetRamBlockStatus, operation=PS_Rte_NvmBlock_MtrPos_MtrPosSnsr_EOLData.SetRamBlockStatus
      V_3_ReadBlock: start-on-event=ReadBlock, operation=PS_Rte_NvmBlock_MtrPos_MtrPosSnsr_EOLData.ReadBlock
      V_3_WriteBlock: start-on-event=WriteBlock, operation=PS_Rte_NvmBlock_MtrPos_MtrPosSnsr_EOLData.WriteBlock
      V_3_InvalidateNvBlock: start-on-event=InvalidateNvBlock, operation=PS_Rte_NvmBlock_MtrPos_MtrPosSnsr_EOLData.InvalidateNvBlock
      V_3_EraseBlock: start-on-event=EraseBlock, operation=PS_Rte_NvmBlock_MtrPos_MtrPosSnsr_EOLData.EraseBlock
      V_3_SetBlockProtection: start-on-event=SetBlockProtection, operation=PAdmin_Rte_NvmBlock_MtrPos_MtrPosSnsr_EOLData.SetBlockProtection
      V_4_GetErrorStatus: start-on-event=GetErrorStatus, operation=PS_Rte_NvmBlock_HwTrq_HwTrqScaleData.GetErrorStatus
      V_4_SetRamBlockStatus: start-on-event=SetRamBlockStatus, operation=PS_Rte_NvmBlock_HwTrq_HwTrqScaleData.SetRamBlockStatus
      V_4_ReadBlock: start-on-event=ReadBlock, operation=PS_Rte_NvmBlock_HwTrq_HwTrqScaleData.ReadBlock
      V_4_WriteBlock: start-on-event=WriteBlock, operation=PS_Rte_NvmBlock_HwTrq_HwTrqScaleData.WriteBlock
      V_4_InvalidateNvBlock: start-on-event=InvalidateNvBlock, operation=PS_Rte_NvmBlock_HwTrq_HwTrqScaleData.InvalidateNvBlock
      V_4_EraseBlock: start-on-event=EraseBlock, operation=PS_Rte_NvmBlock_HwTrq_HwTrqScaleData.EraseBlock
      V_4_SetBlockProtection: start-on-event=SetBlockProtection, operation=PAdmin_Rte_NvmBlock_HwTrq_HwTrqScaleData.SetBlockProtection
      V_5_GetErrorStatus: start-on-event=GetErrorStatus, operation=PS_Rte_NvmBlock_Polarity_EOLCtrlPolarity.GetErrorStatus
      V_5_SetRamBlockStatus: start-on-event=SetRamBlockStatus, operation=PS_Rte_NvmBlock_Polarity_EOLCtrlPolarity.SetRamBlockStatus
      V_5_ReadBlock: start-on-event=ReadBlock, operation=PS_Rte_NvmBlock_Polarity_EOLCtrlPolarity.ReadBlock
      V_5_WriteBlock: start-on-event=WriteBlock, operation=PS_Rte_NvmBlock_Polarity_EOLCtrlPolarity.WriteBlock
      V_5_InvalidateNvBlock: start-on-event=InvalidateNvBlock, operation=PS_Rte_NvmBlock_Polarity_EOLCtrlPolarity.InvalidateNvBlock
      V_5_EraseBlock: start-on-event=EraseBlock, operation=PS_Rte_NvmBlock_Polarity_EOLCtrlPolarity.EraseBlock
      V_5_SetBlockProtection: start-on-event=SetBlockProtection, operation=PAdmin_Rte_NvmBlock_Polarity_EOLCtrlPolarity.SetBlockProtection
      V_6_GetErrorStatus: start-on-event=GetErrorStatus, operation=PS_Rte_NvmBlock_HwTrq_HwTrqTrimData.GetErrorStatus
      V_6_SetRamBlockStatus: start-on-event=SetRamBlockStatus, operation=PS_Rte_NvmBlock_HwTrq_HwTrqTrimData.SetRamBlockStatus
      V_6_ReadBlock: start-on-event=ReadBlock, operation=PS_Rte_NvmBlock_HwTrq_HwTrqTrimData.ReadBlock
      V_6_WriteBlock: start-on-event=WriteBlock, operation=PS_Rte_NvmBlock_HwTrq_HwTrqTrimData.WriteBlock
      V_6_InvalidateNvBlock: start-on-event=InvalidateNvBlock, operation=PS_Rte_NvmBlock_HwTrq_HwTrqTrimData.InvalidateNvBlock
      V_6_EraseBlock: start-on-event=EraseBlock, operation=PS_Rte_NvmBlock_HwTrq_HwTrqTrimData.EraseBlock
      V_6_SetBlockProtection: start-on-event=SetBlockProtection, operation=PAdmin_Rte_NvmBlock_HwTrq_HwTrqTrimData.SetBlockProtection
      V_7_GetErrorStatus: start-on-event=GetErrorStatus, operation=PS_NVM_BLOCK_DIAGMGR_NTCSTRG.GetErrorStatus
      V_7_SetRamBlockStatus: start-on-event=SetRamBlockStatus, operation=PS_NVM_BLOCK_DIAGMGR_NTCSTRG.SetRamBlockStatus
      V_7_ReadBlock: start-on-event=ReadBlock, operation=PS_NVM_BLOCK_DIAGMGR_NTCSTRG.ReadBlock
      V_7_WriteBlock: start-on-event=WriteBlock, operation=PS_NVM_BLOCK_DIAGMGR_NTCSTRG.WriteBlock
      V_7_InvalidateNvBlock: start-on-event=InvalidateNvBlock, operation=PS_NVM_BLOCK_DIAGMGR_NTCSTRG.InvalidateNvBlock
      V_7_EraseBlock: start-on-event=EraseBlock, operation=PS_NVM_BLOCK_DIAGMGR_NTCSTRG.EraseBlock
      V_7_SetBlockProtection: start-on-event=SetBlockProtection, operation=PAdmin_NVM_BLOCK_DIAGMGR_NTCSTRG.SetBlockProtection
      V_8_GetErrorStatus: start-on-event=GetErrorStatus, operation=PS_NVM_BLOCK_EPSDEFEATS.GetErrorStatus
      V_8_SetRamBlockStatus: start-on-event=SetRamBlockStatus, operation=PS_NVM_BLOCK_EPSDEFEATS.SetRamBlockStatus
      V_8_ReadBlock: start-on-event=ReadBlock, operation=PS_NVM_BLOCK_EPSDEFEATS.ReadBlock
      V_8_WriteBlock: start-on-event=WriteBlock, operation=PS_NVM_BLOCK_EPSDEFEATS.WriteBlock
      V_8_InvalidateNvBlock: start-on-event=InvalidateNvBlock, operation=PS_NVM_BLOCK_EPSDEFEATS.InvalidateNvBlock
      V_8_EraseBlock: start-on-event=EraseBlock, operation=PS_NVM_BLOCK_EPSDEFEATS.EraseBlock
      V_8_SetBlockProtection: start-on-event=SetBlockProtection, operation=PAdmin_NVM_BLOCK_EPSDEFEATS.SetBlockProtection
      V_9_GetErrorStatus: start-on-event=GetErrorStatus, operation=PS_Rte_NvmBlock_StaMd_TypeHRamBuffer.GetErrorStatus
      V_9_SetRamBlockStatus: start-on-event=SetRamBlockStatus, operation=PS_Rte_NvmBlock_StaMd_TypeHRamBuffer.SetRamBlockStatus
      V_9_ReadBlock: start-on-event=ReadBlock, operation=PS_Rte_NvmBlock_StaMd_TypeHRamBuffer.ReadBlock
      V_9_WriteBlock: start-on-event=WriteBlock, operation=PS_Rte_NvmBlock_StaMd_TypeHRamBuffer.WriteBlock
      V_9_InvalidateNvBlock: start-on-event=InvalidateNvBlock, operation=PS_Rte_NvmBlock_StaMd_TypeHRamBuffer.InvalidateNvBlock
      V_9_EraseBlock: start-on-event=EraseBlock, operation=PS_Rte_NvmBlock_StaMd_TypeHRamBuffer.EraseBlock
      V_9_SetBlockProtection: start-on-event=SetBlockProtection, operation=PAdmin_Rte_NvmBlock_StaMd_TypeHRamBuffer.SetBlockProtection
      V_10_GetErrorStatus: start-on-event=GetErrorStatus, operation=PS_Rte_NvmBlock_TrqCmdScl_TorqueCmdSF_Uls_f32.GetErrorStatus
      V_10_SetRamBlockStatus: start-on-event=SetRamBlockStatus, operation=PS_Rte_NvmBlock_TrqCmdScl_TorqueCmdSF_Uls_f32.SetRamBlockStatus
      V_10_ReadBlock: start-on-event=ReadBlock, operation=PS_Rte_NvmBlock_TrqCmdScl_TorqueCmdSF_Uls_f32.ReadBlock
      V_10_WriteBlock: start-on-event=WriteBlock, operation=PS_Rte_NvmBlock_TrqCmdScl_TorqueCmdSF_Uls_f32.WriteBlock
      V_10_InvalidateNvBlock: start-on-event=InvalidateNvBlock, operation=PS_Rte_NvmBlock_TrqCmdScl_TorqueCmdSF_Uls_f32.InvalidateNvBlock
      V_10_EraseBlock: start-on-event=EraseBlock, operation=PS_Rte_NvmBlock_TrqCmdScl_TorqueCmdSF_Uls_f32.EraseBlock
      V_10_SetBlockProtection: start-on-event=SetBlockProtection, operation=PAdmin_Rte_NvmBlock_TrqCmdScl_TorqueCmdSF_Uls_f32.SetBlockProtection
      V_11_GetErrorStatus: start-on-event=GetErrorStatus, operation=PS_Rte_NvmBlock_CmMtrCurr_CurrTempOffset.GetErrorStatus
      V_11_SetRamBlockStatus: start-on-event=SetRamBlockStatus, operation=PS_Rte_NvmBlock_CmMtrCurr_CurrTempOffset.SetRamBlockStatus
      V_11_ReadBlock: start-on-event=ReadBlock, operation=PS_Rte_NvmBlock_CmMtrCurr_CurrTempOffset.ReadBlock
      V_11_WriteBlock: start-on-event=WriteBlock, operation=PS_Rte_NvmBlock_CmMtrCurr_CurrTempOffset.WriteBlock
      V_11_InvalidateNvBlock: start-on-event=InvalidateNvBlock, operation=PS_Rte_NvmBlock_CmMtrCurr_CurrTempOffset.InvalidateNvBlock
      V_11_EraseBlock: start-on-event=EraseBlock, operation=PS_Rte_NvmBlock_CmMtrCurr_CurrTempOffset.EraseBlock
      V_11_SetBlockProtection: start-on-event=SetBlockProtection, operation=PAdmin_Rte_NvmBlock_CmMtrCurr_CurrTempOffset.SetBlockProtection
      V_12_GetErrorStatus: start-on-event=GetErrorStatus, operation=PS_Rte_NvmBlock_CmMtrCurr_ShCurrCal.GetErrorStatus
      V_12_SetRamBlockStatus: start-on-event=SetRamBlockStatus, operation=PS_Rte_NvmBlock_CmMtrCurr_ShCurrCal.SetRamBlockStatus
      V_12_ReadBlock: start-on-event=ReadBlock, operation=PS_Rte_NvmBlock_CmMtrCurr_ShCurrCal.ReadBlock
      V_12_WriteBlock: start-on-event=WriteBlock, operation=PS_Rte_NvmBlock_CmMtrCurr_ShCurrCal.WriteBlock
      V_12_InvalidateNvBlock: start-on-event=InvalidateNvBlock, operation=PS_Rte_NvmBlock_CmMtrCurr_ShCurrCal.InvalidateNvBlock
      V_12_EraseBlock: start-on-event=EraseBlock, operation=PS_Rte_NvmBlock_CmMtrCurr_ShCurrCal.EraseBlock
      V_12_SetBlockProtection: start-on-event=SetBlockProtection, operation=PAdmin_Rte_NvmBlock_CmMtrCurr_ShCurrCal.SetBlockProtection
      V_13_GetErrorStatus: start-on-event=GetErrorStatus, operation=PS_Rte_NvmBlock_CurrParamComp_EOLNomMtrParam.GetErrorStatus
      V_13_SetRamBlockStatus: start-on-event=SetRamBlockStatus, operation=PS_Rte_NvmBlock_CurrParamComp_EOLNomMtrParam.SetRamBlockStatus
      V_13_ReadBlock: start-on-event=ReadBlock, operation=PS_Rte_NvmBlock_CurrParamComp_EOLNomMtrParam.ReadBlock
      V_13_WriteBlock: start-on-event=WriteBlock, operation=PS_Rte_NvmBlock_CurrParamComp_EOLNomMtrParam.WriteBlock
      V_13_InvalidateNvBlock: start-on-event=InvalidateNvBlock, operation=PS_Rte_NvmBlock_CurrParamComp_EOLNomMtrParam.InvalidateNvBlock
      V_13_EraseBlock: start-on-event=EraseBlock, operation=PS_Rte_NvmBlock_CurrParamComp_EOLNomMtrParam.EraseBlock
      V_13_SetBlockProtection: start-on-event=SetBlockProtection, operation=PAdmin_Rte_NvmBlock_CurrParamComp_EOLNomMtrParam.SetBlockProtection
      V_14_GetErrorStatus: start-on-event=GetErrorStatus, operation=PS_Rte_NvmBlock_LrnEOT_LearnedEOT.GetErrorStatus
      V_14_SetRamBlockStatus: start-on-event=SetRamBlockStatus, operation=PS_Rte_NvmBlock_LrnEOT_LearnedEOT.SetRamBlockStatus
      V_14_ReadBlock: start-on-event=ReadBlock, operation=PS_Rte_NvmBlock_LrnEOT_LearnedEOT.ReadBlock
      V_14_WriteBlock: start-on-event=WriteBlock, operation=PS_Rte_NvmBlock_LrnEOT_LearnedEOT.WriteBlock
      V_14_InvalidateNvBlock: start-on-event=InvalidateNvBlock, operation=PS_Rte_NvmBlock_LrnEOT_LearnedEOT.InvalidateNvBlock
      V_14_EraseBlock: start-on-event=EraseBlock, operation=PS_Rte_NvmBlock_LrnEOT_LearnedEOT.EraseBlock
      V_14_SetBlockProtection: start-on-event=SetBlockProtection, operation=PAdmin_Rte_NvmBlock_LrnEOT_LearnedEOT.SetBlockProtection
      V_15_GetErrorStatus: start-on-event=GetErrorStatus, operation=PS_Rte_NvmBlock_IPMTrqCanc_CogTrqCal.GetErrorStatus
      V_15_SetRamBlockStatus: start-on-event=SetRamBlockStatus, operation=PS_Rte_NvmBlock_IPMTrqCanc_CogTrqCal.SetRamBlockStatus
      V_15_ReadBlock: start-on-event=ReadBlock, operation=PS_Rte_NvmBlock_IPMTrqCanc_CogTrqCal.ReadBlock
      V_15_WriteBlock: start-on-event=WriteBlock, operation=PS_Rte_NvmBlock_IPMTrqCanc_CogTrqCal.WriteBlock
      V_15_InvalidateNvBlock: start-on-event=InvalidateNvBlock, operation=PS_Rte_NvmBlock_IPMTrqCanc_CogTrqCal.InvalidateNvBlock
      V_15_EraseBlock: start-on-event=EraseBlock, operation=PS_Rte_NvmBlock_IPMTrqCanc_CogTrqCal.EraseBlock
      V_15_SetBlockProtection: start-on-event=SetBlockProtection, operation=PAdmin_Rte_NvmBlock_IPMTrqCanc_CogTrqCal.SetBlockProtection
      V_16_GetErrorStatus: start-on-event=GetErrorStatus, operation=PS_Rte_NvmBlock_HwTrq_EOLTrqStepData.GetErrorStatus
      V_16_SetRamBlockStatus: start-on-event=SetRamBlockStatus, operation=PS_Rte_NvmBlock_HwTrq_EOLTrqStepData.SetRamBlockStatus
      V_16_ReadBlock: start-on-event=ReadBlock, operation=PS_Rte_NvmBlock_HwTrq_EOLTrqStepData.ReadBlock
      V_16_WriteBlock: start-on-event=WriteBlock, operation=PS_Rte_NvmBlock_HwTrq_EOLTrqStepData.WriteBlock
      V_16_InvalidateNvBlock: start-on-event=InvalidateNvBlock, operation=PS_Rte_NvmBlock_HwTrq_EOLTrqStepData.InvalidateNvBlock
      V_16_EraseBlock: start-on-event=EraseBlock, operation=PS_Rte_NvmBlock_HwTrq_EOLTrqStepData.EraseBlock
      V_16_SetBlockProtection: start-on-event=SetBlockProtection, operation=PAdmin_Rte_NvmBlock_HwTrq_EOLTrqStepData.SetBlockProtection
      V_17_GetErrorStatus: start-on-event=GetErrorStatus, operation=PS_NVM_BLOCK_SER_METADATA_APPLICATION.GetErrorStatus
      V_17_SetRamBlockStatus: start-on-event=SetRamBlockStatus, operation=PS_NVM_BLOCK_SER_METADATA_APPLICATION.SetRamBlockStatus
      V_17_ReadBlock: start-on-event=ReadBlock, operation=PS_NVM_BLOCK_SER_METADATA_APPLICATION.ReadBlock
      V_17_WriteBlock: start-on-event=WriteBlock, operation=PS_NVM_BLOCK_SER_METADATA_APPLICATION.WriteBlock
      V_17_InvalidateNvBlock: start-on-event=InvalidateNvBlock, operation=PS_NVM_BLOCK_SER_METADATA_APPLICATION.InvalidateNvBlock
      V_17_EraseBlock: start-on-event=EraseBlock, operation=PS_NVM_BLOCK_SER_METADATA_APPLICATION.EraseBlock
      V_17_SetBlockProtection: start-on-event=SetBlockProtection, operation=PAdmin_NVM_BLOCK_SER_METADATA_APPLICATION.SetBlockProtection
      V_18_GetErrorStatus: start-on-event=GetErrorStatus, operation=PS_NVM_BLOCK_SER_METADATA_CAL1.GetErrorStatus
      V_18_SetRamBlockStatus: start-on-event=SetRamBlockStatus, operation=PS_NVM_BLOCK_SER_METADATA_CAL1.SetRamBlockStatus
      V_18_ReadBlock: start-on-event=ReadBlock, operation=PS_NVM_BLOCK_SER_METADATA_CAL1.ReadBlock
      V_18_WriteBlock: start-on-event=WriteBlock, operation=PS_NVM_BLOCK_SER_METADATA_CAL1.WriteBlock
      V_18_InvalidateNvBlock: start-on-event=InvalidateNvBlock, operation=PS_NVM_BLOCK_SER_METADATA_CAL1.InvalidateNvBlock
      V_18_EraseBlock: start-on-event=EraseBlock, operation=PS_NVM_BLOCK_SER_METADATA_CAL1.EraseBlock
      V_18_SetBlockProtection: start-on-event=SetBlockProtection, operation=PAdmin_NVM_BLOCK_SER_METADATA_CAL1.SetBlockProtection
      V_19_GetErrorStatus: start-on-event=GetErrorStatus, operation=PS_NVM_BLOCK_SER_METADATA_CAL2.GetErrorStatus
      V_19_SetRamBlockStatus: start-on-event=SetRamBlockStatus, operation=PS_NVM_BLOCK_SER_METADATA_CAL2.SetRamBlockStatus
      V_19_ReadBlock: start-on-event=ReadBlock, operation=PS_NVM_BLOCK_SER_METADATA_CAL2.ReadBlock
      V_19_WriteBlock: start-on-event=WriteBlock, operation=PS_NVM_BLOCK_SER_METADATA_CAL2.WriteBlock
      V_19_InvalidateNvBlock: start-on-event=InvalidateNvBlock, operation=PS_NVM_BLOCK_SER_METADATA_CAL2.InvalidateNvBlock
      V_19_EraseBlock: start-on-event=EraseBlock, operation=PS_NVM_BLOCK_SER_METADATA_CAL2.EraseBlock
      V_19_SetBlockProtection: start-on-event=SetBlockProtection, operation=PAdmin_NVM_BLOCK_SER_METADATA_CAL2.SetBlockProtection
      V_20_GetErrorStatus: start-on-event=GetErrorStatus, operation=PS_NVM_BLOCK_SER_ACTIVEDIAGINFO_BOOT.GetErrorStatus
      V_20_SetRamBlockStatus: start-on-event=SetRamBlockStatus, operation=PS_NVM_BLOCK_SER_ACTIVEDIAGINFO_BOOT.SetRamBlockStatus
      V_20_ReadBlock: start-on-event=ReadBlock, operation=PS_NVM_BLOCK_SER_ACTIVEDIAGINFO_BOOT.ReadBlock
      V_20_WriteBlock: start-on-event=WriteBlock, operation=PS_NVM_BLOCK_SER_ACTIVEDIAGINFO_BOOT.WriteBlock
      V_20_InvalidateNvBlock: start-on-event=InvalidateNvBlock, operation=PS_NVM_BLOCK_SER_ACTIVEDIAGINFO_BOOT.InvalidateNvBlock
      V_20_EraseBlock: start-on-event=EraseBlock, operation=PS_NVM_BLOCK_SER_ACTIVEDIAGINFO_BOOT.EraseBlock
      V_20_SetBlockProtection: start-on-event=SetBlockProtection, operation=PAdmin_NVM_BLOCK_SER_ACTIVEDIAGINFO_BOOT.SetBlockProtection
      V_21_GetErrorStatus: start-on-event=GetErrorStatus, operation=PS_NVM_BLOCK_SER_HWPARTNUMBER.GetErrorStatus
      V_21_SetRamBlockStatus: start-on-event=SetRamBlockStatus, operation=PS_NVM_BLOCK_SER_HWPARTNUMBER.SetRamBlockStatus
      V_21_ReadBlock: start-on-event=ReadBlock, operation=PS_NVM_BLOCK_SER_HWPARTNUMBER.ReadBlock
      V_21_WriteBlock: start-on-event=WriteBlock, operation=PS_NVM_BLOCK_SER_HWPARTNUMBER.WriteBlock
      V_21_InvalidateNvBlock: start-on-event=InvalidateNvBlock, operation=PS_NVM_BLOCK_SER_HWPARTNUMBER.InvalidateNvBlock
      V_21_EraseBlock: start-on-event=EraseBlock, operation=PS_NVM_BLOCK_SER_HWPARTNUMBER.EraseBlock
      V_21_SetBlockProtection: start-on-event=SetBlockProtection, operation=PAdmin_NVM_BLOCK_SER_HWPARTNUMBER.SetBlockProtection
      V_22_GetErrorStatus: start-on-event=GetErrorStatus, operation=PS_NVM_BLOCK_SER_HWVERSIONINFO.GetErrorStatus
      V_22_SetRamBlockStatus: start-on-event=SetRamBlockStatus, operation=PS_NVM_BLOCK_SER_HWVERSIONINFO.SetRamBlockStatus
      V_22_ReadBlock: start-on-event=ReadBlock, operation=PS_NVM_BLOCK_SER_HWVERSIONINFO.ReadBlock
      V_22_WriteBlock: start-on-event=WriteBlock, operation=PS_NVM_BLOCK_SER_HWVERSIONINFO.WriteBlock
      V_22_InvalidateNvBlock: start-on-event=InvalidateNvBlock, operation=PS_NVM_BLOCK_SER_HWVERSIONINFO.InvalidateNvBlock
      V_22_EraseBlock: start-on-event=EraseBlock, operation=PS_NVM_BLOCK_SER_HWVERSIONINFO.EraseBlock
      V_22_SetBlockProtection: start-on-event=SetBlockProtection, operation=PAdmin_NVM_BLOCK_SER_HWVERSIONINFO.SetBlockProtection
      V_23_GetErrorStatus: start-on-event=GetErrorStatus, operation=PS_NVM_BLOCK_SER_BOOTSWVERSIONINFO.GetErrorStatus
      V_23_SetRamBlockStatus: start-on-event=SetRamBlockStatus, operation=PS_NVM_BLOCK_SER_BOOTSWVERSIONINFO.SetRamBlockStatus
      V_23_ReadBlock: start-on-event=ReadBlock, operation=PS_NVM_BLOCK_SER_BOOTSWVERSIONINFO.ReadBlock
      V_23_WriteBlock: start-on-event=WriteBlock, operation=PS_NVM_BLOCK_SER_BOOTSWVERSIONINFO.WriteBlock
      V_23_InvalidateNvBlock: start-on-event=InvalidateNvBlock, operation=PS_NVM_BLOCK_SER_BOOTSWVERSIONINFO.InvalidateNvBlock
      V_23_EraseBlock: start-on-event=EraseBlock, operation=PS_NVM_BLOCK_SER_BOOTSWVERSIONINFO.EraseBlock
      V_23_SetBlockProtection: start-on-event=SetBlockProtection, operation=PAdmin_NVM_BLOCK_SER_BOOTSWVERSIONINFO.SetBlockProtection
      V_24_GetErrorStatus: start-on-event=GetErrorStatus, operation=PS_NVM_BLOCK_SER_HWSUPPID.GetErrorStatus
      V_24_SetRamBlockStatus: start-on-event=SetRamBlockStatus, operation=PS_NVM_BLOCK_SER_HWSUPPID.SetRamBlockStatus
      V_24_ReadBlock: start-on-event=ReadBlock, operation=PS_NVM_BLOCK_SER_HWSUPPID.ReadBlock
      V_24_WriteBlock: start-on-event=WriteBlock, operation=PS_NVM_BLOCK_SER_HWSUPPID.WriteBlock
      V_24_InvalidateNvBlock: start-on-event=InvalidateNvBlock, operation=PS_NVM_BLOCK_SER_HWSUPPID.InvalidateNvBlock
      V_24_EraseBlock: start-on-event=EraseBlock, operation=PS_NVM_BLOCK_SER_HWSUPPID.EraseBlock
      V_24_SetBlockProtection: start-on-event=SetBlockProtection, operation=PAdmin_NVM_BLOCK_SER_HWSUPPID.SetBlockProtection
      V_25_GetErrorStatus: start-on-event=GetErrorStatus, operation=PS_NVM_BLOCK_SER_RESPONEVENTACTVSTATE.GetErrorStatus
      V_25_SetRamBlockStatus: start-on-event=SetRamBlockStatus, operation=PS_NVM_BLOCK_SER_RESPONEVENTACTVSTATE.SetRamBlockStatus
      V_25_ReadBlock: start-on-event=ReadBlock, operation=PS_NVM_BLOCK_SER_RESPONEVENTACTVSTATE.ReadBlock
      V_25_WriteBlock: start-on-event=WriteBlock, operation=PS_NVM_BLOCK_SER_RESPONEVENTACTVSTATE.WriteBlock
      V_25_InvalidateNvBlock: start-on-event=InvalidateNvBlock, operation=PS_NVM_BLOCK_SER_RESPONEVENTACTVSTATE.InvalidateNvBlock
      V_25_EraseBlock: start-on-event=EraseBlock, operation=PS_NVM_BLOCK_SER_RESPONEVENTACTVSTATE.EraseBlock
      V_25_SetBlockProtection: start-on-event=SetBlockProtection, operation=PAdmin_NVM_BLOCK_SER_RESPONEVENTACTVSTATE.SetBlockProtection
      V_26_GetErrorStatus: start-on-event=GetErrorStatus, operation=PS_NVM_BLOCK_SER_VINODOMETERCOUNTER.GetErrorStatus
      V_26_SetRamBlockStatus: start-on-event=SetRamBlockStatus, operation=PS_NVM_BLOCK_SER_VINODOMETERCOUNTER.SetRamBlockStatus
      V_26_ReadBlock: start-on-event=ReadBlock, operation=PS_NVM_BLOCK_SER_VINODOMETERCOUNTER.ReadBlock
      V_26_WriteBlock: start-on-event=WriteBlock, operation=PS_NVM_BLOCK_SER_VINODOMETERCOUNTER.WriteBlock
      V_26_InvalidateNvBlock: start-on-event=InvalidateNvBlock, operation=PS_NVM_BLOCK_SER_VINODOMETERCOUNTER.InvalidateNvBlock
      V_26_EraseBlock: start-on-event=EraseBlock, operation=PS_NVM_BLOCK_SER_VINODOMETERCOUNTER.EraseBlock
      V_26_SetBlockProtection: start-on-event=SetBlockProtection, operation=PAdmin_NVM_BLOCK_SER_VINODOMETERCOUNTER.SetBlockProtection
      V_27_GetErrorStatus: start-on-event=GetErrorStatus, operation=PS_NVM_BLOCK_SER_DIAGSPECINFO.GetErrorStatus
      V_27_SetRamBlockStatus: start-on-event=SetRamBlockStatus, operation=PS_NVM_BLOCK_SER_DIAGSPECINFO.SetRamBlockStatus
      V_27_ReadBlock: start-on-event=ReadBlock, operation=PS_NVM_BLOCK_SER_DIAGSPECINFO.ReadBlock
      V_27_WriteBlock: start-on-event=WriteBlock, operation=PS_NVM_BLOCK_SER_DIAGSPECINFO.WriteBlock
      V_27_InvalidateNvBlock: start-on-event=InvalidateNvBlock, operation=PS_NVM_BLOCK_SER_DIAGSPECINFO.InvalidateNvBlock
      V_27_EraseBlock: start-on-event=EraseBlock, operation=PS_NVM_BLOCK_SER_DIAGSPECINFO.EraseBlock
      V_27_SetBlockProtection: start-on-event=SetBlockProtection, operation=PAdmin_NVM_BLOCK_SER_DIAGSPECINFO.SetBlockProtection
      V_28_GetErrorStatus: start-on-event=GetErrorStatus, operation=PS_NVM_BLOCK_SER_VEHICLEINFO.GetErrorStatus
      V_28_SetRamBlockStatus: start-on-event=SetRamBlockStatus, operation=PS_NVM_BLOCK_SER_VEHICLEINFO.SetRamBlockStatus
      V_28_ReadBlock: start-on-event=ReadBlock, operation=PS_NVM_BLOCK_SER_VEHICLEINFO.ReadBlock
      V_28_WriteBlock: start-on-event=WriteBlock, operation=PS_NVM_BLOCK_SER_VEHICLEINFO.WriteBlock
      V_28_InvalidateNvBlock: start-on-event=InvalidateNvBlock, operation=PS_NVM_BLOCK_SER_VEHICLEINFO.InvalidateNvBlock
      V_28_EraseBlock: start-on-event=EraseBlock, operation=PS_NVM_BLOCK_SER_VEHICLEINFO.EraseBlock
      V_28_SetBlockProtection: start-on-event=SetBlockProtection, operation=PAdmin_NVM_BLOCK_SER_VEHICLEINFO.SetBlockProtection
      V_29_GetErrorStatus: start-on-event=GetErrorStatus, operation=PS_NVM_BLOCK_SER_ECUSERIALNUMBER.GetErrorStatus
      V_29_SetRamBlockStatus: start-on-event=SetRamBlockStatus, operation=PS_NVM_BLOCK_SER_ECUSERIALNUMBER.SetRamBlockStatus
      V_29_ReadBlock: start-on-event=ReadBlock, operation=PS_NVM_BLOCK_SER_ECUSERIALNUMBER.ReadBlock
      V_29_WriteBlock: start-on-event=WriteBlock, operation=PS_NVM_BLOCK_SER_ECUSERIALNUMBER.WriteBlock
      V_29_InvalidateNvBlock: start-on-event=InvalidateNvBlock, operation=PS_NVM_BLOCK_SER_ECUSERIALNUMBER.InvalidateNvBlock
      V_29_EraseBlock: start-on-event=EraseBlock, operation=PS_NVM_BLOCK_SER_ECUSERIALNUMBER.EraseBlock
      V_29_SetBlockProtection: start-on-event=SetBlockProtection, operation=PAdmin_NVM_BLOCK_SER_ECUSERIALNUMBER.SetBlockProtection
      V_30_GetErrorStatus: start-on-event=GetErrorStatus, operation=PS_NVM_BLOCK_SER_VINCURRENT.GetErrorStatus
      V_30_SetRamBlockStatus: start-on-event=SetRamBlockStatus, operation=PS_NVM_BLOCK_SER_VINCURRENT.SetRamBlockStatus
      V_30_ReadBlock: start-on-event=ReadBlock, operation=PS_NVM_BLOCK_SER_VINCURRENT.ReadBlock
      V_30_WriteBlock: start-on-event=WriteBlock, operation=PS_NVM_BLOCK_SER_VINCURRENT.WriteBlock
      V_30_InvalidateNvBlock: start-on-event=InvalidateNvBlock, operation=PS_NVM_BLOCK_SER_VINCURRENT.InvalidateNvBlock
      V_30_EraseBlock: start-on-event=EraseBlock, operation=PS_NVM_BLOCK_SER_VINCURRENT.EraseBlock
      V_30_SetBlockProtection: start-on-event=SetBlockProtection, operation=PAdmin_NVM_BLOCK_SER_VINCURRENT.SetBlockProtection
      V_31_GetErrorStatus: start-on-event=GetErrorStatus, operation=PS_NVM_BLOCK_SER_VINORIGINAL.GetErrorStatus
      V_31_SetRamBlockStatus: start-on-event=SetRamBlockStatus, operation=PS_NVM_BLOCK_SER_VINORIGINAL.SetRamBlockStatus
      V_31_ReadBlock: start-on-event=ReadBlock, operation=PS_NVM_BLOCK_SER_VINORIGINAL.ReadBlock
      V_31_WriteBlock: start-on-event=WriteBlock, operation=PS_NVM_BLOCK_SER_VINORIGINAL.WriteBlock
      V_31_InvalidateNvBlock: start-on-event=InvalidateNvBlock, operation=PS_NVM_BLOCK_SER_VINORIGINAL.InvalidateNvBlock
      V_31_EraseBlock: start-on-event=EraseBlock, operation=PS_NVM_BLOCK_SER_VINORIGINAL.EraseBlock
      V_31_SetBlockProtection: start-on-event=SetBlockProtection, operation=PAdmin_NVM_BLOCK_SER_VINORIGINAL.SetBlockProtection
      V_32_GetErrorStatus: start-on-event=GetErrorStatus, operation=PS_NVM_BLOCK_SER_ACTIVEDIAGINFO_APPL.GetErrorStatus
      V_32_SetRamBlockStatus: start-on-event=SetRamBlockStatus, operation=PS_NVM_BLOCK_SER_ACTIVEDIAGINFO_APPL.SetRamBlockStatus
      V_32_ReadBlock: start-on-event=ReadBlock, operation=PS_NVM_BLOCK_SER_ACTIVEDIAGINFO_APPL.ReadBlock
      V_32_WriteBlock: start-on-event=WriteBlock, operation=PS_NVM_BLOCK_SER_ACTIVEDIAGINFO_APPL.WriteBlock
      V_32_InvalidateNvBlock: start-on-event=InvalidateNvBlock, operation=PS_NVM_BLOCK_SER_ACTIVEDIAGINFO_APPL.InvalidateNvBlock
      V_32_EraseBlock: start-on-event=EraseBlock, operation=PS_NVM_BLOCK_SER_ACTIVEDIAGINFO_APPL.EraseBlock
      V_32_SetBlockProtection: start-on-event=SetBlockProtection, operation=PAdmin_NVM_BLOCK_SER_ACTIVEDIAGINFO_APPL.SetBlockProtection
      V_33_GetErrorStatus: start-on-event=GetErrorStatus, operation=PS_NVM_BLOCK_CMS_NXTRMEC.GetErrorStatus
      V_33_SetRamBlockStatus: start-on-event=SetRamBlockStatus, operation=PS_NVM_BLOCK_CMS_NXTRMEC.SetRamBlockStatus
      V_33_ReadBlock: start-on-event=ReadBlock, operation=PS_NVM_BLOCK_CMS_NXTRMEC.ReadBlock
      V_33_WriteBlock: start-on-event=WriteBlock, operation=PS_NVM_BLOCK_CMS_NXTRMEC.WriteBlock
      V_33_InvalidateNvBlock: start-on-event=InvalidateNvBlock, operation=PS_NVM_BLOCK_CMS_NXTRMEC.InvalidateNvBlock
      V_33_EraseBlock: start-on-event=EraseBlock, operation=PS_NVM_BLOCK_CMS_NXTRMEC.EraseBlock
      V_33_SetBlockProtection: start-on-event=SetBlockProtection, operation=PAdmin_NVM_BLOCK_CMS_NXTRMEC.SetBlockProtection
      V_34_GetErrorStatus: start-on-event=GetErrorStatus, operation=PS_NVM_BLOCK_CMS_ECUSRLNUM.GetErrorStatus
      V_34_SetRamBlockStatus: start-on-event=SetRamBlockStatus, operation=PS_NVM_BLOCK_CMS_ECUSRLNUM.SetRamBlockStatus
      V_34_ReadBlock: start-on-event=ReadBlock, operation=PS_NVM_BLOCK_CMS_ECUSRLNUM.ReadBlock
      V_34_WriteBlock: start-on-event=WriteBlock, operation=PS_NVM_BLOCK_CMS_ECUSRLNUM.WriteBlock
      V_34_InvalidateNvBlock: start-on-event=InvalidateNvBlock, operation=PS_NVM_BLOCK_CMS_ECUSRLNUM.InvalidateNvBlock
      V_34_EraseBlock: start-on-event=EraseBlock, operation=PS_NVM_BLOCK_CMS_ECUSRLNUM.EraseBlock
      V_34_SetBlockProtection: start-on-event=SetBlockProtection, operation=PAdmin_NVM_BLOCK_CMS_ECUSRLNUM.SetBlockProtection
      V_35_GetErrorStatus: start-on-event=GetErrorStatus, operation=PS_NVM_BLOCK_CMS_EPSSRLNUM.GetErrorStatus
      V_35_SetRamBlockStatus: start-on-event=SetRamBlockStatus, operation=PS_NVM_BLOCK_CMS_EPSSRLNUM.SetRamBlockStatus
      V_35_ReadBlock: start-on-event=ReadBlock, operation=PS_NVM_BLOCK_CMS_EPSSRLNUM.ReadBlock
      V_35_WriteBlock: start-on-event=WriteBlock, operation=PS_NVM_BLOCK_CMS_EPSSRLNUM.WriteBlock
      V_35_InvalidateNvBlock: start-on-event=InvalidateNvBlock, operation=PS_NVM_BLOCK_CMS_EPSSRLNUM.InvalidateNvBlock
      V_35_EraseBlock: start-on-event=EraseBlock, operation=PS_NVM_BLOCK_CMS_EPSSRLNUM.EraseBlock
      V_35_SetBlockProtection: start-on-event=SetBlockProtection, operation=PAdmin_NVM_BLOCK_CMS_EPSSRLNUM.SetBlockProtection
      V_36_GetErrorStatus: start-on-event=GetErrorStatus, operation=PS_NVM_BLOCK_SER_ECUPN.GetErrorStatus
      V_36_SetRamBlockStatus: start-on-event=SetRamBlockStatus, operation=PS_NVM_BLOCK_SER_ECUPN.SetRamBlockStatus
      V_36_ReadBlock: start-on-event=ReadBlock, operation=PS_NVM_BLOCK_SER_ECUPN.ReadBlock
      V_36_WriteBlock: start-on-event=WriteBlock, operation=PS_NVM_BLOCK_SER_ECUPN.WriteBlock
      V_36_InvalidateNvBlock: start-on-event=InvalidateNvBlock, operation=PS_NVM_BLOCK_SER_ECUPN.InvalidateNvBlock
      V_36_EraseBlock: start-on-event=EraseBlock, operation=PS_NVM_BLOCK_SER_ECUPN.EraseBlock
      V_36_SetBlockProtection: start-on-event=SetBlockProtection, operation=PAdmin_NVM_BLOCK_SER_ECUPN.SetBlockProtection
      V_37_GetErrorStatus: start-on-event=GetErrorStatus, operation=PS_NVM_BLOCK_CMS_NXTRMANUFSCRATCHPAD.GetErrorStatus
      V_37_SetRamBlockStatus: start-on-event=SetRamBlockStatus, operation=PS_NVM_BLOCK_CMS_NXTRMANUFSCRATCHPAD.SetRamBlockStatus
      V_37_ReadBlock: start-on-event=ReadBlock, operation=PS_NVM_BLOCK_CMS_NXTRMANUFSCRATCHPAD.ReadBlock
      V_37_WriteBlock: start-on-event=WriteBlock, operation=PS_NVM_BLOCK_CMS_NXTRMANUFSCRATCHPAD.WriteBlock
      V_37_InvalidateNvBlock: start-on-event=InvalidateNvBlock, operation=PS_NVM_BLOCK_CMS_NXTRMANUFSCRATCHPAD.InvalidateNvBlock
      V_37_EraseBlock: start-on-event=EraseBlock, operation=PS_NVM_BLOCK_CMS_NXTRMANUFSCRATCHPAD.EraseBlock
      V_37_SetBlockProtection: start-on-event=SetBlockProtection, operation=PAdmin_NVM_BLOCK_CMS_NXTRMANUFSCRATCHPAD.SetBlockProtection
      V_38_GetErrorStatus: start-on-event=GetErrorStatus, operation=PS_NVM_BLOCK_CMS_IGNCNTR.GetErrorStatus
      V_38_SetRamBlockStatus: start-on-event=SetRamBlockStatus, operation=PS_NVM_BLOCK_CMS_IGNCNTR.SetRamBlockStatus
      V_38_ReadBlock: start-on-event=ReadBlock, operation=PS_NVM_BLOCK_CMS_IGNCNTR.ReadBlock
      V_38_WriteBlock: start-on-event=WriteBlock, operation=PS_NVM_BLOCK_CMS_IGNCNTR.WriteBlock
      V_38_InvalidateNvBlock: start-on-event=InvalidateNvBlock, operation=PS_NVM_BLOCK_CMS_IGNCNTR.InvalidateNvBlock
      V_38_EraseBlock: start-on-event=EraseBlock, operation=PS_NVM_BLOCK_CMS_IGNCNTR.EraseBlock
      V_38_SetBlockProtection: start-on-event=SetBlockProtection, operation=PAdmin_NVM_BLOCK_CMS_IGNCNTR.SetBlockProtection
      V_39_GetErrorStatus: start-on-event=GetErrorStatus, operation=PS_Rte_NvmBlock_StaMd_CloseCheckData.GetErrorStatus
      V_39_SetRamBlockStatus: start-on-event=SetRamBlockStatus, operation=PS_Rte_NvmBlock_StaMd_CloseCheckData.SetRamBlockStatus
      V_39_ReadBlock: start-on-event=ReadBlock, operation=PS_Rte_NvmBlock_StaMd_CloseCheckData.ReadBlock
      V_39_WriteBlock: start-on-event=WriteBlock, operation=PS_Rte_NvmBlock_StaMd_CloseCheckData.WriteBlock
      V_39_InvalidateNvBlock: start-on-event=InvalidateNvBlock, operation=PS_Rte_NvmBlock_StaMd_CloseCheckData.InvalidateNvBlock
      V_39_EraseBlock: start-on-event=EraseBlock, operation=PS_Rte_NvmBlock_StaMd_CloseCheckData.EraseBlock
      V_39_SetBlockProtection: start-on-event=SetBlockProtection, operation=PAdmin_Rte_NvmBlock_StaMd_CloseCheckData.SetBlockProtection
      V_40_GetErrorStatus: start-on-event=GetErrorStatus, operation=PS_NVM_BLOCK_DIAGMGR_BLACKBOX.GetErrorStatus
      V_40_SetRamBlockStatus: start-on-event=SetRamBlockStatus, operation=PS_NVM_BLOCK_DIAGMGR_BLACKBOX.SetRamBlockStatus
      V_40_ReadBlock: start-on-event=ReadBlock, operation=PS_NVM_BLOCK_DIAGMGR_BLACKBOX.ReadBlock
      V_40_WriteBlock: start-on-event=WriteBlock, operation=PS_NVM_BLOCK_DIAGMGR_BLACKBOX.WriteBlock
      V_40_InvalidateNvBlock: start-on-event=InvalidateNvBlock, operation=PS_NVM_BLOCK_DIAGMGR_BLACKBOX.InvalidateNvBlock
      V_40_EraseBlock: start-on-event=EraseBlock, operation=PS_NVM_BLOCK_DIAGMGR_BLACKBOX.EraseBlock
      V_40_SetBlockProtection: start-on-event=SetBlockProtection, operation=PAdmin_NVM_BLOCK_DIAGMGR_BLACKBOX.SetBlockProtection
      V_41_GetErrorStatus: start-on-event=GetErrorStatus, operation=PS_Rte_NvmBlock_Ap_AvgFricLrn_AvgFricLrnData.GetErrorStatus
      V_41_SetRamBlockStatus: start-on-event=SetRamBlockStatus, operation=PS_Rte_NvmBlock_Ap_AvgFricLrn_AvgFricLrnData.SetRamBlockStatus
      V_41_ReadBlock: start-on-event=ReadBlock, operation=PS_Rte_NvmBlock_Ap_AvgFricLrn_AvgFricLrnData.ReadBlock
      V_41_WriteBlock: start-on-event=WriteBlock, operation=PS_Rte_NvmBlock_Ap_AvgFricLrn_AvgFricLrnData.WriteBlock
      V_41_InvalidateNvBlock: start-on-event=InvalidateNvBlock, operation=PS_Rte_NvmBlock_Ap_AvgFricLrn_AvgFricLrnData.InvalidateNvBlock
      V_41_EraseBlock: start-on-event=EraseBlock, operation=PS_Rte_NvmBlock_Ap_AvgFricLrn_AvgFricLrnData.EraseBlock
      V_41_SetBlockProtection: start-on-event=SetBlockProtection, operation=PAdmin_Rte_NvmBlock_Ap_AvgFricLrn_AvgFricLrnData.SetBlockProtection
      V_42_GetErrorStatus: start-on-event=GetErrorStatus, operation=PS_Rte_NvmBlock_BatteryVoltage_OvervoltageData.GetErrorStatus
      V_42_SetRamBlockStatus: start-on-event=SetRamBlockStatus, operation=PS_Rte_NvmBlock_BatteryVoltage_OvervoltageData.SetRamBlockStatus
      V_42_ReadBlock: start-on-event=ReadBlock, operation=PS_Rte_NvmBlock_BatteryVoltage_OvervoltageData.ReadBlock
      V_42_WriteBlock: start-on-event=WriteBlock, operation=PS_Rte_NvmBlock_BatteryVoltage_OvervoltageData.WriteBlock
      V_42_InvalidateNvBlock: start-on-event=InvalidateNvBlock, operation=PS_Rte_NvmBlock_BatteryVoltage_OvervoltageData.InvalidateNvBlock
      V_42_EraseBlock: start-on-event=EraseBlock, operation=PS_Rte_NvmBlock_BatteryVoltage_OvervoltageData.EraseBlock
      V_42_SetBlockProtection: start-on-event=SetBlockProtection, operation=PAdmin_Rte_NvmBlock_BatteryVoltage_OvervoltageData.SetBlockProtection
      V_43_GetErrorStatus: start-on-event=GetErrorStatus, operation=PS_NVM_BLOCK_DIAGMGR_LATCHCNTRS.GetErrorStatus
      V_43_SetRamBlockStatus: start-on-event=SetRamBlockStatus, operation=PS_NVM_BLOCK_DIAGMGR_LATCHCNTRS.SetRamBlockStatus
      V_43_ReadBlock: start-on-event=ReadBlock, operation=PS_NVM_BLOCK_DIAGMGR_LATCHCNTRS.ReadBlock
      V_43_WriteBlock: start-on-event=WriteBlock, operation=PS_NVM_BLOCK_DIAGMGR_LATCHCNTRS.WriteBlock
      V_43_InvalidateNvBlock: start-on-event=InvalidateNvBlock, operation=PS_NVM_BLOCK_DIAGMGR_LATCHCNTRS.InvalidateNvBlock
      V_43_EraseBlock: start-on-event=EraseBlock, operation=PS_NVM_BLOCK_DIAGMGR_LATCHCNTRS.EraseBlock
      V_43_SetBlockProtection: start-on-event=SetBlockProtection, operation=PAdmin_NVM_BLOCK_DIAGMGR_LATCHCNTRS.SetBlockProtection
      V_44_GetErrorStatus: start-on-event=GetErrorStatus, operation=PS_NvM_NVM_BLOCK_DEM.GetErrorStatus
      V_44_SetRamBlockStatus: start-on-event=SetRamBlockStatus, operation=PS_NvM_NVM_BLOCK_DEM.SetRamBlockStatus
      V_44_ReadBlock: start-on-event=ReadBlock, operation=PS_NvM_NVM_BLOCK_DEM.ReadBlock
      V_44_WriteBlock: start-on-event=WriteBlock, operation=PS_NvM_NVM_BLOCK_DEM.WriteBlock
      V_44_InvalidateNvBlock: start-on-event=InvalidateNvBlock, operation=PS_NvM_NVM_BLOCK_DEM.InvalidateNvBlock
      V_44_EraseBlock: start-on-event=EraseBlock, operation=PS_NvM_NVM_BLOCK_DEM.EraseBlock
      V_44_SetBlockProtection: start-on-event=SetBlockProtection, operation=PAdmin_NvM_NVM_BLOCK_DEM.SetBlockProtection
      V_45_GetErrorStatus: start-on-event=GetErrorStatus, operation=PS_Rte_NvmBlock_Ap_TrqCanc_CogTrqRplComp.GetErrorStatus
      V_45_SetRamBlockStatus: start-on-event=SetRamBlockStatus, operation=PS_Rte_NvmBlock_Ap_TrqCanc_CogTrqRplComp.SetRamBlockStatus
      V_45_ReadBlock: start-on-event=ReadBlock, operation=PS_Rte_NvmBlock_Ap_TrqCanc_CogTrqRplComp.ReadBlock
      V_45_WriteBlock: start-on-event=WriteBlock, operation=PS_Rte_NvmBlock_Ap_TrqCanc_CogTrqRplComp.WriteBlock
      V_45_InvalidateNvBlock: start-on-event=InvalidateNvBlock, operation=PS_Rte_NvmBlock_Ap_TrqCanc_CogTrqRplComp.InvalidateNvBlock
      V_45_EraseBlock: start-on-event=EraseBlock, operation=PS_Rte_NvmBlock_Ap_TrqCanc_CogTrqRplComp.EraseBlock
      V_45_SetBlockProtection: start-on-event=SetBlockProtection, operation=PAdmin_Rte_NvmBlock_Ap_TrqCanc_CogTrqRplComp.SetBlockProtection
      V_46_GetErrorStatus: start-on-event=GetErrorStatus, operation=PS_Rte_NvmBlock_Ap_AstLmt_SteerAsstDefeat.GetErrorStatus
      V_46_SetRamBlockStatus: start-on-event=SetRamBlockStatus, operation=PS_Rte_NvmBlock_Ap_AstLmt_SteerAsstDefeat.SetRamBlockStatus
      V_46_ReadBlock: start-on-event=ReadBlock, operation=PS_Rte_NvmBlock_Ap_AstLmt_SteerAsstDefeat.ReadBlock
      V_46_WriteBlock: start-on-event=WriteBlock, operation=PS_Rte_NvmBlock_Ap_AstLmt_SteerAsstDefeat.WriteBlock
      V_46_InvalidateNvBlock: start-on-event=InvalidateNvBlock, operation=PS_Rte_NvmBlock_Ap_AstLmt_SteerAsstDefeat.InvalidateNvBlock
      V_46_EraseBlock: start-on-event=EraseBlock, operation=PS_Rte_NvmBlock_Ap_AstLmt_SteerAsstDefeat.EraseBlock
      V_46_SetBlockProtection: start-on-event=SetBlockProtection, operation=PAdmin_Rte_NvmBlock_Ap_AstLmt_SteerAsstDefeat.SetBlockProtection
      V_47_GetErrorStatus: start-on-event=GetErrorStatus, operation=PS_NVM_BLOCK_CMS_ECUHWPN.GetErrorStatus
      V_47_SetRamBlockStatus: start-on-event=SetRamBlockStatus, operation=PS_NVM_BLOCK_CMS_ECUHWPN.SetRamBlockStatus
      V_47_ReadBlock: start-on-event=ReadBlock, operation=PS_NVM_BLOCK_CMS_ECUHWPN.ReadBlock
      V_47_WriteBlock: start-on-event=WriteBlock, operation=PS_NVM_BLOCK_CMS_ECUHWPN.WriteBlock
      V_47_InvalidateNvBlock: start-on-event=InvalidateNvBlock, operation=PS_NVM_BLOCK_CMS_ECUHWPN.InvalidateNvBlock
      V_47_EraseBlock: start-on-event=EraseBlock, operation=PS_NVM_BLOCK_CMS_ECUHWPN.EraseBlock
      V_47_SetBlockProtection: start-on-event=SetBlockProtection, operation=PAdmin_NVM_BLOCK_CMS_ECUHWPN.SetBlockProtection
      V_48_GetErrorStatus: start-on-event=GetErrorStatus, operation=PS_NVM_BLOCK_SWFINGERPRINT.GetErrorStatus
      V_48_SetRamBlockStatus: start-on-event=SetRamBlockStatus, operation=PS_NVM_BLOCK_SWFINGERPRINT.SetRamBlockStatus
      V_48_ReadBlock: start-on-event=ReadBlock, operation=PS_NVM_BLOCK_SWFINGERPRINT.ReadBlock
      V_48_WriteBlock: start-on-event=WriteBlock, operation=PS_NVM_BLOCK_SWFINGERPRINT.WriteBlock
      V_48_InvalidateNvBlock: start-on-event=InvalidateNvBlock, operation=PS_NVM_BLOCK_SWFINGERPRINT.InvalidateNvBlock
      V_48_EraseBlock: start-on-event=EraseBlock, operation=PS_NVM_BLOCK_SWFINGERPRINT.EraseBlock
      V_48_SetBlockProtection: start-on-event=SetBlockProtection, operation=PAdmin_NVM_BLOCK_SWFINGERPRINT.SetBlockProtection
      V_49_GetErrorStatus: start-on-event=GetErrorStatus, operation=PS_NVM_BLOCK_RESETRESP.GetErrorStatus
      V_49_SetRamBlockStatus: start-on-event=SetRamBlockStatus, operation=PS_NVM_BLOCK_RESETRESP.SetRamBlockStatus
      V_49_ReadBlock: start-on-event=ReadBlock, operation=PS_NVM_BLOCK_RESETRESP.ReadBlock
      V_49_WriteBlock: start-on-event=WriteBlock, operation=PS_NVM_BLOCK_RESETRESP.WriteBlock
      V_49_InvalidateNvBlock: start-on-event=InvalidateNvBlock, operation=PS_NVM_BLOCK_RESETRESP.InvalidateNvBlock
      V_49_EraseBlock: start-on-event=EraseBlock, operation=PS_NVM_BLOCK_RESETRESP.EraseBlock
      V_49_SetBlockProtection: start-on-event=SetBlockProtection, operation=PAdmin_NVM_BLOCK_RESETRESP.SetBlockProtection
      V_50_GetErrorStatus: start-on-event=GetErrorStatus, operation=PS_NVM_BLOCK_PROGREQCNT.GetErrorStatus
      V_50_SetRamBlockStatus: start-on-event=SetRamBlockStatus, operation=PS_NVM_BLOCK_PROGREQCNT.SetRamBlockStatus
      V_50_ReadBlock: start-on-event=ReadBlock, operation=PS_NVM_BLOCK_PROGREQCNT.ReadBlock
      V_50_WriteBlock: start-on-event=WriteBlock, operation=PS_NVM_BLOCK_PROGREQCNT.WriteBlock
      V_50_InvalidateNvBlock: start-on-event=InvalidateNvBlock, operation=PS_NVM_BLOCK_PROGREQCNT.InvalidateNvBlock
      V_50_EraseBlock: start-on-event=EraseBlock, operation=PS_NVM_BLOCK_PROGREQCNT.EraseBlock
      V_50_SetBlockProtection: start-on-event=SetBlockProtection, operation=PAdmin_NVM_BLOCK_PROGREQCNT.SetBlockProtection
      V_51_GetErrorStatus: start-on-event=GetErrorStatus, operation=PS_NVM_BLOCK_SECDLYEN.GetErrorStatus
      V_51_SetRamBlockStatus: start-on-event=SetRamBlockStatus, operation=PS_NVM_BLOCK_SECDLYEN.SetRamBlockStatus
      V_51_ReadBlock: start-on-event=ReadBlock, operation=PS_NVM_BLOCK_SECDLYEN.ReadBlock
      V_51_WriteBlock: start-on-event=WriteBlock, operation=PS_NVM_BLOCK_SECDLYEN.WriteBlock
      V_51_InvalidateNvBlock: start-on-event=InvalidateNvBlock, operation=PS_NVM_BLOCK_SECDLYEN.InvalidateNvBlock
      V_51_EraseBlock: start-on-event=EraseBlock, operation=PS_NVM_BLOCK_SECDLYEN.EraseBlock
      V_51_SetBlockProtection: start-on-event=SetBlockProtection, operation=PAdmin_NVM_BLOCK_SECDLYEN.SetBlockProtection
      V_1_GetErrorStatus: start-on-event=GetErrorStatus, operation=PS_ConfigBlock.GetErrorStatus
      V_1_SetRamBlockStatus: start-on-event=SetRamBlockStatus, operation=PS_ConfigBlock.SetRamBlockStatus
      V_1_ReadBlock: start-on-event=ReadBlock, operation=PS_ConfigBlock.ReadBlock
      V_1_WriteBlock: start-on-event=WriteBlock, operation=PS_ConfigBlock.WriteBlock
      V_1_InvalidateNvBlock: start-on-event=InvalidateNvBlock, operation=PS_ConfigBlock.InvalidateNvBlock
      V_1_EraseBlock: start-on-event=EraseBlock, operation=PS_ConfigBlock.EraseBlock
      V_1_SetBlockProtection: start-on-event=SetBlockProtection, operation=PAdmin_ConfigBlock.SetBlockProtection
    port-api-option port=PS_NVM_BLOCK_NXTRWIRSELECT:
      port-arg-values:
        integer literal NvM_ServiceBlockId_2: type=NvM_BlockIdType, value=2
    port-api-option port=PS_Rte_NvmBlock_MtrPos_MtrPosSnsr_EOLData:
      port-arg-values:
        integer literal NvM_ServiceBlockId_3: type=NvM_BlockIdType, value=3
    port-api-option port=PS_Rte_NvmBlock_HwTrq_HwTrqScaleData:
      port-arg-values:
        integer literal NvM_ServiceBlockId_4: type=NvM_BlockIdType, value=4
    port-api-option port=PS_Rte_NvmBlock_Polarity_EOLCtrlPolarity:
      port-arg-values:
        integer literal NvM_ServiceBlockId_5: type=NvM_BlockIdType, value=5
    port-api-option port=PS_Rte_NvmBlock_HwTrq_HwTrqTrimData:
      port-arg-values:
        integer literal NvM_ServiceBlockId_6: type=NvM_BlockIdType, value=6
    port-api-option port=PS_NVM_BLOCK_DIAGMGR_NTCSTRG:
      port-arg-values:
        integer literal NvM_ServiceBlockId_7: type=NvM_BlockIdType, value=7
    port-api-option port=PS_NVM_BLOCK_EPSDEFEATS:
      port-arg-values:
        integer literal NvM_ServiceBlockId_8: type=NvM_BlockIdType, value=8
    port-api-option port=PS_Rte_NvmBlock_StaMd_TypeHRamBuffer:
      port-arg-values:
        integer literal NvM_ServiceBlockId_9: type=NvM_BlockIdType, value=9
    port-api-option port=PS_Rte_NvmBlock_TrqCmdScl_TorqueCmdSF_Uls_f32:
      port-arg-values:
        integer literal NvM_ServiceBlockId_10: type=NvM_BlockIdType, value=10
    port-api-option port=PS_Rte_NvmBlock_CmMtrCurr_CurrTempOffset:
      port-arg-values:
        integer literal NvM_ServiceBlockId_11: type=NvM_BlockIdType, value=11
    port-api-option port=PS_Rte_NvmBlock_CmMtrCurr_ShCurrCal:
      port-arg-values:
        integer literal NvM_ServiceBlockId_12: type=NvM_BlockIdType, value=12
    port-api-option port=PS_Rte_NvmBlock_CurrParamComp_EOLNomMtrParam:
      port-arg-values:
        integer literal NvM_ServiceBlockId_13: type=NvM_BlockIdType, value=13
    port-api-option port=PS_Rte_NvmBlock_LrnEOT_LearnedEOT:
      port-arg-values:
        integer literal NvM_ServiceBlockId_14: type=NvM_BlockIdType, value=14
    port-api-option port=PS_Rte_NvmBlock_IPMTrqCanc_CogTrqCal:
      port-arg-values:
        integer literal NvM_ServiceBlockId_15: type=NvM_BlockIdType, value=15
    port-api-option port=PS_Rte_NvmBlock_HwTrq_EOLTrqStepData:
      port-arg-values:
        integer literal NvM_ServiceBlockId_16: type=NvM_BlockIdType, value=16
    port-api-option port=PS_NVM_BLOCK_SER_METADATA_APPLICATION:
      port-arg-values:
        integer literal NvM_ServiceBlockId_17: type=NvM_BlockIdType, value=17
    port-api-option port=PS_NVM_BLOCK_SER_METADATA_CAL1:
      port-arg-values:
        integer literal NvM_ServiceBlockId_18: type=NvM_BlockIdType, value=18
    port-api-option port=PS_NVM_BLOCK_SER_METADATA_CAL2:
      port-arg-values:
        integer literal NvM_ServiceBlockId_19: type=NvM_BlockIdType, value=19
    port-api-option port=PS_NVM_BLOCK_SER_ACTIVEDIAGINFO_BOOT:
      port-arg-values:
        integer literal NvM_ServiceBlockId_20: type=NvM_BlockIdType, value=20
    port-api-option port=PS_NVM_BLOCK_SER_HWPARTNUMBER:
      port-arg-values:
        integer literal NvM_ServiceBlockId_21: type=NvM_BlockIdType, value=21
    port-api-option port=PS_NVM_BLOCK_SER_HWVERSIONINFO:
      port-arg-values:
        integer literal NvM_ServiceBlockId_22: type=NvM_BlockIdType, value=22
    port-api-option port=PS_NVM_BLOCK_SER_BOOTSWVERSIONINFO:
      port-arg-values:
        integer literal NvM_ServiceBlockId_23: type=NvM_BlockIdType, value=23
    port-api-option port=PS_NVM_BLOCK_SER_HWSUPPID:
      port-arg-values:
        integer literal NvM_ServiceBlockId_24: type=NvM_BlockIdType, value=24
    port-api-option port=PS_NVM_BLOCK_SER_RESPONEVENTACTVSTATE:
      port-arg-values:
        integer literal NvM_ServiceBlockId_25: type=NvM_BlockIdType, value=25
    port-api-option port=PS_NVM_BLOCK_SER_VINODOMETERCOUNTER:
      port-arg-values:
        integer literal NvM_ServiceBlockId_26: type=NvM_BlockIdType, value=26
    port-api-option port=PS_NVM_BLOCK_SER_DIAGSPECINFO:
      port-arg-values:
        integer literal NvM_ServiceBlockId_27: type=NvM_BlockIdType, value=27
    port-api-option port=PS_NVM_BLOCK_SER_VEHICLEINFO:
      port-arg-values:
        integer literal NvM_ServiceBlockId_28: type=NvM_BlockIdType, value=28
    port-api-option port=PS_NVM_BLOCK_SER_ECUSERIALNUMBER:
      port-arg-values:
        integer literal NvM_ServiceBlockId_29: type=NvM_BlockIdType, value=29
    port-api-option port=PS_NVM_BLOCK_SER_VINCURRENT:
      port-arg-values:
        integer literal NvM_ServiceBlockId_30: type=NvM_BlockIdType, value=30
    port-api-option port=PS_NVM_BLOCK_SER_VINORIGINAL:
      port-arg-values:
        integer literal NvM_ServiceBlockId_31: type=NvM_BlockIdType, value=31
    port-api-option port=PS_NVM_BLOCK_SER_ACTIVEDIAGINFO_APPL:
      port-arg-values:
        integer literal NvM_ServiceBlockId_32: type=NvM_BlockIdType, value=32
    port-api-option port=PS_NVM_BLOCK_CMS_NXTRMEC:
      port-arg-values:
        integer literal NvM_ServiceBlockId_33: type=NvM_BlockIdType, value=33
    port-api-option port=PS_NVM_BLOCK_CMS_ECUSRLNUM:
      port-arg-values:
        integer literal NvM_ServiceBlockId_34: type=NvM_BlockIdType, value=34
    port-api-option port=PS_NVM_BLOCK_CMS_EPSSRLNUM:
      port-arg-values:
        integer literal NvM_ServiceBlockId_35: type=NvM_BlockIdType, value=35
    port-api-option port=PS_NVM_BLOCK_SER_ECUPN:
      port-arg-values:
        integer literal NvM_ServiceBlockId_36: type=NvM_BlockIdType, value=36
    port-api-option port=PS_NVM_BLOCK_CMS_NXTRMANUFSCRATCHPAD:
      port-arg-values:
        integer literal NvM_ServiceBlockId_37: type=NvM_BlockIdType, value=37
    port-api-option port=PS_NVM_BLOCK_CMS_IGNCNTR:
      port-arg-values:
        integer literal NvM_ServiceBlockId_38: type=NvM_BlockIdType, value=38
    port-api-option port=PS_Rte_NvmBlock_StaMd_CloseCheckData:
      port-arg-values:
        integer literal NvM_ServiceBlockId_39: type=NvM_BlockIdType, value=39
    port-api-option port=PS_NVM_BLOCK_DIAGMGR_BLACKBOX:
      port-arg-values:
        integer literal NvM_ServiceBlockId_40: type=NvM_BlockIdType, value=40
    port-api-option port=PS_Rte_NvmBlock_Ap_AvgFricLrn_AvgFricLrnData:
      port-arg-values:
        integer literal NvM_ServiceBlockId_41: type=NvM_BlockIdType, value=41
    port-api-option port=PS_Rte_NvmBlock_BatteryVoltage_OvervoltageData:
      port-arg-values:
        integer literal NvM_ServiceBlockId_42: type=NvM_BlockIdType, value=42
    port-api-option port=PS_NVM_BLOCK_DIAGMGR_LATCHCNTRS:
      port-arg-values:
        integer literal NvM_ServiceBlockId_43: type=NvM_BlockIdType, value=43
    port-api-option port=PS_NvM_NVM_BLOCK_DEM:
      port-arg-values:
        integer literal NvM_ServiceBlockId_44: type=NvM_BlockIdType, value=44
    port-api-option port=PS_Rte_NvmBlock_Ap_TrqCanc_CogTrqRplComp:
      port-arg-values:
        integer literal NvM_ServiceBlockId_45: type=NvM_BlockIdType, value=45
    port-api-option port=PS_Rte_NvmBlock_Ap_AstLmt_SteerAsstDefeat:
      port-arg-values:
        integer literal NvM_ServiceBlockId_46: type=NvM_BlockIdType, value=46
    port-api-option port=PS_NVM_BLOCK_CMS_ECUHWPN:
      port-arg-values:
        integer literal NvM_ServiceBlockId_47: type=NvM_BlockIdType, value=47
    port-api-option port=PS_NVM_BLOCK_SWFINGERPRINT:
      port-arg-values:
        integer literal NvM_ServiceBlockId_48: type=NvM_BlockIdType, value=48
    port-api-option port=PS_NVM_BLOCK_RESETRESP:
      port-arg-values:
        integer literal NvM_ServiceBlockId_49: type=NvM_BlockIdType, value=49
    port-api-option port=PS_NVM_BLOCK_PROGREQCNT:
      port-arg-values:
        integer literal NvM_ServiceBlockId_50: type=NvM_BlockIdType, value=50
    port-api-option port=PS_NVM_BLOCK_SECDLYEN:
      port-arg-values:
        integer literal NvM_ServiceBlockId_51: type=NvM_BlockIdType, value=51
    port-api-option port=PS_ConfigBlock:
      port-arg-values:
        integer literal NvM_ServiceBlockId_1: type=NvM_BlockIdType, value=1
    port-api-option port=PAdmin_NVM_BLOCK_NXTRWIRSELECT:
      port-arg-values:
        integer literal NvM_AdminBlockId_2: type=NvM_BlockIdType, value=2
    port-api-option port=PAdmin_Rte_NvmBlock_MtrPos_MtrPosSnsr_EOLData:
      port-arg-values:
        integer literal NvM_AdminBlockId_3: type=NvM_BlockIdType, value=3
    port-api-option port=PAdmin_Rte_NvmBlock_HwTrq_HwTrqScaleData:
      port-arg-values:
        integer literal NvM_AdminBlockId_4: type=NvM_BlockIdType, value=4
    port-api-option port=PAdmin_Rte_NvmBlock_Polarity_EOLCtrlPolarity:
      port-arg-values:
        integer literal NvM_AdminBlockId_5: type=NvM_BlockIdType, value=5
    port-api-option port=PAdmin_Rte_NvmBlock_HwTrq_HwTrqTrimData:
      port-arg-values:
        integer literal NvM_AdminBlockId_6: type=NvM_BlockIdType, value=6
    port-api-option port=PAdmin_NVM_BLOCK_DIAGMGR_NTCSTRG:
      port-arg-values:
        integer literal NvM_AdminBlockId_7: type=NvM_BlockIdType, value=7
    port-api-option port=PAdmin_NVM_BLOCK_EPSDEFEATS:
      port-arg-values:
        integer literal NvM_AdminBlockId_8: type=NvM_BlockIdType, value=8
    port-api-option port=PAdmin_Rte_NvmBlock_StaMd_TypeHRamBuffer:
      port-arg-values:
        integer literal NvM_AdminBlockId_9: type=NvM_BlockIdType, value=9
    port-api-option port=PAdmin_Rte_NvmBlock_TrqCmdScl_TorqueCmdSF_Uls_f32:
      port-arg-values:
        integer literal NvM_AdminBlockId_10: type=NvM_BlockIdType, value=10
    port-api-option port=PAdmin_Rte_NvmBlock_CmMtrCurr_CurrTempOffset:
      port-arg-values:
        integer literal NvM_AdminBlockId_11: type=NvM_BlockIdType, value=11
    port-api-option port=PAdmin_Rte_NvmBlock_CmMtrCurr_ShCurrCal:
      port-arg-values:
        integer literal NvM_AdminBlockId_12: type=NvM_BlockIdType, value=12
    port-api-option port=PAdmin_Rte_NvmBlock_CurrParamComp_EOLNomMtrParam:
      port-arg-values:
        integer literal NvM_AdminBlockId_13: type=NvM_BlockIdType, value=13
    port-api-option port=PAdmin_Rte_NvmBlock_LrnEOT_LearnedEOT:
      port-arg-values:
        integer literal NvM_AdminBlockId_14: type=NvM_BlockIdType, value=14
    port-api-option port=PAdmin_Rte_NvmBlock_IPMTrqCanc_CogTrqCal:
      port-arg-values:
        integer literal NvM_AdminBlockId_15: type=NvM_BlockIdType, value=15
    port-api-option port=PAdmin_Rte_NvmBlock_HwTrq_EOLTrqStepData:
      port-arg-values:
        integer literal NvM_AdminBlockId_16: type=NvM_BlockIdType, value=16
    port-api-option port=PAdmin_NVM_BLOCK_SER_METADATA_APPLICATION:
      port-arg-values:
        integer literal NvM_AdminBlockId_17: type=NvM_BlockIdType, value=17
    port-api-option port=PAdmin_NVM_BLOCK_SER_METADATA_CAL1:
      port-arg-values:
        integer literal NvM_AdminBlockId_18: type=NvM_BlockIdType, value=18
    port-api-option port=PAdmin_NVM_BLOCK_SER_METADATA_CAL2:
      port-arg-values:
        integer literal NvM_AdminBlockId_19: type=NvM_BlockIdType, value=19
    port-api-option port=PAdmin_NVM_BLOCK_SER_ACTIVEDIAGINFO_BOOT:
      port-arg-values:
        integer literal NvM_AdminBlockId_20: type=NvM_BlockIdType, value=20
    port-api-option port=PAdmin_NVM_BLOCK_SER_HWPARTNUMBER:
      port-arg-values:
        integer literal NvM_AdminBlockId_21: type=NvM_BlockIdType, value=21
    port-api-option port=PAdmin_NVM_BLOCK_SER_HWVERSIONINFO:
      port-arg-values:
        integer literal NvM_AdminBlockId_22: type=NvM_BlockIdType, value=22
    port-api-option port=PAdmin_NVM_BLOCK_SER_BOOTSWVERSIONINFO:
      port-arg-values:
        integer literal NvM_AdminBlockId_23: type=NvM_BlockIdType, value=23
    port-api-option port=PAdmin_NVM_BLOCK_SER_HWSUPPID:
      port-arg-values:
        integer literal NvM_AdminBlockId_24: type=NvM_BlockIdType, value=24
    port-api-option port=PAdmin_NVM_BLOCK_SER_RESPONEVENTACTVSTATE:
      port-arg-values:
        integer literal NvM_AdminBlockId_25: type=NvM_BlockIdType, value=25
    port-api-option port=PAdmin_NVM_BLOCK_SER_VINODOMETERCOUNTER:
      port-arg-values:
        integer literal NvM_AdminBlockId_26: type=NvM_BlockIdType, value=26
    port-api-option port=PAdmin_NVM_BLOCK_SER_DIAGSPECINFO:
      port-arg-values:
        integer literal NvM_AdminBlockId_27: type=NvM_BlockIdType, value=27
    port-api-option port=PAdmin_NVM_BLOCK_SER_VEHICLEINFO:
      port-arg-values:
        integer literal NvM_AdminBlockId_28: type=NvM_BlockIdType, value=28
    port-api-option port=PAdmin_NVM_BLOCK_SER_ECUSERIALNUMBER:
      port-arg-values:
        integer literal NvM_AdminBlockId_29: type=NvM_BlockIdType, value=29
    port-api-option port=PAdmin_NVM_BLOCK_SER_VINCURRENT:
      port-arg-values:
        integer literal NvM_AdminBlockId_30: type=NvM_BlockIdType, value=30
    port-api-option port=PAdmin_NVM_BLOCK_SER_VINORIGINAL:
      port-arg-values:
        integer literal NvM_AdminBlockId_31: type=NvM_BlockIdType, value=31
    port-api-option port=PAdmin_NVM_BLOCK_SER_ACTIVEDIAGINFO_APPL:
      port-arg-values:
        integer literal NvM_AdminBlockId_32: type=NvM_BlockIdType, value=32
    port-api-option port=PAdmin_NVM_BLOCK_CMS_NXTRMEC:
      port-arg-values:
        integer literal NvM_AdminBlockId_33: type=NvM_BlockIdType, value=33
    port-api-option port=PAdmin_NVM_BLOCK_CMS_ECUSRLNUM:
      port-arg-values:
        integer literal NvM_AdminBlockId_34: type=NvM_BlockIdType, value=34
    port-api-option port=PAdmin_NVM_BLOCK_CMS_EPSSRLNUM:
      port-arg-values:
        integer literal NvM_AdminBlockId_35: type=NvM_BlockIdType, value=35
    port-api-option port=PAdmin_NVM_BLOCK_SER_ECUPN:
      port-arg-values:
        integer literal NvM_AdminBlockId_36: type=NvM_BlockIdType, value=36
    port-api-option port=PAdmin_NVM_BLOCK_CMS_NXTRMANUFSCRATCHPAD:
      port-arg-values:
        integer literal NvM_AdminBlockId_37: type=NvM_BlockIdType, value=37
    port-api-option port=PAdmin_NVM_BLOCK_CMS_IGNCNTR:
      port-arg-values:
        integer literal NvM_AdminBlockId_38: type=NvM_BlockIdType, value=38
    port-api-option port=PAdmin_Rte_NvmBlock_StaMd_CloseCheckData:
      port-arg-values:
        integer literal NvM_AdminBlockId_39: type=NvM_BlockIdType, value=39
    port-api-option port=PAdmin_NVM_BLOCK_DIAGMGR_BLACKBOX:
      port-arg-values:
        integer literal NvM_AdminBlockId_40: type=NvM_BlockIdType, value=40
    port-api-option port=PAdmin_Rte_NvmBlock_Ap_AvgFricLrn_AvgFricLrnData:
      port-arg-values:
        integer literal NvM_AdminBlockId_41: type=NvM_BlockIdType, value=41
    port-api-option port=PAdmin_Rte_NvmBlock_BatteryVoltage_OvervoltageData:
      port-arg-values:
        integer literal NvM_AdminBlockId_42: type=NvM_BlockIdType, value=42
    port-api-option port=PAdmin_NVM_BLOCK_DIAGMGR_LATCHCNTRS:
      port-arg-values:
        integer literal NvM_AdminBlockId_43: type=NvM_BlockIdType, value=43
    port-api-option port=PAdmin_NvM_NVM_BLOCK_DEM:
      port-arg-values:
        integer literal NvM_AdminBlockId_44: type=NvM_BlockIdType, value=44
    port-api-option port=PAdmin_Rte_NvmBlock_Ap_TrqCanc_CogTrqRplComp:
      port-arg-values:
        integer literal NvM_AdminBlockId_45: type=NvM_BlockIdType, value=45
    port-api-option port=PAdmin_Rte_NvmBlock_Ap_AstLmt_SteerAsstDefeat:
      port-arg-values:
        integer literal NvM_AdminBlockId_46: type=NvM_BlockIdType, value=46
    port-api-option port=PAdmin_NVM_BLOCK_CMS_ECUHWPN:
      port-arg-values:
        integer literal NvM_AdminBlockId_47: type=NvM_BlockIdType, value=47
    port-api-option port=PAdmin_NVM_BLOCK_SWFINGERPRINT:
      port-arg-values:
        integer literal NvM_AdminBlockId_48: type=NvM_BlockIdType, value=48
    port-api-option port=PAdmin_NVM_BLOCK_RESETRESP:
      port-arg-values:
        integer literal NvM_AdminBlockId_49: type=NvM_BlockIdType, value=49
    port-api-option port=PAdmin_NVM_BLOCK_PROGREQCNT:
      port-arg-values:
        integer literal NvM_AdminBlockId_50: type=NvM_BlockIdType, value=50
    port-api-option port=PAdmin_NVM_BLOCK_SECDLYEN:
      port-arg-values:
        integer literal NvM_AdminBlockId_51: type=NvM_BlockIdType, value=51
    port-api-option port=PAdmin_ConfigBlock:
      port-arg-values:
        integer literal NvM_AdminBlockId_1: type=NvM_BlockIdType, value=1
    7 x runnable, all with can-be-invoked-concurrently=true:
      GetErrorStatus: symbol=NvM_GetErrorStatus
      SetRamBlockStatus: symbol=NvM_SetRamBlockStatus
      ReadBlock: symbol=NvM_ReadBlock
      WriteBlock: symbol=NvM_WriteBlock
      InvalidateNvBlock: symbol=NvM_InvalidateNvBlock
      EraseBlock: symbol=NvM_EraseNvBlock
      SetBlockProtection: symbol=NvM_SetBlockProtection
package /PortInterface
  client server interface NvM_Administration: is-service=true
    operation SetBlockProtection
      arg ProtectionEnabled: type=Boolean, direction=IN
  client server interface NvM_AC3_SRBS_Srv: is-service=true  # NvmService_NvmApiConfigClass3 | Port Interface for NVRAM Blocks of Management Types "NATIVE" or "REDUNDANT" without default values.
    6 x operation:
      GetErrorStatus
        arg ErrorStatus: type=NvM_RequestResultType, direction=OUT
      SetRamBlockStatus
        arg RamBlockStatus: type=Boolean, direction=IN
      ReadBlock: possible-error=E_NOT_OK
        arg DstPtr: type=NvM_DestPtr, direction=OUT
      WriteBlock: possible-error=E_NOT_OK
        arg DstPtr: type=NvM_DestPtr, direction=IN
      EraseBlock: possible-error=E_NOT_OK
      InvalidateNvBlock: possible-error=E_NOT_OK
    error E_NOT_OK: error-code=1
package /DataTypes
  integer type NvM_BlockIdType: lower-limit=1, upper-limit=32767  # It is the type to be used in the "Port Defined Arguments". According to the NVM API it must result in an uint16 data type; thus the upper limit does not correspond to the number of configured blocks. Therefore the this type is common to all NVM SWC Descriptions. The upper limit is the theoretical maximum number of NVRAM blocks, if NVM_DATASET_SELECTION_BITS equals to 1. (It cannot be 0 since block Id 1 is fixed to be a REDUNDANT NVRAM Block - it consists of two NV blocks)
  integer type NvM_RequestResultType: compu {0=NVM_REQ_OK, 1=NVM_REQ_NOT_OK, 2=NVM_REQ_PENDING, 3=NVM_REQ_INTEGRITY_FAILED, 4=NVM_REQ_BLOCK_SKIPPED, 5=NVM_REQ_NV_INVALIDATED}, lower-limit=0, upper-limit=5
  array type NvM_DestPtr  # DataPtr Type to be used by WriteBlock, ReadBlock and RestoreBlockDefaults operations. This type is used for all NVRAM blocks
    element NvM_DestPtr_BaseType: type=UInt8, max-number-of-elements=65535
