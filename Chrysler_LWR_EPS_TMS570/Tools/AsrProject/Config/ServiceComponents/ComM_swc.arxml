AUTOSAR XML (schema 3.0.1)
standard types defined: Boolean, UInt8, UInt16, UInt32
package /ComponentType
  internal behavior ComMInternalBehavior: component=ComM
    timing event Timer_ComM_MainFunction_1300cf42: start-on-event=ComM_MainFunction_0, period=0.02
    32 x operation invoked event:
      OpEventComM_UserRequest_36540e3e: start-on-event=RequestComMode, operation=UR_ComMUser_VN_SLHSSharedDiagnostic_Ch0_0.RequestComMode
      OpEventComM_UserRequest_16ed2913: start-on-event=GetCurrentComMode, operation=UR_ComMUser_VN_SLHSSharedDiagnostic_Ch0_0.GetCurrentComMode
      OpEventComM_UserRequest_939157e8: start-on-event=GetMaxComMode, operation=UR_ComMUser_VN_SLHSSharedDiagnostic_Ch0_0.GetMaxComMode
      OpEventComM_UserRequest_e59a4b16: start-on-event=GetRequestedComMode, operation=UR_ComMUser_VN_SLHSSharedDiagnostic_Ch0_0.GetRequestedComMode
      OpEventComM_UserRequest_358c9684: start-on-event=RequestComMode, operation=UR_ComMUser_VN_AllNodes_Ch0_1.RequestComMode
      OpEventComM_UserRequest_707373d6: start-on-event=GetCurrentComMode, operation=UR_ComMUser_VN_AllNodes_Ch0_1.GetCurrentComMode
      OpEventComM_UserRequest_5a99243c: start-on-event=GetMaxComMode, operation=UR_ComMUser_VN_AllNodes_Ch0_1.GetMaxComMode
      OpEventComM_UserRequest_00eaf03b: start-on-event=GetRequestedComMode, operation=UR_ComMUser_VN_AllNodes_Ch0_1.GetRequestedComMode
      OpEventComM_UserRequest_428ba612: start-on-event=RequestComMode, operation=UR_ComMUser_VN_SLHS_VNReq_Ch0_2.RequestComMode
      OpEventComM_UserRequest_07744340: start-on-event=GetCurrentComMode, operation=UR_ComMUser_VN_SLHS_VNReq_Ch0_2.GetCurrentComMode
      OpEventComM_UserRequest_2d9e14aa: start-on-event=GetMaxComMode, operation=UR_ComMUser_VN_SLHS_VNReq_Ch0_2.GetMaxComMode
      OpEventComM_UserRequest_77edc0ad: start-on-event=GetRequestedComMode, operation=UR_ComMUser_VN_SLHS_VNReq_Ch0_2.GetRequestedComMode
      OpEventComM_UserRequest_db82f7a8: start-on-event=RequestComMode, operation=UR_ComMUser_VN_SLHSSharedDiagnostic_Ch1_3.RequestComMode
      OpEventComM_UserRequest_9e7d12fa: start-on-event=GetCurrentComMode, operation=UR_ComMUser_VN_SLHSSharedDiagnostic_Ch1_3.GetCurrentComMode
      OpEventComM_UserRequest_b4974510: start-on-event=GetMaxComMode, operation=UR_ComMUser_VN_SLHSSharedDiagnostic_Ch1_3.GetMaxComMode
      OpEventComM_UserRequest_eee49117: start-on-event=GetRequestedComMode, operation=UR_ComMUser_VN_SLHSSharedDiagnostic_Ch1_3.GetRequestedComMode
      OpEventComM_UserRequest_ac85c73e: start-on-event=RequestComMode, operation=UR_ComMUser_VN_AllNodes_Ch1_4.RequestComMode
      OpEventComM_UserRequest_e97a226c: start-on-event=GetCurrentComMode, operation=UR_ComMUser_VN_AllNodes_Ch1_4.GetCurrentComMode
      OpEventComM_UserRequest_c3907586: start-on-event=GetMaxComMode, operation=UR_ComMUser_VN_AllNodes_Ch1_4.GetMaxComMode
      OpEventComM_UserRequest_99e3a181: start-on-event=GetRequestedComMode, operation=UR_ComMUser_VN_AllNodes_Ch1_4.GetRequestedComMode
      OpEventComM_UserRequest_32e1529d: start-on-event=RequestComMode, operation=UR_ComMUser_VN_SLHS_VNReq_Ch1_5.RequestComMode
      OpEventComM_UserRequest_771eb7cf: start-on-event=GetCurrentComMode, operation=UR_ComMUser_VN_SLHS_VNReq_Ch1_5.GetCurrentComMode
      OpEventComM_UserRequest_5df4e025: start-on-event=GetMaxComMode, operation=UR_ComMUser_VN_SLHS_VNReq_Ch1_5.GetMaxComMode
      OpEventComM_UserRequest_07873422: start-on-event=GetRequestedComMode, operation=UR_ComMUser_VN_SLHS_VNReq_Ch1_5.GetRequestedComMode
      OpEventComM_ECUModeLimi_dc1297bc: start-on-event=LimitECUToNoComMode, operation=modeLimitation.LimitECUToNoComMode
      OpEventComM_ECUModeLimi_56ef1311: start-on-event=ReadInhibitCounter, operation=modeLimitation.ReadInhibitCounter
      OpEventComM_ECUModeLimi_5b4f977d: start-on-event=ResetInhibitCounter, operation=modeLimitation.ResetInhibitCounter
      OpEventComM_ECUModeLimi_af552dc0: start-on-event=SetECUGroupClassification, operation=modeLimitation.SetECUGroupClassification
      OpEventComM_ChannelLimi_a67f3266: start-on-event=LimitChannelToNoComMode, operation=CL_A_FlexRay.LimitChannelToNoComMode
      OpEventComM_ChannelLimi_af95168d: start-on-event=GetInhibitionStatus, operation=CL_A_FlexRay.GetInhibitionStatus
      OpEventComM_ChannelWake_44599e88: start-on-event=PreventWakeUp, operation=CW_A_FlexRay.PreventWakeUp
      OpEventComM_GetNumSendR_9b5c91e7: start-on-event=GetNumSendRcvAppl, operation=NumSendRcvAppl.GetNumSendRcvAppl
    port-api-options port-api-option={enable-take-address=true, indirect-api=false, port=modeLimitation}, port-api-option={enable-take-address=true, indirect-api=false, port=NumSendRcvAppl}:
      port-api-option enable-take-address=true, indirect-api=false, port=UR_ComMUser_VN_SLHSSharedDiagnostic_Ch0_0:
        port-arg-values:
          integer literal UR_ComMUser_VN_SLHSSharedDiagnostic_Ch0_0: type=ComM_UserHandleType, value=0
      port-api-option enable-take-address=true, indirect-api=false, port=UR_ComMUser_VN_AllNodes_Ch0_1:
        port-arg-values:
          integer literal UR_ComMUser_VN_AllNodes_Ch0_1: type=ComM_UserHandleType, value=1
      port-api-option enable-take-address=true, indirect-api=false, port=UR_ComMUser_VN_SLHS_VNReq_Ch0_2:
        port-arg-values:
          integer literal UR_ComMUser_VN_SLHS_VNReq_Ch0_2: type=ComM_UserHandleType, value=2
      port-api-option enable-take-address=true, indirect-api=false, port=UR_ComMUser_VN_SLHSSharedDiagnostic_Ch1_3:
        port-arg-values:
          integer literal UR_ComMUser_VN_SLHSSharedDiagnostic_Ch1_3: type=ComM_UserHandleType, value=3
      port-api-option enable-take-address=true, indirect-api=false, port=UR_ComMUser_VN_AllNodes_Ch1_4:
        port-arg-values:
          integer literal UR_ComMUser_VN_AllNodes_Ch1_4: type=ComM_UserHandleType, value=4
      port-api-option enable-take-address=true, indirect-api=false, port=UR_ComMUser_VN_SLHS_VNReq_Ch1_5:
        port-arg-values:
          integer literal UR_ComMUser_VN_SLHS_VNReq_Ch1_5: type=ComM_UserHandleType, value=5
      port-api-option enable-take-address=true, indirect-api=false, port=CL_A_FlexRay:
        port-arg-values:
          integer literal CL_A_FlexRay: type=ComM_NetworkHandleType, value=0
      port-api-option enable-take-address=true, indirect-api=false, port=CW_A_FlexRay:
        port-arg-values:
          integer literal CW_A_FlexRay: type=ComM_NetworkHandleType, value=0
    13 x runnable, all with can-be-invoked-concurrently=true:
      ComM_MainFunction_0
      RequestComMode: symbol=ComM_RequestComMode
      GetCurrentComMode: symbol=ComM_GetCurrentComMode
      GetMaxComMode: symbol=ComM_GetMaxComMode
      GetRequestedComMode: symbol=ComM_GetRequestedComMode
      LimitECUToNoComMode: symbol=ComM_LimitECUToNoComMode
      ReadInhibitCounter: symbol=ComM_ReadInhibitCounter
      ResetInhibitCounter: symbol=ComM_ResetInhibitCounter
      SetECUGroupClassification: symbol=ComM_SetECUGroupClassification
      LimitChannelToNoComMode: symbol=ComM_ServiceLimitChannelToNoComMode
      GetInhibitionStatus: symbol=ComM_GetInhibitionStatus
      PreventWakeUp: symbol=ComM_ServicePreventWakeUp
      GetNumSendRcvAppl: symbol=ComM_GetNumSendRcvAppl
  swc implementation ComMImplementation: behavior=ComMInternalBehavior
  service component type ComM: category=ServiceComponent
    10 x provide port:
      UR_ComMUser_VN_SLHSSharedDiagnostic_Ch0_0: provided-interface=ComM_UserRequest
      UR_ComMUser_VN_AllNodes_Ch0_1: provided-interface=ComM_UserRequest
      UR_ComMUser_VN_SLHS_VNReq_Ch0_2: provided-interface=ComM_UserRequest
      UR_ComMUser_VN_SLHSSharedDiagnostic_Ch1_3: provided-interface=ComM_UserRequest
      UR_ComMUser_VN_AllNodes_Ch1_4: provided-interface=ComM_UserRequest
      UR_ComMUser_VN_SLHS_VNReq_Ch1_5: provided-interface=ComM_UserRequest
      modeLimitation: provided-interface=ComM_ECUModeLimitation
      CL_A_FlexRay: provided-interface=ComM_ChannelLimitation
      CW_A_FlexRay: provided-interface=ComM_ChannelWakeUp
      NumSendRcvAppl: provided-interface=ComM_GetNumSendRcvAppl
package /PortInterface
  5 x client server interface, all with is-service=true:
    ComM_UserRequest
      4 x operation:
        RequestComMode: possible-error=[ComM_UserRequest/E_NOT_OK, COMM_E_MODE_LIMITATION]
          arg ComMode: type=ComM_ModeType, direction=IN
        GetCurrentComMode: possible-error=ComM_UserRequest/E_NOT_OK
          arg ComMode: type=ComM_ModeType, direction=OUT
        GetMaxComMode: possible-error=ComM_UserRequest/E_NOT_OK
          arg ComMode: type=ComM_ModeType, direction=OUT
        GetRequestedComMode: possible-error=ComM_UserRequest/E_NOT_OK
          arg ComMode: type=ComM_ModeType, direction=OUT
      error E_NOT_OK: error-code=1
      error COMM_E_MODE_LIMITATION: error-code=2
    ComM_ECUModeLimitation
      4 x operation, all with possible-error=ComM_ECUModeLimitation/E_NOT_OK:
        LimitECUToNoComMode
          arg Status: type=Boolean, direction=IN
        ReadInhibitCounter
          arg CounterValue: type=UInt16, direction=OUT
        ResetInhibitCounter
        SetECUGroupClassification
          arg Status: type=ComM_InhibitionStatusType, direction=IN
      error E_NOT_OK: error-code=1
    ComM_ChannelLimitation
      operation LimitChannelToNoComMode: possible-error=ComM_ChannelLimitation/E_NOT_OK
        arg Status: type=Boolean, direction=IN
      operation GetInhibitionStatus: possible-error=ComM_ChannelLimitation/E_NOT_OK
        arg Status: type=ComM_InhibitionStatusType, direction=OUT
      error E_NOT_OK: error-code=1
    ComM_ChannelWakeUp
      operation PreventWakeUp: possible-error=ComM_ChannelWakeUp/E_NOT_OK
        arg Status: type=Boolean, direction=IN
      error E_NOT_OK: error-code=1
    ComM_GetNumSendRcvAppl
      operation GetNumSendRcvAppl: possible-error=ComM_GetNumSendRcvAppl/E_NOT_OK
        arg sendRcvApplCount: type=UInt8, direction=OUT
      error E_NOT_OK: error-code=1
package /DataType
  integer type ComM_ModeType: compu {0=COMM_NO_COMMUNICATION, 1=COMM_SILENT_COMMUNICATION, 2=COMM_FULL_COMMUNICATION}, lower-limit=0, upper-limit=2
  integer type ComM_UserHandleType: lower-limit=0, upper-limit=255
  integer type ComM_InhibitionStatusType: lower-limit=0, upper-limit=0
  integer type ComM_NetworkHandleType: lower-limit=0, upper-limit=255
  mode declaration group ComMMode: initial-mode=NO_COMMUNICATION
    mode NO_COMMUNICATION
    mode SILENT_COMMUNICATION
    mode FULL_COMMUNICATION
