AUTOSAR XML (schema 3.2.1)
standard types defined: Boolean, UInt8, UInt16, UInt32
package /ComponentType
  internal behavior DemInternalBehavior: component=Dem
    timing event Timer_Dem_MainFunction: start-on-event=Dem_MainFunction, period=0.01
    145 x operation invoked event:
      OpEventDiagnosticMonito_52826b3e: start-on-event=SetEventStatus, operation=Event_TEMPERATURE_TOO_HIGH.SetEventStatus
      OpEventDiagnosticMonito_51c88e60: start-on-event=ResetEventStatus, operation=Event_TEMPERATURE_TOO_HIGH.ResetEventStatus
      OpEventDiagnosticMonito_2d9cd849: start-on-event=GetEventStatus, operation=Event_TEMPERATURE_TOO_HIGH.GetEventStatus
      OpEventDiagnosticMonito_c8171e22: start-on-event=GetEventFailed, operation=Event_TEMPERATURE_TOO_HIGH.GetEventFailed
      OpEventDiagnosticMonito_5e185e41: start-on-event=GetEventTested, operation=Event_TEMPERATURE_TOO_HIGH.GetEventTested
      OpEventDiagnosticMonito_4fdf47e0: start-on-event=GetDTCOfEvent, operation=Event_TEMPERATURE_TOO_HIGH.GetDTCOfEvent
      OpEventDiagnosticMonito_cbd6d252: start-on-event=GetFaultDetectionCounter, operation=Event_TEMPERATURE_TOO_HIGH.GetFaultDetectionCounter
      OpEventDiagnosticMonito_35e840e1: start-on-event=SetEventStatus, operation=Event_SRS_ATTEMPTS_EXCEEDED.SetEventStatus
      OpEventDiagnosticMonito_b93876f7: start-on-event=ResetEventStatus, operation=Event_SRS_ATTEMPTS_EXCEEDED.ResetEventStatus
      OpEventDiagnosticMonito_fbf6bacd: start-on-event=GetEventStatus, operation=Event_SRS_ATTEMPTS_EXCEEDED.GetEventStatus
      OpEventDiagnosticMonito_217389db: start-on-event=GetEventFailed, operation=Event_SRS_ATTEMPTS_EXCEEDED.GetEventFailed
      OpEventDiagnosticMonito_f55eb679: start-on-event=GetEventTested, operation=Event_SRS_ATTEMPTS_EXCEEDED.GetEventTested
      OpEventDiagnosticMonito_549ee21e: start-on-event=GetDTCOfEvent, operation=Event_SRS_ATTEMPTS_EXCEEDED.GetDTCOfEvent
      OpEventDiagnosticMonito_7175392b: start-on-event=GetFaultDetectionCounter, operation=Event_SRS_ATTEMPTS_EXCEEDED.GetFaultDetectionCounter
      OpEventDiagnosticMonito_42ef7077: start-on-event=SetEventStatus, operation=Event_MTR_CIR_ELEC_FAILURE.SetEventStatus
      OpEventDiagnosticMonito_ce3f4661: start-on-event=ResetEventStatus, operation=Event_MTR_CIR_ELEC_FAILURE.ResetEventStatus
      OpEventDiagnosticMonito_8cf18a5b: start-on-event=GetEventStatus, operation=Event_MTR_CIR_ELEC_FAILURE.GetEventStatus
      OpEventDiagnosticMonito_5674b94d: start-on-event=GetEventFailed, operation=Event_MTR_CIR_ELEC_FAILURE.GetEventFailed
      OpEventDiagnosticMonito_825986ef: start-on-event=GetEventTested, operation=Event_MTR_CIR_ELEC_FAILURE.GetEventTested
      OpEventDiagnosticMonito_2399d288: start-on-event=GetDTCOfEvent, operation=Event_MTR_CIR_ELEC_FAILURE.GetDTCOfEvent
      OpEventDiagnosticMonito_067209bd: start-on-event=GetFaultDetectionCounter, operation=Event_MTR_CIR_ELEC_FAILURE.GetFaultDetectionCounter
      OpEventDiagnosticMonito_dbe621cd: start-on-event=SetEventStatus, operation=Event_MTR_CIR_MECH_FAILURE.SetEventStatus
      OpEventDiagnosticMonito_573617db: start-on-event=ResetEventStatus, operation=Event_MTR_CIR_MECH_FAILURE.ResetEventStatus
      OpEventDiagnosticMonito_15f8dbe1: start-on-event=GetEventStatus, operation=Event_MTR_CIR_MECH_FAILURE.GetEventStatus
      OpEventDiagnosticMonito_cf7de8f7: start-on-event=GetEventFailed, operation=Event_MTR_CIR_MECH_FAILURE.GetEventFailed
      OpEventDiagnosticMonito_1b50d755: start-on-event=GetEventTested, operation=Event_MTR_CIR_MECH_FAILURE.GetEventTested
      OpEventDiagnosticMonito_ba908332: start-on-event=GetDTCOfEvent, operation=Event_MTR_CIR_MECH_FAILURE.GetDTCOfEvent
      OpEventDiagnosticMonito_9f7b5807: start-on-event=GetFaultDetectionCounter, operation=Event_MTR_CIR_MECH_FAILURE.GetFaultDetectionCounter
      OpEventDiagnosticMonito_ace1115b: start-on-event=SetEventStatus, operation=Event_TRQ_SEN_ELEC_FAILURE.SetEventStatus
      OpEventDiagnosticMonito_2031274d: start-on-event=ResetEventStatus, operation=Event_TRQ_SEN_ELEC_FAILURE.ResetEventStatus
      OpEventDiagnosticMonito_62ffeb77: start-on-event=GetEventStatus, operation=Event_TRQ_SEN_ELEC_FAILURE.GetEventStatus
      OpEventDiagnosticMonito_b87ad861: start-on-event=GetEventFailed, operation=Event_TRQ_SEN_ELEC_FAILURE.GetEventFailed
      OpEventDiagnosticMonito_6c57e7c3: start-on-event=GetEventTested, operation=Event_TRQ_SEN_ELEC_FAILURE.GetEventTested
      OpEventDiagnosticMonito_cd97b3a4: start-on-event=GetDTCOfEvent, operation=Event_TRQ_SEN_ELEC_FAILURE.GetDTCOfEvent
      OpEventDiagnosticMonito_e87c6891: start-on-event=GetFaultDetectionCounter, operation=Event_TRQ_SEN_ELEC_FAILURE.GetFaultDetectionCounter
      OpEventDiagnosticMonito_328584f8: start-on-event=SetEventStatus, operation=Event_TRQ_SEN_CAL_NOT_LEARNED.SetEventStatus
      OpEventDiagnosticMonito_be55b2ee: start-on-event=ResetEventStatus, operation=Event_TRQ_SEN_CAL_NOT_LEARNED.ResetEventStatus
      OpEventDiagnosticMonito_fc9b7ed4: start-on-event=GetEventStatus, operation=Event_TRQ_SEN_CAL_NOT_LEARNED.GetEventStatus
      OpEventDiagnosticMonito_261e4dc2: start-on-event=GetEventFailed, operation=Event_TRQ_SEN_CAL_NOT_LEARNED.GetEventFailed
      OpEventDiagnosticMonito_f2337260: start-on-event=GetEventTested, operation=Event_TRQ_SEN_CAL_NOT_LEARNED.GetEventTested
      OpEventDiagnosticMonito_53f32607: start-on-event=GetDTCOfEvent, operation=Event_TRQ_SEN_CAL_NOT_LEARNED.GetDTCOfEvent
      OpEventDiagnosticMonito_7618fd32: start-on-event=GetFaultDetectionCounter, operation=Event_TRQ_SEN_CAL_NOT_LEARNED.GetFaultDetectionCounter
      OpEventDiagnosticMonito_4582b46e: start-on-event=SetEventStatus, operation=Event_ECU_INTERNAL_FAILURE.SetEventStatus
      OpEventDiagnosticMonito_c9528278: start-on-event=ResetEventStatus, operation=Event_ECU_INTERNAL_FAILURE.ResetEventStatus
      OpEventDiagnosticMonito_8b9c4e42: start-on-event=GetEventStatus, operation=Event_ECU_INTERNAL_FAILURE.GetEventStatus
      OpEventDiagnosticMonito_51197d54: start-on-event=GetEventFailed, operation=Event_ECU_INTERNAL_FAILURE.GetEventFailed
      OpEventDiagnosticMonito_853442f6: start-on-event=GetEventTested, operation=Event_ECU_INTERNAL_FAILURE.GetEventTested
      OpEventDiagnosticMonito_24f41691: start-on-event=GetDTCOfEvent, operation=Event_ECU_INTERNAL_FAILURE.GetDTCOfEvent
      OpEventDiagnosticMonito_011fcda4: start-on-event=GetFaultDetectionCounter, operation=Event_ECU_INTERNAL_FAILURE.GetFaultDetectionCounter
      OpEventDiagnosticMonito_dc8be5d4: start-on-event=SetEventStatus, operation=Event_ECU_INCORRECT_COMP.SetEventStatus
      OpEventDiagnosticMonito_505bd3c2: start-on-event=ResetEventStatus, operation=Event_ECU_INCORRECT_COMP.ResetEventStatus
      OpEventDiagnosticMonito_12951ff8: start-on-event=GetEventStatus, operation=Event_ECU_INCORRECT_COMP.GetEventStatus
      OpEventDiagnosticMonito_c8102cee: start-on-event=GetEventFailed, operation=Event_ECU_INCORRECT_COMP.GetEventFailed
      OpEventDiagnosticMonito_1c3d134c: start-on-event=GetEventTested, operation=Event_ECU_INCORRECT_COMP.GetEventTested
      OpEventDiagnosticMonito_bdfd472b: start-on-event=GetDTCOfEvent, operation=Event_ECU_INCORRECT_COMP.GetDTCOfEvent
      OpEventDiagnosticMonito_98169c1e: start-on-event=GetFaultDetectionCounter, operation=Event_ECU_INCORRECT_COMP.GetFaultDetectionCounter
      OpEventDiagnosticMonito_ab8cd542: start-on-event=SetEventStatus, operation=Event_ECU_NO_VEH_CONFIG.SetEventStatus
      OpEventDiagnosticMonito_275ce354: start-on-event=ResetEventStatus, operation=Event_ECU_NO_VEH_CONFIG.ResetEventStatus
      OpEventDiagnosticMonito_65922f6e: start-on-event=GetEventStatus, operation=Event_ECU_NO_VEH_CONFIG.GetEventStatus
      OpEventDiagnosticMonito_bf171c78: start-on-event=GetEventFailed, operation=Event_ECU_NO_VEH_CONFIG.GetEventFailed
      OpEventDiagnosticMonito_6b3a23da: start-on-event=GetEventTested, operation=Event_ECU_NO_VEH_CONFIG.GetEventTested
      OpEventDiagnosticMonito_cafa77bd: start-on-event=GetDTCOfEvent, operation=Event_ECU_NO_VEH_CONFIG.GetDTCOfEvent
      OpEventDiagnosticMonito_ef11ac88: start-on-event=GetFaultDetectionCounter, operation=Event_ECU_NO_VEH_CONFIG.GetFaultDetectionCounter
      OpEventDiagnosticMonito_3b33c8d3: start-on-event=SetEventStatus, operation=Event_EEPROM_ERROR.SetEventStatus
      OpEventDiagnosticMonito_b7e3fec5: start-on-event=ResetEventStatus, operation=Event_EEPROM_ERROR.ResetEventStatus
      OpEventDiagnosticMonito_f52d32ff: start-on-event=GetEventStatus, operation=Event_EEPROM_ERROR.GetEventStatus
      OpEventDiagnosticMonito_2fa801e9: start-on-event=GetEventFailed, operation=Event_EEPROM_ERROR.GetEventFailed
      OpEventDiagnosticMonito_fb853e4b: start-on-event=GetEventTested, operation=Event_EEPROM_ERROR.GetEventTested
      OpEventDiagnosticMonito_5a456a2c: start-on-event=GetDTCOfEvent, operation=Event_EEPROM_ERROR.GetDTCOfEvent
      OpEventDiagnosticMonito_7faeb119: start-on-event=GetFaultDetectionCounter, operation=Event_EEPROM_ERROR.GetFaultDetectionCounter
      OpEventDiagnosticMonito_4c34f845: start-on-event=SetEventStatus, operation=Event_COMM_ENABLE_FAILURE.SetEventStatus
      OpEventDiagnosticMonito_c0e4ce53: start-on-event=ResetEventStatus, operation=Event_COMM_ENABLE_FAILURE.ResetEventStatus
      OpEventDiagnosticMonito_822a0269: start-on-event=GetEventStatus, operation=Event_COMM_ENABLE_FAILURE.GetEventStatus
      OpEventDiagnosticMonito_58af317f: start-on-event=GetEventFailed, operation=Event_COMM_ENABLE_FAILURE.GetEventFailed
      OpEventDiagnosticMonito_8c820edd: start-on-event=GetEventTested, operation=Event_COMM_ENABLE_FAILURE.GetEventTested
      OpEventDiagnosticMonito_2d425aba: start-on-event=GetDTCOfEvent, operation=Event_COMM_ENABLE_FAILURE.GetDTCOfEvent
      OpEventDiagnosticMonito_08a9818f: start-on-event=GetFaultDetectionCounter, operation=Event_COMM_ENABLE_FAILURE.GetFaultDetectionCounter
      OpEventDiagnosticMonito_3af8d4ce: start-on-event=SetEventStatus, operation=Event_HIGH_VOLTAGE.SetEventStatus
      OpEventDiagnosticMonito_cea0b1a9: start-on-event=ResetEventStatus, operation=Event_HIGH_VOLTAGE.ResetEventStatus
      OpEventDiagnosticMonito_08eea6d7: start-on-event=GetEventStatus, operation=Event_HIGH_VOLTAGE.GetEventStatus
      OpEventDiagnosticMonito_fce096b5: start-on-event=GetEventFailed, operation=Event_HIGH_VOLTAGE.GetEventFailed
      OpEventDiagnosticMonito_c4ec794e: start-on-event=GetEventTested, operation=Event_HIGH_VOLTAGE.GetEventTested
      OpEventDiagnosticMonito_179b4de1: start-on-event=GetDTCOfEvent, operation=Event_HIGH_VOLTAGE.GetDTCOfEvent
      OpEventDiagnosticMonito_410d6219: start-on-event=GetFaultDetectionCounter, operation=Event_HIGH_VOLTAGE.GetFaultDetectionCounter
      OpEventDiagnosticMonito_4dffe458: start-on-event=SetEventStatus, operation=Event_LOW_VOLTAGE.SetEventStatus
      OpEventDiagnosticMonito_b9a7813f: start-on-event=ResetEventStatus, operation=Event_LOW_VOLTAGE.ResetEventStatus
      OpEventDiagnosticMonito_7fe99641: start-on-event=GetEventStatus, operation=Event_LOW_VOLTAGE.GetEventStatus
      OpEventDiagnosticMonito_8be7a623: start-on-event=GetEventFailed, operation=Event_LOW_VOLTAGE.GetEventFailed
      OpEventDiagnosticMonito_b3eb49d8: start-on-event=GetEventTested, operation=Event_LOW_VOLTAGE.GetEventTested
      OpEventDiagnosticMonito_609c7d77: start-on-event=GetDTCOfEvent, operation=Event_LOW_VOLTAGE.GetDTCOfEvent
      OpEventDiagnosticMonito_360a528f: start-on-event=GetFaultDetectionCounter, operation=Event_LOW_VOLTAGE.GetFaultDetectionCounter
      OpEventDiagnosticMonito_d4f6b5e2: start-on-event=SetEventStatus, operation=Event_BUS_OFF.SetEventStatus
      OpEventDiagnosticMonito_20aed085: start-on-event=ResetEventStatus, operation=Event_BUS_OFF.ResetEventStatus
      OpEventDiagnosticMonito_e6e0c7fb: start-on-event=GetEventStatus, operation=Event_BUS_OFF.GetEventStatus
      OpEventDiagnosticMonito_12eef799: start-on-event=GetEventFailed, operation=Event_BUS_OFF.GetEventFailed
      OpEventDiagnosticMonito_2ae21862: start-on-event=GetEventTested, operation=Event_BUS_OFF.GetEventTested
      OpEventDiagnosticMonito_f9952ccd: start-on-event=GetDTCOfEvent, operation=Event_BUS_OFF.GetDTCOfEvent
      OpEventDiagnosticMonito_af030335: start-on-event=GetFaultDetectionCounter, operation=Event_BUS_OFF.GetFaultDetectionCounter
      OpEventDiagnosticMonito_a3f18574: start-on-event=SetEventStatus, operation=Event_ECM_MISSING_MSG.SetEventStatus
      OpEventDiagnosticMonito_57a9e013: start-on-event=ResetEventStatus, operation=Event_ECM_MISSING_MSG.ResetEventStatus
      OpEventDiagnosticMonito_91e7f76d: start-on-event=GetEventStatus, operation=Event_ECM_MISSING_MSG.GetEventStatus
      OpEventDiagnosticMonito_65e9c70f: start-on-event=GetEventFailed, operation=Event_ECM_MISSING_MSG.GetEventFailed
      OpEventDiagnosticMonito_5de528f4: start-on-event=GetEventTested, operation=Event_ECM_MISSING_MSG.GetEventTested
      OpEventDiagnosticMonito_8e921c5b: start-on-event=GetDTCOfEvent, operation=Event_ECM_MISSING_MSG.GetDTCOfEvent
      OpEventDiagnosticMonito_d80433a3: start-on-event=GetFaultDetectionCounter, operation=Event_ECM_MISSING_MSG.GetFaultDetectionCounter
      OpEventDiagnosticMonito_3d9510d7: start-on-event=SetEventStatus, operation=Event_ECM_INVALID_DATA.SetEventStatus
      OpEventDiagnosticMonito_c9cd75b0: start-on-event=ResetEventStatus, operation=Event_ECM_INVALID_DATA.ResetEventStatus
      OpEventDiagnosticMonito_0f8362ce: start-on-event=GetEventStatus, operation=Event_ECM_INVALID_DATA.GetEventStatus
      OpEventDiagnosticMonito_fb8d52ac: start-on-event=GetEventFailed, operation=Event_ECM_INVALID_DATA.GetEventFailed
      OpEventDiagnosticMonito_c381bd57: start-on-event=GetEventTested, operation=Event_ECM_INVALID_DATA.GetEventTested
      OpEventDiagnosticMonito_10f689f8: start-on-event=GetDTCOfEvent, operation=Event_ECM_INVALID_DATA.GetDTCOfEvent
      OpEventDiagnosticMonito_4660a600: start-on-event=GetFaultDetectionCounter, operation=Event_ECM_INVALID_DATA.GetFaultDetectionCounter
      OpEventDiagnosticMonito_4a922041: start-on-event=SetEventStatus, operation=Event_EBCM_MISSING_MSG.SetEventStatus
      OpEventDiagnosticMonito_beca4526: start-on-event=ResetEventStatus, operation=Event_EBCM_MISSING_MSG.ResetEventStatus
      OpEventDiagnosticMonito_78845258: start-on-event=GetEventStatus, operation=Event_EBCM_MISSING_MSG.GetEventStatus
      OpEventDiagnosticMonito_8c8a623a: start-on-event=GetEventFailed, operation=Event_EBCM_MISSING_MSG.GetEventFailed
      OpEventDiagnosticMonito_b4868dc1: start-on-event=GetEventTested, operation=Event_EBCM_MISSING_MSG.GetEventTested
      OpEventDiagnosticMonito_67f1b96e: start-on-event=GetDTCOfEvent, operation=Event_EBCM_MISSING_MSG.GetDTCOfEvent
      OpEventDiagnosticMonito_31679696: start-on-event=GetFaultDetectionCounter, operation=Event_EBCM_MISSING_MSG.GetFaultDetectionCounter
      OpEventDiagnosticMonito_d39b71fb: start-on-event=SetEventStatus, operation=Event_EBCM_INVALID_DATA.SetEventStatus
      OpEventDiagnosticMonito_27c3149c: start-on-event=ResetEventStatus, operation=Event_EBCM_INVALID_DATA.ResetEventStatus
      OpEventDiagnosticMonito_e18d03e2: start-on-event=GetEventStatus, operation=Event_EBCM_INVALID_DATA.GetEventStatus
      OpEventDiagnosticMonito_15833380: start-on-event=GetEventFailed, operation=Event_EBCM_INVALID_DATA.GetEventFailed
      OpEventDiagnosticMonito_2d8fdc7b: start-on-event=GetEventTested, operation=Event_EBCM_INVALID_DATA.GetEventTested
      OpEventDiagnosticMonito_fef8e8d4: start-on-event=GetDTCOfEvent, operation=Event_EBCM_INVALID_DATA.GetDTCOfEvent
      OpEventDiagnosticMonito_a86ec72c: start-on-event=GetFaultDetectionCounter, operation=Event_EBCM_INVALID_DATA.GetFaultDetectionCounter
      OpEventDiagnosticMonito_a49c416d: start-on-event=SetEventStatus, operation=Event_STR_WHL_ANG_MISSING_MSG.SetEventStatus
      OpEventDiagnosticMonito_50c4240a: start-on-event=ResetEventStatus, operation=Event_STR_WHL_ANG_MISSING_MSG.ResetEventStatus
      OpEventDiagnosticMonito_968a3374: start-on-event=GetEventStatus, operation=Event_STR_WHL_ANG_MISSING_MSG.GetEventStatus
      OpEventDiagnosticMonito_62840316: start-on-event=GetEventFailed, operation=Event_STR_WHL_ANG_MISSING_MSG.GetEventFailed
      OpEventDiagnosticMonito_5a88eced: start-on-event=GetEventTested, operation=Event_STR_WHL_ANG_MISSING_MSG.GetEventTested
      OpEventDiagnosticMonito_89ffd842: start-on-event=GetDTCOfEvent, operation=Event_STR_WHL_ANG_MISSING_MSG.GetDTCOfEvent
      OpEventDiagnosticMonito_df69f7ba: start-on-event=GetFaultDetectionCounter, operation=Event_STR_WHL_ANG_MISSING_MSG.GetFaultDetectionCounter
      OpEventDiagnosticMonito_34235cfc: start-on-event=SetEventStatus, operation=Event_BCM_MISSING_MSG.SetEventStatus
      OpEventDiagnosticMonito_c07b399b: start-on-event=ResetEventStatus, operation=Event_BCM_MISSING_MSG.ResetEventStatus
      OpEventDiagnosticMonito_06352ee5: start-on-event=GetEventStatus, operation=Event_BCM_MISSING_MSG.GetEventStatus
      OpEventDiagnosticMonito_f23b1e87: start-on-event=GetEventFailed, operation=Event_BCM_MISSING_MSG.GetEventFailed
      OpEventDiagnosticMonito_ca37f17c: start-on-event=GetEventTested, operation=Event_BCM_MISSING_MSG.GetEventTested
      OpEventDiagnosticMonito_1940c5d3: start-on-event=GetDTCOfEvent, operation=Event_BCM_MISSING_MSG.GetDTCOfEvent
      OpEventDiagnosticMonito_4fd6ea2b: start-on-event=GetFaultDetectionCounter, operation=Event_BCM_MISSING_MSG.GetFaultDetectionCounter
      OpEventOperationCycleSe_d13956d3: start-on-event=SetOperationCycleState, operation=OpCycle_DEM_IGNITION.SetOperationCycleState
      OpEventOperationCycleSe_ebd06519: start-on-event=SetOperationCycleState, operation=OpCycle_DEM_OBD_DCY.SetOperationCycleState
      OpEventOperationCycleSe_9cd7558f: start-on-event=SetOperationCycleState, operation=OpCycle_DEM_POWER.SetOperationCycleState
      OpEventOperationCycleSe_05de0435: start-on-event=SetOperationCycleState, operation=OpCycle_DEM_WARMUP.SetOperationCycleState
      OpEventIndicatorStatusG_1495fc2f: start-on-event=GetIndicatorStatus, operation=IndStatus_Warning_Indicator.GetIndicatorStatus
    port-api-option enable-take-address=true, indirect-api=false, port=Event_TEMPERATURE_TOO_HIGH:
      port-arg-values:
        integer literal Event_TEMPERATURE_TOO_HIGH: type=Dem_EventIdType, value=20
    port-api-option enable-take-address=true, indirect-api=false, port=Event_SRS_ATTEMPTS_EXCEEDED:
      port-arg-values:
        integer literal Event_SRS_ATTEMPTS_EXCEEDED: type=Dem_EventIdType, value=19
    port-api-option enable-take-address=true, indirect-api=false, port=Event_MTR_CIR_ELEC_FAILURE:
      port-arg-values:
        integer literal Event_MTR_CIR_ELEC_FAILURE: type=Dem_EventIdType, value=18
    port-api-option enable-take-address=true, indirect-api=false, port=Event_MTR_CIR_MECH_FAILURE:
      port-arg-values:
        integer literal Event_MTR_CIR_MECH_FAILURE: type=Dem_EventIdType, value=17
    port-api-option enable-take-address=true, indirect-api=false, port=Event_TRQ_SEN_ELEC_FAILURE:
      port-arg-values:
        integer literal Event_TRQ_SEN_ELEC_FAILURE: type=Dem_EventIdType, value=16
    port-api-option enable-take-address=true, indirect-api=false, port=Event_TRQ_SEN_CAL_NOT_LEARNED:
      port-arg-values:
        integer literal Event_TRQ_SEN_CAL_NOT_LEARNED: type=Dem_EventIdType, value=15
    port-api-option enable-take-address=true, indirect-api=false, port=Event_ECU_INTERNAL_FAILURE:
      port-arg-values:
        integer literal Event_ECU_INTERNAL_FAILURE: type=Dem_EventIdType, value=13
    port-api-option enable-take-address=true, indirect-api=false, port=Event_ECU_INCORRECT_COMP:
      port-arg-values:
        integer literal Event_ECU_INCORRECT_COMP: type=Dem_EventIdType, value=12
    port-api-option enable-take-address=true, indirect-api=false, port=Event_ECU_NO_VEH_CONFIG:
      port-arg-values:
        integer literal Event_ECU_NO_VEH_CONFIG: type=Dem_EventIdType, value=11
    port-api-option enable-take-address=true, indirect-api=false, port=Event_EEPROM_ERROR:
      port-arg-values:
        integer literal Event_EEPROM_ERROR: type=Dem_EventIdType, value=14
    port-api-option enable-take-address=true, indirect-api=false, port=Event_COMM_ENABLE_FAILURE:
      port-arg-values:
        integer literal Event_COMM_ENABLE_FAILURE: type=Dem_EventIdType, value=1
    port-api-option enable-take-address=true, indirect-api=false, port=Event_HIGH_VOLTAGE:
      port-arg-values:
        integer literal Event_HIGH_VOLTAGE: type=Dem_EventIdType, value=10
    port-api-option enable-take-address=true, indirect-api=false, port=Event_LOW_VOLTAGE:
      port-arg-values:
        integer literal Event_LOW_VOLTAGE: type=Dem_EventIdType, value=9
    port-api-option enable-take-address=true, indirect-api=false, port=Event_BUS_OFF:
      port-arg-values:
        integer literal Event_BUS_OFF: type=Dem_EventIdType, value=8
    port-api-option enable-take-address=true, indirect-api=false, port=Event_ECM_MISSING_MSG:
      port-arg-values:
        integer literal Event_ECM_MISSING_MSG: type=Dem_EventIdType, value=7
    port-api-option enable-take-address=true, indirect-api=false, port=Event_ECM_INVALID_DATA:
      port-arg-values:
        integer literal Event_ECM_INVALID_DATA: type=Dem_EventIdType, value=6
    port-api-option enable-take-address=true, indirect-api=false, port=Event_EBCM_MISSING_MSG:
      port-arg-values:
        integer literal Event_EBCM_MISSING_MSG: type=Dem_EventIdType, value=5
    port-api-option enable-take-address=true, indirect-api=false, port=Event_EBCM_INVALID_DATA:
      port-arg-values:
        integer literal Event_EBCM_INVALID_DATA: type=Dem_EventIdType, value=4
    port-api-option enable-take-address=true, indirect-api=false, port=Event_STR_WHL_ANG_MISSING_MSG:
      port-arg-values:
        integer literal Event_STR_WHL_ANG_MISSING_MSG: type=Dem_EventIdType, value=3
    port-api-option enable-take-address=true, indirect-api=false, port=Event_BCM_MISSING_MSG:
      port-arg-values:
        integer literal Event_BCM_MISSING_MSG: type=Dem_EventIdType, value=2
    port-api-option enable-take-address=true, indirect-api=false, port=OpCycle_DEM_IGNITION:
      port-arg-values:
        integer literal OpCycle_DEM_IGNITION: type=Dem_OperationCycleIdType, value=0
    port-api-option enable-take-address=true, indirect-api=false, port=OpCycle_DEM_OBD_DCY:
      port-arg-values:
        integer literal OpCycle_DEM_OBD_DCY: type=Dem_OperationCycleIdType, value=1
    port-api-option enable-take-address=true, indirect-api=false, port=OpCycle_DEM_POWER:
      port-arg-values:
        integer literal OpCycle_DEM_POWER: type=Dem_OperationCycleIdType, value=3
    port-api-option enable-take-address=true, indirect-api=false, port=OpCycle_DEM_WARMUP:
      port-arg-values:
        integer literal OpCycle_DEM_WARMUP: type=Dem_OperationCycleIdType, value=2
    port-api-option enable-take-address=true, indirect-api=false, port=IndStatus_Warning_Indicator:
      port-arg-values:
        integer literal IndStatus_Warning_Indicator: type=UInt8, value=0
    10 x runnable:
      Dem_MainFunction
      SetEventStatus: can-be-invoked-concurrently=true, symbol=Dem_SetEventStatus
      ResetEventStatus: can-be-invoked-concurrently=true, symbol=Dem_ResetEventStatus
      GetEventStatus: can-be-invoked-concurrently=true, symbol=Dem_GetEventStatus
      GetEventFailed: can-be-invoked-concurrently=true, symbol=Dem_GetEventFailed
      GetEventTested: can-be-invoked-concurrently=true, symbol=Dem_GetEventTested
      GetDTCOfEvent: can-be-invoked-concurrently=true, symbol=Dem_GetDTCOfEvent
      GetFaultDetectionCounter: can-be-invoked-concurrently=true, symbol=Dem_GetFaultDetectionCounter
      SetOperationCycleState: can-be-invoked-concurrently=true, symbol=Dem_SetOperationCycleState
      GetIndicatorStatus: can-be-invoked-concurrently=true, symbol=Dem_GetIndicatorStatus
  swc implementation DemImplementation: behavior=DemInternalBehavior
  service component type Dem: category=ServiceComponent
    25 x provide port:
      Event_TEMPERATURE_TOO_HIGH: provided-interface=DiagnosticMonitor
      Event_SRS_ATTEMPTS_EXCEEDED: provided-interface=DiagnosticMonitor
      Event_MTR_CIR_ELEC_FAILURE: provided-interface=DiagnosticMonitor
      Event_MTR_CIR_MECH_FAILURE: provided-interface=DiagnosticMonitor
      Event_TRQ_SEN_ELEC_FAILURE: provided-interface=DiagnosticMonitor
      Event_TRQ_SEN_CAL_NOT_LEARNED: provided-interface=DiagnosticMonitor
      Event_ECU_INTERNAL_FAILURE: provided-interface=DiagnosticMonitor
      Event_ECU_INCORRECT_COMP: provided-interface=DiagnosticMonitor
      Event_ECU_NO_VEH_CONFIG: provided-interface=DiagnosticMonitor
      Event_EEPROM_ERROR: provided-interface=DiagnosticMonitor
      Event_COMM_ENABLE_FAILURE: provided-interface=DiagnosticMonitor
      Event_HIGH_VOLTAGE: provided-interface=DiagnosticMonitor
      Event_LOW_VOLTAGE: provided-interface=DiagnosticMonitor
      Event_BUS_OFF: provided-interface=DiagnosticMonitor
      Event_ECM_MISSING_MSG: provided-interface=DiagnosticMonitor
      Event_ECM_INVALID_DATA: provided-interface=DiagnosticMonitor
      Event_EBCM_MISSING_MSG: provided-interface=DiagnosticMonitor
      Event_EBCM_INVALID_DATA: provided-interface=DiagnosticMonitor
      Event_STR_WHL_ANG_MISSING_MSG: provided-interface=DiagnosticMonitor
      Event_BCM_MISSING_MSG: provided-interface=DiagnosticMonitor
      OpCycle_DEM_IGNITION: provided-interface=OperationCycle
      OpCycle_DEM_OBD_DCY: provided-interface=OperationCycle
      OpCycle_DEM_POWER: provided-interface=OperationCycle
      OpCycle_DEM_WARMUP: provided-interface=OperationCycle
      IndStatus_Warning_Indicator: provided-interface=IndicatorStatus
package /PortInterface
  client server interface DiagnosticMonitor: is-service=true
    7 x operation:
      SetEventStatus: possible-error=[DiagnosticMonitor/E_NOT_OK, DiagnosticMonitor/DEM_E_QUEUE_OVERFLOW]
        arg EventStatus: type=Dem_EventStatusType, direction=IN
      ResetEventStatus: possible-error=[DiagnosticMonitor/E_NOT_OK, DiagnosticMonitor/DEM_E_QUEUE_OVERFLOW]
      GetEventStatus: possible-error=DiagnosticMonitor/E_NOT_OK
        arg EventStatus: type=Dem_EventStatusExtendedType, direction=OUT
      GetEventFailed: possible-error=DiagnosticMonitor/E_NOT_OK
        arg Failed: type=Boolean, direction=OUT
      GetEventTested: possible-error=DiagnosticMonitor/E_NOT_OK
        arg Failed: type=Boolean, direction=OUT
      GetDTCOfEvent: possible-error=[DiagnosticMonitor/E_NOT_OK, DEM_GET_DTCOFEVENT_WRONG_DTCKIND, DEM_GET_DTCOFEVENT_WRONG_EVENTID]
        arg DTCKind: type=Dem_DTCKindType, direction=IN
        arg DTC: type=Dem_DTCType, direction=OUT
      GetFaultDetectionCounter: possible-error=DiagnosticMonitor/E_NOT_OK
        arg EventIdFaultDetectionCounter: type=Dem_FaultDetectionCounterType, direction=OUT
    4 x error:
      E_NOT_OK: error-code=1
      DEM_GET_DTCOFEVENT_WRONG_DTCKIND: error-code=4
      DEM_GET_DTCOFEVENT_WRONG_EVENTID: error-code=5
      DEM_E_QUEUE_OVERFLOW: error-code=15
  client server interface OperationCycle: is-service=true
    operation SetOperationCycleState: possible-error=[OperationCycle/E_NOT_OK, OperationCycle/DEM_E_QUEUE_OVERFLOW]
      arg CycleState: type=Dem_OperationCycleStateType, direction=IN
    error E_NOT_OK: error-code=1
    error DEM_E_QUEUE_OVERFLOW: error-code=15
  client server interface IndicatorStatus: is-service=true
    operation GetIndicatorStatus: possible-error=IndicatorStatus/E_NOT_OK
      arg IndicatorStatus: type=Dem_IndicatorStatusType, direction=OUT
    error E_NOT_OK: error-code=1
package /DataType
  integer type Dem_EventIdType: lower-limit=0, upper-limit=255
  integer type Dem_EventStatusType: compu {0=DEM_EVENT_STATUS_PASSED, 1=DEM_EVENT_STATUS_FAILED, 2=DEM_EVENT_STATUS_PREPASSED, 3=DEM_EVENT_STATUS_PREFAILED}, lower-limit=0, upper-limit=255
  integer type Dem_EventStatusExtendedType: lower-limit=0, upper-limit=255
  integer type Dem_DTCKindType: compu {1=DEM_DTC_KIND_ALL_DTCS, 2=DEM_DTC_KIND_EMISSION_REL_DTCS}, lower-limit=1, upper-limit=2
  integer type Dem_DTCType: lower-limit=0, upper-limit=4294967295
  integer type Dem_InitMonitorKindType: compu {1=DEM_INIT_MONITOR_CLEAR, 2=DEM_INIT_MONITOR_RESTART}, lower-limit=0, upper-limit=2
  integer type Dem_DTCStatusMaskType: lower-limit=0, upper-limit=255
  integer type Dem_OperationCycleIdType: lower-limit=0, upper-limit=255
  integer type Dem_OperationCycleStateType: compu {1=DEM_CYCLE_STATE_START, 2=DEM_CYCLE_STATE_END}, lower-limit=1, upper-limit=2
  integer type Dem_IndicatorStatusType: compu {0=DEM_INDICATOR_OFF, 1=DEM_INDICATOR_CONTINUOUS, 2=DEM_INDICATOR_BLINKING, 3=DEM_INDICATOR_BLINK_CONT}, lower-limit=0, upper-limit=3
  integer type Dem_FaultDetectionCounterType: lower-limit=-128, upper-limit=127
  array type Dem_MaxDataValueType
    element Dem_MaxDataValueType: type=UInt8, max-number-of-elements=1
  array type Dem_MaxExtendedDataRecordType
    element Dem_MaxExtendedDataRecordType: type=UInt8, max-number-of-elements=1
  integer type Dem_SuppressDTCStatusType: compu {0=DEM_SUPPRESS_DTC_OFF, 1=DEM_SUPPRESS_DTC_ON}, lower-limit=0, upper-limit=1
