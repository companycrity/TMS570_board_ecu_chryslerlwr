AUTOSAR XML (schema 321)
standard types defined: Boolean, UInt8
package /ComponentType
  internal behavior NvMProxy_InternalBehavior: component=NvMProxy
    42 x operation invoked event:
      OIT_GetErrorStatus_PS_NvMP_NvmBlock_MtrPosSnsr_EOLData_GetErrorStatus: start-on-event=GetErrorStatus, operation=PS_NvMP_NvmBlock_MtrPosSnsr_EOLData.GetErrorStatus
      OIT_WriteBlock_PS_NvMP_NvmBlock_MtrPosSnsr_EOLData_WriteBlock: start-on-event=WriteBlock, operation=PS_NvMP_NvmBlock_MtrPosSnsr_EOLData.WriteBlock
      OIT_SetRamBlockStatus_PS_NvMP_NvmBlock_MtrPosSnsr_EOLData_SetRamBlockStatus: start-on-event=SetRamBlockStatus, operation=PS_NvMP_NvmBlock_MtrPosSnsr_EOLData.SetRamBlockStatus
      OIT_GetErrorStatus_PS_NvMP_NvmBlock_ShCurrCal_GetErrorStatus: start-on-event=GetErrorStatus, operation=PS_NvMP_NvmBlock_ShCurrCal.GetErrorStatus
      OIT_WriteBlock_PS_NvMP_NvmBlock_ShCurrCal_WriteBlock: start-on-event=WriteBlock, operation=PS_NvMP_NvmBlock_ShCurrCal.WriteBlock
      OIT_SetRamBlockStatus_PS_NvMP_NvmBlock_ShCurrCal_SetRamBlockStatus: start-on-event=SetRamBlockStatus, operation=PS_NvMP_NvmBlock_ShCurrCal.SetRamBlockStatus
      OIT_GetErrorStatus_PS_NvMP_NvmBlock_HwTrqScaleData_GetErrorStatus: start-on-event=GetErrorStatus, operation=PS_NvMP_NvmBlock_HwTrqScaleData.GetErrorStatus
      OIT_WriteBlock_PS_NvMP_NvmBlock_HwTrqScaleData_WriteBlock: start-on-event=WriteBlock, operation=PS_NvMP_NvmBlock_HwTrqScaleData.WriteBlock
      OIT_SetRamBlockStatus_PS_NvMP_NvmBlock_HwTrqScaleData_SetRamBlockStatus: start-on-event=SetRamBlockStatus, operation=PS_NvMP_NvmBlock_HwTrqScaleData.SetRamBlockStatus
      OIT_GetErrorStatus_PS_NvMP_NvmBlock_HwTrqTrimData_GetErrorStatus: start-on-event=GetErrorStatus, operation=PS_NvMP_NvmBlock_HwTrqTrimData.GetErrorStatus
      OIT_WriteBlock_PS_NvMP_NvmBlock_HwTrqTrimData_WriteBlock: start-on-event=WriteBlock, operation=PS_NvMP_NvmBlock_HwTrqTrimData.WriteBlock
      OIT_SetRamBlockStatus_PS_NvMP_NvmBlock_HwTrqTrimData_SetRamBlockStatus: start-on-event=SetRamBlockStatus, operation=PS_NvMP_NvmBlock_HwTrqTrimData.SetRamBlockStatus
      OIT_GetErrorStatus_PS_NvMP_NvmBlock_EOLTrqStepData_GetErrorStatus: start-on-event=GetErrorStatus, operation=PS_NvMP_NvmBlock_EOLTrqStepData.GetErrorStatus
      OIT_WriteBlock_PS_NvMP_NvmBlock_EOLTrqStepData_WriteBlock: start-on-event=WriteBlock, operation=PS_NvMP_NvmBlock_EOLTrqStepData.WriteBlock
      OIT_SetRamBlockStatus_PS_NvMP_NvmBlock_EOLTrqStepData_SetRamBlockStatus: start-on-event=SetRamBlockStatus, operation=PS_NvMP_NvmBlock_EOLTrqStepData.SetRamBlockStatus
      OIT_GetErrorStatus_PS_NvMP_NvmBlock_EOLNomMtrParam_GetErrorStatus: start-on-event=GetErrorStatus, operation=PS_NvMP_NvmBlock_EOLNomMtrParam.GetErrorStatus
      OIT_WriteBlock_PS_NvMP_NvmBlock_EOLNomMtrParam_WriteBlock: start-on-event=WriteBlock, operation=PS_NvMP_NvmBlock_EOLNomMtrParam.WriteBlock
      OIT_SetRamBlockStatus_PS_NvMP_NvmBlock_EOLNomMtrParam_SetRamBlockStatus: start-on-event=SetRamBlockStatus, operation=PS_NvMP_NvmBlock_EOLNomMtrParam.SetRamBlockStatus
      OIT_GetErrorStatus_PS_NvMP_NvmBlock_TorqueCmdSF_GetErrorStatus: start-on-event=GetErrorStatus, operation=PS_NvMP_NvmBlock_TorqueCmdSF.GetErrorStatus
      OIT_WriteBlock_PS_NvMP_NvmBlock_TorqueCmdSF_WriteBlock: start-on-event=WriteBlock, operation=PS_NvMP_NvmBlock_TorqueCmdSF.WriteBlock
      OIT_SetRamBlockStatus_PS_NvMP_NvmBlock_TorqueCmdSF_SetRamBlockStatus: start-on-event=SetRamBlockStatus, operation=PS_NvMP_NvmBlock_TorqueCmdSF.SetRamBlockStatus
      OIT_GetErrorStatus_PS_NvMP_NvmBlock_EOLCtrlPolarity_GetErrorStatus: start-on-event=GetErrorStatus, operation=PS_NvMP_NvmBlock_EOLCtrlPolarity.GetErrorStatus
      OIT_WriteBlock_PS_NvMP_NvmBlock_EOLCtrlPolarity_WriteBlock: start-on-event=WriteBlock, operation=PS_NvMP_NvmBlock_EOLCtrlPolarity.WriteBlock
      OIT_SetRamBlockStatus_PS_NvMP_NvmBlock_EOLCtrlPolarity_SetRamBlockStatus: start-on-event=SetRamBlockStatus, operation=PS_NvMP_NvmBlock_EOLCtrlPolarity.SetRamBlockStatus
      OIT_GetErrorStatus_PS_NvMP_NvmBlock_CloseCheckData_GetErrorStatus: start-on-event=GetErrorStatus, operation=PS_NvMP_NvmBlock_CloseCheckData.GetErrorStatus
      OIT_WriteBlock_PS_NvMP_NvmBlock_CloseCheckData_WriteBlock: start-on-event=WriteBlock, operation=PS_NvMP_NvmBlock_CloseCheckData.WriteBlock
      OIT_SetRamBlockStatus_PS_NvMP_NvmBlock_CloseCheckData_SetRamBlockStatus: start-on-event=SetRamBlockStatus, operation=PS_NvMP_NvmBlock_CloseCheckData.SetRamBlockStatus
      OIT_GetErrorStatus_PS_NvMP_NvmBlock_TypeHRamBuffer_GetErrorStatus: start-on-event=GetErrorStatus, operation=PS_NvMP_NvmBlock_TypeHRamBuffer.GetErrorStatus
      OIT_WriteBlock_PS_NvMP_NvmBlock_TypeHRamBuffer_WriteBlock: start-on-event=WriteBlock, operation=PS_NvMP_NvmBlock_TypeHRamBuffer.WriteBlock
      OIT_SetRamBlockStatus_PS_NvMP_NvmBlock_TypeHRamBuffer_SetRamBlockStatus: start-on-event=SetRamBlockStatus, operation=PS_NvMP_NvmBlock_TypeHRamBuffer.SetRamBlockStatus
      OIT_GetErrorStatus_PS_NvMP_NvmBlock_CoggingTables_GetErrorStatus: start-on-event=GetErrorStatus, operation=PS_NvMP_NvmBlock_CoggingTables.GetErrorStatus
      OIT_WriteBlock_PS_NvMP_NvmBlock_CoggingTables_WriteBlock: start-on-event=WriteBlock, operation=PS_NvMP_NvmBlock_CoggingTables.WriteBlock
      OIT_SetRamBlockStatus_PS_NvMP_NvmBlock_CoggingTables_SetRamBlockStatus: start-on-event=SetRamBlockStatus, operation=PS_NvMP_NvmBlock_CoggingTables.SetRamBlockStatus
      OIT_GetErrorStatus_PS_NvMP_NvmBlock_OverVoltageData_GetErrorStatus: start-on-event=GetErrorStatus, operation=PS_NvMP_NvmBlock_OverVoltageData.GetErrorStatus
      OIT_WriteBlock_PS_NvMP_NvmBlock_OverVoltageData_WriteBlock: start-on-event=WriteBlock, operation=PS_NvMP_NvmBlock_OverVoltageData.WriteBlock
      OIT_SetRamBlockStatus_PS_NvMP_NvmBlock_OverVoltageData_SetRamBlockStatus: start-on-event=SetRamBlockStatus, operation=PS_NvMP_NvmBlock_OverVoltageData.SetRamBlockStatus
      OIT_GetErrorStatus_PS_NvMP_NvmBlock_CogtrqRplComp_GetErrorStatus: start-on-event=GetErrorStatus, operation=PS_NvMP_NvmBlock_CogtrqRplComp.GetErrorStatus
      OIT_WriteBlock_PS_NvMP_NvmBlock_CogtrqRplComp_WriteBlock: start-on-event=WriteBlock, operation=PS_NvMP_NvmBlock_CogtrqRplComp.WriteBlock
      OIT_SetRamBlockStatus_PS_NvMP_NvmBlock_CogtrqRplComp_SetRamBlockStatus: start-on-event=SetRamBlockStatus, operation=PS_NvMP_NvmBlock_CogtrqRplComp.SetRamBlockStatus
      OIT_GetErrorStatus_PS_NvMP_NvmBlock_AstLmt_SteerAsstDefeat_GetErrorStatus: start-on-event=GetErrorStatus, operation=PS_NvMP_NvmBlock_AstLmt_SteerAsstDefeat.GetErrorStatus
      OIT_WriteBlock_PS_NvMP_NvmBlock_AstLmt_SteerAsstDefeat_WriteBlock: start-on-event=WriteBlock, operation=PS_NvMP_NvmBlock_AstLmt_SteerAsstDefeat.WriteBlock
      OIT_SetRamBlockStatus_PS_NvMP_NvmBlock_AstLmt_SteerAsstDefeat_SetRamBlockStatus: start-on-event=SetRamBlockStatus, operation=PS_NvMP_NvmBlock_AstLmt_SteerAsstDefeat.SetRamBlockStatus
    timing event TMT_NvMProxy_MainFunction: start-on-event=NvMProxy_MainFunction, period=0.01
    port-api-option enable-take-address=false, indirect-api=false, port=PS_NvMP_NvmBlock_MtrPosSnsr_EOLData:
      port-arg-values:
        integer literal NvM_ServiceBlockId_1: type=UInt8, value=1
    port-api-option enable-take-address=false, indirect-api=false, port=PS_NvMP_NvmBlock_ShCurrCal:
      port-arg-values:
        integer literal NvM_ServiceBlockId_2: type=UInt8, value=2
    port-api-option enable-take-address=false, indirect-api=false, port=PS_NvMP_NvmBlock_HwTrqScaleData:
      port-arg-values:
        integer literal NvM_ServiceBlockId_3: type=UInt8, value=3
    port-api-option enable-take-address=false, indirect-api=false, port=PS_NvMP_NvmBlock_HwTrqTrimData:
      port-arg-values:
        integer literal NvM_ServiceBlockId_4: type=UInt8, value=4
    port-api-option enable-take-address=false, indirect-api=false, port=PS_NvMP_NvmBlock_EOLTrqStepData:
      port-arg-values:
        integer literal NvM_ServiceBlockId_5: type=UInt8, value=5
    port-api-option enable-take-address=false, indirect-api=false, port=PS_NvMP_NvmBlock_EOLNomMtrParam:
      port-arg-values:
        integer literal NvM_ServiceBlockId_6: type=UInt8, value=6
    port-api-option enable-take-address=false, indirect-api=false, port=PS_NvMP_NvmBlock_TorqueCmdSF:
      port-arg-values:
        integer literal NvM_ServiceBlockId_7: type=UInt8, value=7
    port-api-option enable-take-address=false, indirect-api=false, port=PS_NvMP_NvmBlock_EOLCtrlPolarity:
      port-arg-values:
        integer literal NvM_ServiceBlockId_8: type=UInt8, value=8
    port-api-option enable-take-address=false, indirect-api=false, port=PS_NvMP_NvmBlock_CloseCheckData:
      port-arg-values:
        integer literal NvM_ServiceBlockId_9: type=UInt8, value=9
    port-api-option enable-take-address=false, indirect-api=false, port=PS_NvMP_NvmBlock_TypeHRamBuffer:
      port-arg-values:
        integer literal NvM_ServiceBlockId_10: type=UInt8, value=10
    port-api-option enable-take-address=false, indirect-api=false, port=PS_NvMP_NvmBlock_CoggingTables:
      port-arg-values:
        integer literal NvM_ServiceBlockId_11: type=UInt8, value=11
    port-api-option enable-take-address=false, indirect-api=false, port=PS_NvMP_NvmBlock_OverVoltageData:
      port-arg-values:
        integer literal NvM_ServiceBlockId_12: type=UInt8, value=12
    port-api-option enable-take-address=false, indirect-api=false, port=PS_NvMP_NvmBlock_CogtrqRplComp:
      port-arg-values:
        integer literal NvM_ServiceBlockId_13: type=UInt8, value=13
    port-api-option enable-take-address=false, indirect-api=false, port=PS_NvMP_NvmBlock_AstLmt_SteerAsstDefeat:
      port-arg-values:
        integer literal NvM_ServiceBlockId_14: type=UInt8, value=14
    4 x runnable:
      GetErrorStatus: can-be-invoked-concurrently=true, symbol=NvMProxy_GetErrorStatus
      NvMProxy_MainFunction: minimum-start-interval=0.01
      WriteBlock: can-be-invoked-concurrently=true, symbol=NvMProxy_WriteBlock
      SetRamBlockStatus: can-be-invoked-concurrently=true, symbol=NvMProxy_SetRamBlockStatus
  service component type NvMProxy: category=ServiceComponent  # Software Component description for NvM ASILD proxy based on generated file from Ecuc Package: ActiveEcuC
    14 x provide port, all with provided-interface=NvM_AC3_SRBS_Srv:
      PS_NvMP_NvmBlock_MtrPosSnsr_EOLData  # P-Port Prototype of NvM_AC3_SRBS_Srv for NVRAM Block Rte_NvmBlockProxy_MtrPosSnsr_EOLData
        provided-com-specs:
          operation=EraseBlock, queue-length=1
          operation=GetErrorStatus, queue-length=1
          operation=InvalidateNvBlock, queue-length=1
          operation=ReadBlock, queue-length=1
          operation=SetRamBlockStatus, queue-length=1
          operation=WriteBlock, queue-length=1
      PS_NvMP_NvmBlock_ShCurrCal  # P-Port Prototype of NvM_AC3_SRBS_Srv for NVRAM Block Rte_NvmBlockProxy_ShCurrCal
        provided-com-specs:
          operation=EraseBlock, queue-length=1
          operation=GetErrorStatus, queue-length=1
          operation=InvalidateNvBlock, queue-length=1
          operation=ReadBlock, queue-length=1
          operation=SetRamBlockStatus, queue-length=1
          operation=WriteBlock, queue-length=1
      PS_NvMP_NvmBlock_HwTrqScaleData  # P-Port Prototype of NvM_AC3_SRBS_Srv for NVRAM Block Rte_NvmBlockProxy_HwTrqScaleData
        provided-com-specs:
          operation=EraseBlock, queue-length=1
          operation=GetErrorStatus, queue-length=1
          operation=InvalidateNvBlock, queue-length=1
          operation=ReadBlock, queue-length=1
          operation=SetRamBlockStatus, queue-length=1
          operation=WriteBlock, queue-length=1
      PS_NvMP_NvmBlock_HwTrqTrimData  # P-Port Prototype of NvM_AC3_SRBS_Srv for NVRAM Block Rte_NvmBlockProxy_HwTrqTrimData
        provided-com-specs:
          operation=EraseBlock, queue-length=1
          operation=GetErrorStatus, queue-length=1
          operation=InvalidateNvBlock, queue-length=1
          operation=ReadBlock, queue-length=1
          operation=SetRamBlockStatus, queue-length=1
          operation=WriteBlock, queue-length=1
      PS_NvMP_NvmBlock_EOLTrqStepData  # P-Port Prototype of NvM_AC3_SRBS_Srv for NVRAM Block Rte_NvmBlockProxy_EOLTrqStepData
        provided-com-specs:
          operation=EraseBlock, queue-length=1
          operation=GetErrorStatus, queue-length=1
          operation=InvalidateNvBlock, queue-length=1
          operation=ReadBlock, queue-length=1
          operation=SetRamBlockStatus, queue-length=1
          operation=WriteBlock, queue-length=1
      PS_NvMP_NvmBlock_EOLNomMtrParam  # P-Port Prototype of NvM_AC3_SRBS_Srv for NVRAM Block Rte_NvmBlockProxy_EOLNomMtrParam
        provided-com-specs:
          operation=EraseBlock, queue-length=1
          operation=GetErrorStatus, queue-length=1
          operation=InvalidateNvBlock, queue-length=1
          operation=ReadBlock, queue-length=1
          operation=SetRamBlockStatus, queue-length=1
          operation=WriteBlock, queue-length=1
      PS_NvMP_NvmBlock_TorqueCmdSF  # P-Port Prototype of NvM_AC3_SRBS_Srv for NVRAM Block Rte_NvmBlockProxy_TorqueCmdSF
        provided-com-specs:
          operation=EraseBlock, queue-length=1
          operation=GetErrorStatus, queue-length=1
          operation=InvalidateNvBlock, queue-length=1
          operation=ReadBlock, queue-length=1
          operation=SetRamBlockStatus, queue-length=1
          operation=WriteBlock, queue-length=1
      PS_NvMP_NvmBlock_EOLCtrlPolarity  # P-Port Prototype of NvM_AC3_SRBS_Srv for NVRAM Block Rte_NvmBlockProxy_EOLCtrlPolarity
        provided-com-specs:
          operation=EraseBlock, queue-length=1
          operation=GetErrorStatus, queue-length=1
          operation=InvalidateNvBlock, queue-length=1
          operation=ReadBlock, queue-length=1
          operation=SetRamBlockStatus, queue-length=1
          operation=WriteBlock, queue-length=1
      PS_NvMP_NvmBlock_CloseCheckData  # P-Port Prototype of NvM_AC3_SRBS_Srv for NVRAM Block Rte_NvmBlockProxy_CloseCheckData
        provided-com-specs:
          operation=EraseBlock, queue-length=1
          operation=GetErrorStatus, queue-length=1
          operation=InvalidateNvBlock, queue-length=1
          operation=ReadBlock, queue-length=1
          operation=SetRamBlockStatus, queue-length=1
          operation=WriteBlock, queue-length=1
      PS_NvMP_NvmBlock_TypeHRamBuffer  # P-Port Prototype of NvM_AC3_SRBS_Srv for NVRAM Block Rte_NvmBlockProxy_TypeHRamBuffer
        provided-com-specs:
          operation=EraseBlock, queue-length=1
          operation=GetErrorStatus, queue-length=1
          operation=InvalidateNvBlock, queue-length=1
          operation=ReadBlock, queue-length=1
          operation=SetRamBlockStatus, queue-length=1
          operation=WriteBlock, queue-length=1
      PS_NvMP_NvmBlock_CoggingTables  # P-Port Prototype of NvM_AC3_SRBS_Srv for NVRAM Block Rte_NvmBlockProxy_CoggingTables
        provided-com-specs:
          operation=EraseBlock, queue-length=1
          operation=GetErrorStatus, queue-length=1
          operation=InvalidateNvBlock, queue-length=1
          operation=ReadBlock, queue-length=1
          operation=SetRamBlockStatus, queue-length=1
          operation=WriteBlock, queue-length=1
      PS_NvMP_NvmBlock_OverVoltageData  # P-Port Prototype of NvM_AC3_SRBS_Srv for NVRAM Block Rte_NvmBlockProxy_OverVoltageData
        provided-com-specs:
          operation=EraseBlock, queue-length=1
          operation=GetErrorStatus, queue-length=1
          operation=InvalidateNvBlock, queue-length=1
          operation=ReadBlock, queue-length=1
          operation=SetRamBlockStatus, queue-length=1
          operation=WriteBlock, queue-length=1
      PS_NvMP_NvmBlock_CogtrqRplComp  # P-Port Prototype of NvM_AC3_SRBS_Srv for NVRAM Block Rte_NvmBlockProxy_CogtrqRplComp
        provided-com-specs:
          operation=EraseBlock, queue-length=1
          operation=GetErrorStatus, queue-length=1
          operation=InvalidateNvBlock, queue-length=1
          operation=ReadBlock, queue-length=1
          operation=SetRamBlockStatus, queue-length=1
          operation=WriteBlock, queue-length=1
      PS_NvMP_NvmBlock_AstLmt_SteerAsstDefeat  # P-Port Prototype of NvM_AC3_SRBS_Srv for NVRAM Block Rte_NvmBlockProxy_AstLmt_SteerAsstDefeat
        provided-com-specs:
          operation=EraseBlock, queue-length=1
          operation=GetErrorStatus, queue-length=1
          operation=InvalidateNvBlock, queue-length=1
          operation=ReadBlock, queue-length=1
          operation=SetRamBlockStatus, queue-length=1
          operation=WriteBlock, queue-length=1
  swc implementation NvMProxy_Implementation: behavior=NvMProxy_InternalBehavior
    code-descriptors:
      code Code: type=SRC
package /DataType
  array type NvM_DestPtr  # DataPtr Type to be used by WriteBlock, ReadBlock and RestoreBlockDefaults operations. This type is used for all NVRAM blocks
    element NvM_DestPtr: type=UInt8, max-number-of-elements=65535
  integer type NvM_RequestResultType: compu {0=NVM_REQ_OK, 1=NVM_REQ_NOT_OK, 2=NVM_REQ_PENDING, 3=NVM_REQ_INTEGRITY_FAILED, 4=NVM_REQ_BLOCK_SKIPPED, 5=NVM_REQ_NV_INVALIDATED}, lower-limit=0, upper-limit=5
package /PortInterface
  client server interface NvM_AC3_SRBS_Srv: is-service=true  # Port Interface for NVRAM Blocks of Management Types "NATIVE" or "REDUNDANT" without default values.
    6 x operation:
      EraseBlock: possible-error=E_NOT_OK
      GetErrorStatus
        arg ErrorStatus: type=NvM_RequestResultType, direction=OUT
      InvalidateNvBlock: possible-error=E_NOT_OK
      ReadBlock: possible-error=E_NOT_OK
        arg DstPtr: type=NvM_DestPtr, direction=OUT
      SetRamBlockStatus
        arg RamBlockStatus: type=Boolean, direction=IN
      WriteBlock: possible-error=E_NOT_OK
        arg DstPtr: type=NvM_DestPtr, direction=IN
    error E_NOT_OK: error-code=1
  client server interface NvM_Administration: is-service=true
    operation SetBlockProtection
      arg ProtectionEnabled: type=Boolean, direction=IN
