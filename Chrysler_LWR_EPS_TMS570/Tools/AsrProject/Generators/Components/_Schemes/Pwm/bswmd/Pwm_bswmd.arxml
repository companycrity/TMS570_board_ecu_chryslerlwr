AUTOSAR XML (schema 3.0.2)
# COPYRIGHT
# Copyright (c) 2010 by Vector Informatik GmbH. All rights reserved.
# This software is copyright protected and proprietary to Vector Informatik GmbH.
# Vector Informatik GmbH grants to you only those rights as set out in the license conditions.
package /MICROSAR
  bsw implementation Pwm_Impl: code-generator=cMICROSAR, programming-language=C, sw-major-version=1, sw-minor-version=1, sw-patch-version=0, vendor-id=30, ar-major-version=2, ar-minor-version=2, ar-patch-version=0, preconfigured-configuration=Pwm_Pre, recommended-configuration=Pwm_Rec, vendor-specific-module-def=Pwm
  module definition Pwm [0..1]: refined-module-def=Pwm, variants post-build  # Configuration of Pwm (Pulse Width Modulation) module.
    container PwmChannelConfigSet [1..*]: multiple-configuration-container=true  # Multiple Configuration Set Container
      integer PwmLrClock: 1..128, set at post-build, origin=Vector Informatik, default-value=128  # NHET Loop Resolution Clock settings
      integer PwmHrClock: 1..64, set at post-build, origin=Vector Informatik, default-value=1  # NHET High Resolution Clock settings
      string PwmMcuVariant: set at post-build, origin=Vector Informatik  # Selection of the Mcu Variant
      string PwmMcuClockconfig: set at post-build, origin=Vector Informatik  # Selection of Clock Configuration of the Module Mcu
      float PwmInputFrequnecy: 0..180, set at post-build, origin=Vector Informatik, default-value=20  # The Input Frequency of the NHET unit
      integer PwmHetBase: 0..127, set at pre-compile, origin=Vector Informatik, default-value=48  # Offset in HET instructions where the Pwm program beginns
      container PwmChannel [1..16]  # Configuration of an individual PWM channel.
        enumeration PwmChannelClass: set at post-build, default-value=PWM_VARIABLE_PERIOD  # Class of PWM Channel. ImplementationType: Pwm_ChannelClassType
          PWM_FIXED_PERIOD  # Fixed Period
          PWM_FIXED_PERIOD_SHIFTED  # Shifted Period
          PWM_VARIABLE_PERIOD  # Variable Period
        integer PwmChannelId: 0..15, set at pre-compile, symbolic-name-value=true, default-value=0  # Channel Id of the PWM channel. This value will be assigned to the symbolic name derived of the PwmChannel container short name. (Not used)
        integer PwmDutycycleDefault: 0..32768, set at post-build, default-value=16384  # Value of duty cycle used for Initialization 0, represents 0% 0x8000 represents 100%
        enumeration PwmIdleState: set at post-build, default-value=PWM_LOW  # The parameter PWM_IDLE_STATE represents the output state of the PWM after the signal is stopped (e.g. call of Pwm_SetOutputToIdle).
          PWM_HIGH  # High
          PWM_LOW  # Low
        function name PwmNotification: set at post-build  # Definition of the Callback function.
        float PwmPeriodDefault: 0..1000000, set at post-build, default-value=0.1  # Value of period used for Initialization.(in seconds). (Not used)
        enumeration PwmPolarity: set at post-build, default-value=PWM_HIGH  # Defines the starting polarity of each PWM channel.
          PWM_HIGH  # High
          PWM_LOW  # Low
        float PwmDutycycleDefaultPercent: 0..100, set at post-build, origin=Vector Informatik, default-value=50  # Length of the Duty Cycle in percent of the Period.
        integer PwmPeriodDefaultTics: 0..33554431, set at post-build, origin=Vector Informatik, default-value=1000  # Duration of the Pwm Period in Ticks
        integer PwmOutputPin: 0..31, set at post-build, origin=Vector Informatik, default-value=0  # The output port pin of the PWM singal.
        integer PwmDutycycleDefaultTics: 0..33554431, set at post-build, origin=Vector Informatik, default-value=500  # The lenght of the duty cycle in ticks
    container PwmConfigurationOfOptApiServices
      boolean PwmDeInitApi: set at pre-compile, default-value=true  # Adds / removes the service Pwm_DeInit() from the code.
      boolean PwmGetOutputState: set at pre-compile, default-value=true
      boolean PwmSetDutyCycle: set at pre-compile, default-value=true
      boolean PwmSetOutputToIdle: set at pre-compile, default-value=true
      boolean PwmSetPeriodAndDuty: set at pre-compile, default-value=true
      boolean PwmVersionInfoApi: set at pre-compile, default-value=true  # Switch to indicate that the Pwm_ GetVersionInfo is supported
    container PwmGeneral
      boolean PwmDevErorDetect: set at pre-compile, default-value=true  # Switch for enabling the development error detection.
      boolean PwmDutycycleUpdatedEndperiod: set at pre-compile, default-value=true  # Switch for enabling the update of the duty cycle parameter at the end of the current period
      integer PwmIndex: 0..20, set at pre-compile, default-value=0  # Specifies the InstanceId of this module instance. If only one instance is present it shall have the Id 0. (Not used)
      boolean PwmNotificationSupported: set at pre-compile, default-value=true  # Switch to indicate that the notifications are supported
      boolean PwmPeriodUpdatedEndperiod: set at pre-compile, default-value=true  # Switch for enabling the update of the period parameter at the end of the current period
      boolean PwmCfgDoParamChk: set at pre-compile, origin=Vector Informatik, default-value=true  # Preprocessor switch if parameter checking is activated in development mode.
      boolean PwmCfgChkUninit: set at pre-compile, origin=Vector Informatik, default-value=true  # Activate/deactivate check if module Port is uninitialized when calling a service.
      boolean PwmCfgChkAlreadyInit: set at pre-compile, origin=Vector Informatik, default-value=true  # Activate/deactivate check if module Port is already initialized when calling Pwm_Init.
      boolean PwmCfgChkChannelClass: set at pre-compile, origin=Vector Informatik, default-value=true  # Activate/deactivate check if Pwm_SetPeriodAndDuty() is called with a Pwm channel which is configrued as variable.
      boolean PwmCfgChkNotifyPtr: set at pre-compile, origin=Vector Informatik, default-value=true  # Activate/deactivate check if callback notification function referes to NULL
      boolean PwmCfgChkParamChannel: set at pre-compile, origin=Vector Informatik, default-value=true  # Switch which enables/disables the checking if the ChannelNumber parameter is in valid range.
      boolean PwmCfgChkParamPeriod: set at pre-compile, origin=Vector Informatik, default-value=true  # Switch which enables/disables the checking if the Period parameter is in valid range.
      boolean PwmCfgChkParamVinfo: set at pre-compile, origin=Vector Informatik, default-value=true  # Switch which enables/disables the checking of the parameter of Pwm_GetVersionInfo in development mode.
      boolean PwmCfgChkParamConfig: set at pre-compile, origin=Vector Informatik, default-value=true  # Preprocessor switch if checking of config parameter of Pwmt_Init() is activated in development mode.
      function name PwmErrorhook: set at pre-compile, origin=Vector Informatik, default-value=Det_ReportError  # Function which is called in case of Development Error
      string PwmDetIncludeFile: set at pre-compile, origin=Vector Informatik, default-value=Det.h  # The include file of the Development Error Tracer. Shall be used to specify a special Det module.
      boolean PwmCfgDebugReporting: set at pre-compile, origin=Vector Informatik, default-value=true  # Activate or deactivate if recognized development errors are reported to Det
      derived string PwmNativeISR: set at pre-compile, origin=Vector Informatik
      string PwmCfgIncludeList: set at pre-compile, origin=Vector Informatik
      reference PwmIrqHandling: set at pre-compile, origin=Vector Informatik, destination=InterruptFunctionSet  # Determines the IRQ function set which is used to protect critical sections.
    container VectorCommonData
      string BswmdVersion: set at published-information, origin=Vector Informatik, default-value=1.00.04  # This parameter specifies the version of this bswmd file.
  module config Pwm_Pre: definition=Pwm
  module config Pwm_Rec: definition=Pwm
