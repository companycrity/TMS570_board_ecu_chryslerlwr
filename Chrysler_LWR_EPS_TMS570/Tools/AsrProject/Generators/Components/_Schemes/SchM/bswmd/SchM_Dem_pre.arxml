AUTOSAR XML (schema 3.0.1)
package /MICROSAR
  module config SchM_Rec: definition=SchM, implementation-config-variant=VARIANT-PRE-COMPILE  # Configuration of the SchM (BSW Scheduler) module.
    Dem (SchMModuleConfiguration): SchMModuleLiteral=Dem, SchMModuleInclude=Dem.h, SchMModuleConfigVersion=1.0.0, SchMModuleImplementationRef=Dem_Impl
      SCHM_DEM_INSTANCE_0 (InstanceConfiguration): SchMInstanceLiteral=SCHM_DEM_INSTANCE_0
        DEM_EXCLUSIVE_AREA_0 (ExclusiveAreaConf):
          SchMExclusiveAreaLiteral = DEM_EXCLUSIVE_AREA_0
          SchMExclusiveAreaDescription = Normal operation protection. It is recommended *not* to use a global interrupt lock.
        DEM_EXCLUSIVE_AREA_1 (ExclusiveAreaConf): SchMExclusiveAreaLiteral=DEM_EXCLUSIVE_AREA_1, SchMExclusiveAreaDescription=Protection during ECU startup. Must not require OS support.
    Dem_MainFunction (SchMMainFunctionMapping): SchMMainFunctionSymbol=Dem_MainFunction, SchMModuleRef=Dem
      SchMBswEvent
        SchMBswDerivedTimingEvent: SchMMainFunctionPeriodParamScale=0.001, SchMMainFunctionPeriodParamRef=/MICROSAR/Dem/DemGeneral/DemTaskTime
