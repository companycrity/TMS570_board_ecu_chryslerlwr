AUTOSAR XML (schema 3.0.1)
package /MICROSAR
  module config SchM_Rec: definition=SchM, implementation-config-variant=VARIANT-PRE-COMPILE  # Configuration of the SchM (BSW Scheduler) module.
    Can (SchMModuleConfiguration): SchMModuleLiteral=Can, SchMModuleInclude=Can.h, SchMModuleConfigVersion=1.0.0, SchMModuleImplementationRef=Can_Impl
      SCHM_CAN_INSTANCE_0 (InstanceConfiguration): SchMInstanceLiteral=SCHM_CAN_INSTANCE_0
        CAN_EXCLUSIVE_AREA_0 (ExclusiveAreaConf):
          SchMExclusiveAreaLiteral = CAN_EXCLUSIVE_AREA_0
          SchMExclusiveAreaDescription = Exclusive Area uses to garantee RX, TX data and state consistency. this Area should be protected with global interrupt locks.
    4 x SchMMainFunctionMapping, all with SchMModuleRef=Can:
      Can_MainFunction_Write: SchMMainFunctionSymbol=Can_MainFunction_Write
        SchMBswEvent
          SchMBswTimingEvent: SchMMainFunctionPeriod=0.01
      Can_MainFunction_Read: SchMMainFunctionSymbol=Can_MainFunction_Read
        SchMBswEvent
          SchMBswTimingEvent: SchMMainFunctionPeriod=0.01
      Can_MainFunction_BusOff: SchMMainFunctionSymbol=Can_MainFunction_BusOff
        SchMBswEvent
          SchMBswTimingEvent: SchMMainFunctionPeriod=0.01
      Can_MainFunction_Wakeup: SchMMainFunctionSymbol=Can_MainFunction_Wakeup
        SchMBswEvent
          SchMBswTimingEvent: SchMMainFunctionPeriod=0.01
