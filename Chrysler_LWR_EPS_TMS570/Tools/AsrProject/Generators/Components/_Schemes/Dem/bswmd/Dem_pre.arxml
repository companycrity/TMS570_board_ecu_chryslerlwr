AUTOSAR XML (schema 3.0.1)
package /MICROSAR
  module definition Dem: variants pre-compile
  module config Dem_VectorTemplates: definition=Dem
    DemConfigSet
      VectorEventTemplate (DemEventParameter): DemEventID=(unset), DemEventKind=DEM_EVENT_KIND_SWC, DemImportedEvent=(unset), DemDTCClassRef=(unset)
        DemEventClass:
          DemEventPriority = 0
          DemFFPrestorageSupported = true
          DemHealingAllowed = true
          DemHealingCycleCounter = 40
          DemOperationCycleRef = DEM_POWER
          DemSupportedViewName = (unset)
          DemHealingCycleRef = DEM_POWER
          DemPredebounceAlgorithmClass
            DemPreDebounceCounterBased: DemCountInStepSize=1, DemCountOutStepSize=1, DemJumpDown=false, DemJumpUp=true, DemPreDebounceName=DEM_PRE_DEBOUNCE_COUNTER_BASED
  module config Dem_Pre: definition=Dem
    DemGeneral: DemSupportGetEventIdApi=false
      4 x DemOperationCycleTgt:
        DEM_IGNITION: DemOperationCycle=DEM_IGNITION
        DEM_OBD_DCY: DemOperationCycle=DEM_OBD_DCY
        DEM_POWER: DemOperationCycle=DEM_POWER
        DEM_WARMUP: DemOperationCycle=DEM_WARMUP
  module config Dem_Rec: definition=Dem
