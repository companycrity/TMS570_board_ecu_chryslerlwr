AUTOSAR XML (schema 3.1.4)
# COPYRIGHT
# Copyright (c) 2012 by Vector Informatik GmbH. All rights reserved.
# This software is copyright protected and proprietary to Vector Informatik GmbH.
# Vector Informatik GmbH grants to you only those rights as set out in the license conditions.
package /MICROSAR
  module config Spi_Rec: definition=Spi
    SpiGeneral:
      SpiCancelApi = true
      SpiChannelBuffersAllowed = 1
      SpiDevErrorDetect = true
      SpiHwStatusApi = true
      SpiInterruptibleSeqAllowed = false
      SpiLevelDelivered = 1
      SpiVersionInfoApi = false
      SpiDemIncludeFile = Dem.h
      SpiDetIncludeFile = Det.h
      SpiDetErrorhook = Det_ReportError
      SpiDemErrorhook = Dem_ReportErrorStatus
      SpiIrqType = SPI_ISR_CAT2
      SpiParamChkConfig = true
      SpiParamChkChannel = true
      SpiParamChkJob = true
      SpiParamChkSeq = true
      SpiParamChkLength = true
      SpiParamChkVersion = false
      SpiParamChkUnit = true
      SpiChkModuleInit = true
      SpiChkSeqPending = true
      SpiChkDriverInit = true
      SpiChkSeqProcessing = false
      SpiDetErrorReporting = true
      SpiDemErrorReporting = true
      SpiParamChk = true
      SpiParamChkAlignment = true
      SpiParamChkBuffer = true
      SpiChkModuleAlreadyInitialized = true
  module config Spi_Rec_Class1: definition=Spi
    Spi_Runtime (SpiDriver)
      SpiChannel: SpiChannelId=0, SpiChannelType=EB, SpiDataWidth=8, SpiDefaultData=255, SpiEbMaxLength=255, SpiIbNBuffers=20, SpiTransferStart=MSB
      SpiExternalDevice:
        SpiBaudrate = 500.0
        SpiCsIdentifier = PCS0
        SpiCsPolarity = HIGH
        SpiDataShiftEdge = RAISING
        SpiEnableCs = true
        SpiShiftClockIdleLevel = LOW
        SpiTimeClk2Cs = 1000.0
        SpiTimeCs2Clk = 1000
        SpiTimeEna2Cs = 0.0
        SpiTimeCs2Ena = 0.0
        SpiCsMode = CONTINOUS
        SpiCsIdleTime = 100
      SpiJob:
        SpiJobEndNotification = NULL_PTR
        SpiJobId = 0
        SpiJobPriority = 0
        SpiJobSort = 3
        DeviceAssignment = SpiExternalDevice
        ChannelAssignment = SpiChannel
        SpiHwUnitAssignment = SpiHardwareUnit
      SpiSequence: SpiInterruptibleSequence=false, SpiSequenceId=0, JobAssignment=SpiJob
      SpiHardwareUnit: SpiUnitId=0, SpiUnitHasRam=false, SpiUnitUsesDma=false
      SpiClockSettings: SpiClockSelector=true, SpiClockConfiguration=McuClockDomains
