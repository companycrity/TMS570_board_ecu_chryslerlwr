AUTOSAR XML (schema 3.1.4)
# COPYRIGHT
# Copyright (c) 2012 by Vector Informatik GmbH. All rights reserved.
# This software is copyright protected and proprietary to Vector Informatik GmbH.
# Vector Informatik GmbH grants to you only those rights as set out in the license conditions.
package /MICROSAR
  module definition Spi [0..1]: refined-module-def=Spi, variants post-build  # Configuration of the Spi (Serial Peripheral Interface) module.
    container SpiDriver: multiple-configuration-container=true
      integer SpiMaxChannel [0..1]: 1..254, set at post-build, default-value=254  # This parameter contains the number of Channels configured. It will be gathered by tools during the configuration stage.
      integer SpiMaxJob [0..1]: 1..254, set at post-build, default-value=254
      integer SpiMaxSequence [0..1]: 1..254, set at post-build, default-value=254
      integer SpiMaxHWUnit: 0..4, set at pre-compile, origin=Vector Informatik, default-value=4  # Definition for the availiable hardwareunits.
      container SpiChannel [1..255]  # All data needed to configure one Spi channel
        integer SpiChannelId: 0..254, set at post-build, symbolic-name-value=true, default-value=0  # Settings for Channel ID | Unique Id of a SPI channel.
        enumeration SpiChannelType: set at post-build, default-value=EB  # Select channel type | Buffer usage with EB/IB channel
          EB  # external buffer
          IB  # internal buffer
        integer SpiDataWidth: 8..16, set at post-build, default-value=8  # Width of one data frame | This parameter is the width of a transmitted data unit.
        integer SpiDefaultData: 0..65535, set at post-build, default-value=255  # Default transmission data | This parameter is the default value to transmit.
        integer SpiEbMaxLength: 1..65535, set at post-build, default-value=255  # Maximum length for external channels | This parameter contains the maximum size of data buffers in case of EB Channels and only. This unit is in Bytes.
        integer SpiIbNBuffers: 1..20, set at post-build, default-value=10  # Maximum length for internal channels | This parameter contains the maximum number of data buffers in case of IB Channels and only. This unit is in Bytes.
        enumeration SpiTransferStart: set at post-build, default-value=MSB  # Start transfer with | This parameter defines the first starting bit for transmission.
          LSB  # least significant bit
          MSB  # most significant bit
      container SpiExternalDevice [1..255]  # The communication settings of an external device. Closely linked to SpiJob.
        float SpiBaudrate: 0..20000.0, set at post-build, default-value=500  # Baud rate | This parameter is the communication baudrate - This parameter allows using a range of values, from the point of view of configuration tools, from kHz up to MHz. Baud rate unit is [kHz].
        string SpiCsIdentifier: set at post-build, symbolic-name-value=true, default-value=PCS0  # Pin used for chip select | This parameter is the symbolic name to identify the Chip Select (CS) allocated to this Job.
        enumeration SpiCsPolarity: {HIGH, LOW}, set at post-build, default-value=HIGH  # Level of chip select | This parameter defines the idle polarity of Chip Select.
        enumeration SpiDataShiftEdge: set at post-build, default-value=RAISING  # Data edge | This parameter define the SPI data recognition at rising or falling edge.
          RAISING  # data is valid at rising edge
          FALLING  # data is valid at falling edge
        boolean SpiEnableCs: set at post-build, default-value=true  # Chip select is active | This parameter enables or not the Chip Select handling functions.
        enumeration SpiShiftClockIdleLevel: set at post-build, default-value=HIGH  # Clock level | This parameter defines the SPI clock idle level.
          HIGH  # clock idle level is high
          LOW  # clock idle level is low
        float SpiTimeClk2Cs: 0..65535.0, set at post-build, default-value=10  # Clock stop to CS idle delay | Transmit-end-to-chip-select-inactive-delay.Timing between clock and chip select - This parameter allows to use a range of values from 0 up to 65 micro seconds. Time unit is ns >> max is 65000ns. the real configuration-value used in software BSW-SPI is calculated out of this by the generator-tools
        integer SpiTimeCs2Clk: 0..65535, set at post-build, origin=Vector Informatik, default-value=10  # CS active to Clock start delay | Chip-select-active-to-transmit-start-delay. See SpiTimeClk2Cs.
        float SpiTimeEna2Cs: 0..65535.0, set at post-build, origin=Vector Informatik, default-value=0  # CS idle to ENA stop timeout | Transmit-data-finished-to-ENA-pin-inactive-time-out. Value 0 disables this setting.
        float SpiTimeCs2Ena: 0..65535.0, set at post-build, origin=Vector Informatik, default-value=0  # CS start to ENA active timeout | Chip-select-active-to-ENA-signal-active-time-out in ns. Value 0 disables this setting.
        enumeration SpiCsMode: {SINGLE, CONTINOUS}, set at post-build, origin=Vector Informatik, default-value=CONTINOUS  # Chip select mode | This selcts which CS mode the device should enter. SINGLE: the CS will return to default level after one transmission unit has been sent. CONTINOUS: the CS will remain active during the whole transmission.
        integer SpiMode: 0..3, set at post-build, origin=Vector Informatik, default-value=0  # Resulting Spi mode | Addition to the CS mode of the device. The user can input the amount of time in [ns] the Spi will insert between two SINGLE transfers. The CS will go IDLE for this given time. This parameter depens on the given VCLK of the Spi peripheral.
        integer SpiCsIdleTime: 0..65535, set at post-build, origin=Vector Informatik, default-value=100  # Idle time between chip selects | Idle time of CS# between two single transfers. The time can be configured from 0 = disabled to 65536 [ns] nanoseconds if supported by hardware.
      container SpiJob [1..255]  # All data needed to configure one SPI-Job, amongst others the connection between the internal SPI unit and the special settings for an external device is done.
        enumeration SpiHwUnit: {CSIB0}, set at post-build, default-value=CSIB0  # [REPLACED BY: /MICROSAR/Spi/SpiDriver/SpiJob/SpiHwUnitAssignment]
        function name SpiJobEndNotification: set at post-build, default-value=NULL_PTR  # Job end may call | This parameter is a reference to a notification function.
        integer SpiJobId: 0..254, set at post-build, symbolic-name-value=true, default-value=0  # Settings for Job ID | Unique job Id.
        integer SpiJobPriority: 0..3, set at post-build, default-value=3  # Set prioirity of this job | Priority of this job.
        integer SpiJobSort: 0..3, set at pre-compile, origin=Vector Informatik, default-value=0  # Parameter for internal usage. Do not change!
        enumeration SpiHwUnitSynchronous: set at pre-compile, default-value=ASYNCHRONOUS  # If SpiHwUnitSynchronous is set to "SYNCHRONOUS", the SpiJob uses its containing SpiDriver in a synchronous manner. If it is set to "ASYNCHRO- NOUS", it uses the driver in an asynchronous way. If the parameter is not set, the SpiChannel uses the driver also in an asynchronous way. [NOT USED]
          ASYNCHRONOUS  # Hardware unit transmitts asynchronous
          SYNCHRONOUS  # ASYNCHRONOUS Hardware unit transmitts synchronous
        reference ChannelAssignment [1..*]: set at post-build, destination=SpiChannel  # Assign channel(s) to job | A job references several channels.
        reference DeviceAssignment: set at post-build, destination=SpiExternalDevice  # Assign device(s) to job | Reference to the external device used by this job
        reference SpiHwUnitAssignment: set at post-build, origin=Vector Informatik, destination=SpiHardwareUnit  # Select hardware unit for communication | This parameter is the symbolic name to identify the HW SPI Hardware microcontroller peripheral allocated to this Job.
      container SpiSequence [1..255]  # All data needed to configure one SPI-sequence
        boolean SpiInterruptibleSequence: set at post-build, default-value=false  # This sequence is interruptible | This parameter allows or not this Sequence to be interrupted and suspended by another one.
        function name SpiSeqEndNotification: set at post-build, default-value=NULL_PTR  # Sequence end may call | This parameter is a reference to a notification function.
        integer SpiSequenceId: 0..254, set at post-build, symbolic-name-value=true, default-value=0  # Settings for Sequence ID | Unique sequence Id.
        reference JobAssignment [1..*]: set at post-build, destination=SpiJob  # Assign job(s) to this sequence | A sequence references several jobs, which are executed during a communication sequence
      container SpiHardwareUnit [1..5]  # Container for hardware unit configuration.
        boolean SpiUnitHasRam: set at pre-compile, origin=Vector Informatik, default-value=false  # Hardware unit shall use RAM | If true Spi hardware unt has access to internal RAM buffers
        integer SpiUnitId: 0..4, set at pre-compile, origin=Vector Informatik, default-value=0  # Enter a hardware unit Id | Id of the hardwareunit. Spi unit 0 starts with the id=0, unit 1 has the id=1 and so on.
        boolean SpiUnitUsesDma: set at pre-compile, origin=Vector Informatik, default-value=false  # Hardware unit shall use DMA | If true Spi hardware untt uses DMA.
      container SpiClockSettings
        float SpiClockFrequency: 2..180, set at pre-compile, origin=Vector Informatik, default-value=16  # Resulting clock for Spi in Mhz | operating frequency of Spi, derived from MCU VCLK.
        boolean SpiClockSelector: set at pre-compile, origin=Vector Informatik, default-value=true  # Select clock source | Select clock from MCU or manual clock. MCU = True, manual = false
        reference SpiClockConfiguration: set at pre-compile, origin=Vector Informatik, destination=McuClockDomains  # Select the clock setting configuration | Clock configuration derived from Mcu
    container SpiGeneral  # General configuration settings for SPI-Handler
      boolean SpiCancelApi: set at pre-compile, default-value=true  # Enable Spi_Cancel | Switches the Spi_Cancel function ON or OFF.
      boolean SpiHwStatusApi: set at pre-compile, default-value=true  # Enable Spi_GetHWUnitStatus | Switches the Spi_GetHWUnitStatus function ON or OFF.
      boolean SpiDevErrorDetect: set at pre-compile, default-value=true  # Development mode | Switches the Development Error Detection and Notification ON or OFF.
      boolean SpiInterruptibleSeqAllowed: set at pre-compile, default-value=false  # Global enable interruptible sequences | Switches the Interruptible Sequences handling functionality ON or OFF.
      boolean SpiVersionInfoApi: set at pre-compile, default-value=false  # Enable Spi_GetVersionInfo | Switches the Spi_GetVersionInfo function ON or OFF.
      boolean SpiParamChkConfig: set at pre-compile, origin=Vector Informatik, default-value=true  # Check configuration pointer | Wrong config pointer (NULL_PTR) passed to API.
      boolean SpiParamChkChannel: set at pre-compile, origin=Vector Informatik, default-value=true  # Check if channel is valid | Wrong channel ID passed to API.
      boolean SpiParamChkJob: set at pre-compile, origin=Vector Informatik, default-value=true  # Check if job is valid | Wrong job ID passed to API.
      boolean SpiParamChkSeq: set at pre-compile, origin=Vector Informatik, default-value=true  # Check if sequence is valid | Wrong sequence ID passed to API.
      boolean SpiParamChkLength: set at pre-compile, origin=Vector Informatik, default-value=true  # Check if length is valid | Wrong length passed to API.
      boolean SpiParamChkVersion: set at pre-compile, origin=Vector Informatik, default-value=true  # Check if version pointer is valid | A wrong version pointer was passed to the API.
      boolean SpiParamChkUnit: set at pre-compile, origin=Vector Informatik, default-value=true  # Check if hardware unit is valid | A wrong unit was passed to the API.
      boolean SpiChkModuleInit: set at pre-compile, origin=Vector Informatik, default-value=true  # Check if module is initialized | API service used without module initialization.
      boolean SpiChkSeqPending: set at pre-compile, origin=Vector Informatik, default-value=true  # Check if sequence is still pending | Api called in a wrong Sequence.
      boolean SpiChkModuleAlreadyInitialized: set at pre-compile, origin=Vector Informatik, default-value=true  # Check if module was already initialized | API SPI_Init service called while the SPI driver has already been initialized .
      boolean SpiChkSeqProcessing: set at pre-compile, origin=Vector Informatik, default-value=true  # Check is a sequence is still busy | Synchronous transmission service called at wrong time.
      boolean SpiDetErrorReporting: set at pre-compile, origin=Vector Informatik, default-value=true  # Enable Det error reporting | This parameter enables Det configuration and reporting.
      boolean SpiDemErrorReporting: set at pre-compile, origin=Vector Informatik, default-value=false  # Enable Dem error reporting | Report errors to the Diagnostic Event Monitor. If off, Dem reporting is still active but will not be logged.
      boolean SpiParamChk: set at pre-compile, origin=Vector Informatik, default-value=true  # Enable parameter checks | Enable or disable parameter checks of Spi.
      boolean SpiParamChkBuffer: set at pre-compile, origin=Vector Informatik, default-value=true  # Check if buffer is aligned | This parameter checks if the buffer is aligned when using 8 or 16 bit frame transfer. Using channels with 8 bit frame transfer, alignment does not matter while buffers with 16 bit frame transfer require even aligned buffers.
      boolean SpiParamChkAlignment: set at pre-compile, origin=Vector Informatik, default-value=true  # Check if length is aligned | This parameter checks if the lengthis aligned when using 8 or 16 bit frame transfer. Using channels with 8 bit frame transfer, length alignment does not matter while buffers with 16 bit frame transfer require even aligned length.
      integer SpiChannelBuffersAllowed: 0..2, set at pre-compile, default-value=1  # Select allowed channel buffers | Selects the SPI Handler/Driver Channel Buffers usage allowed and delivered.
      integer SpiLevelDelivered: 0..2, set at pre-compile, default-value=1  # Level of scalable functionality | Selects the SPI Handler/Driver level of scalable functionality that is available and delivered.
      string SpiDemIncludeFile: set at pre-compile, origin=Vector Informatik, default-value=Dem.h  # Dem include file | Determine the Dem include file of the Errorhook function for development mode.
      string SpiDetIncludeFile: set at pre-compile, origin=Vector Informatik, default-value=Det.h  # Det include file | Determine the Det include file of the Errorhook function for development mode.
      string SpiDetErrorhook: set at pre-compile, origin=Vector Informatik, default-value=Det_ReportError  # Det error hook function | Determine the Errorhook function for development mode.
      string SpiDemErrorhook: set at pre-compile, origin=Vector Informatik, default-value=Dem_ReportErrorStatus  # Dem error hook function | Determine the Errorhook function for production mode.
      string SpiCbkIncludeFile [1..3]: set at pre-compile, origin=Vector Informatik, default-value=NULL  # Callback include file(s) | Include the callback include files, to make these functions visible to the Spi.
      string SpiIrqIncludeFile: set at pre-compile, origin=Vector Informatik, default-value=Spi_Irq.h  # Declaration of interrupt functions
      string SpiIrqFunction: set at pre-compile, origin=Vector Informatik, default-value=Spi_IrqUnit[x]TxRx  # Name of the interrupt function | Main name of the ISR service. The [x] is the id of the hardware unit.
      enumeration SpiIrqType: set at pre-compile, origin=Vector Informatik, default-value=SPI_ISR_CAT2  # Interrupt implementation | Type of Isr function: void functionname(void) CAT1 see description in oil tool : interrupt void func(void) CAT2 see description in oil tool : ISR(func)
        SPI_ISR_VOID  # void Func( void )
        SPI_ISR_CAT1  # Category 1
        SPI_ISR_CAT2  # Category 2
      boolean SpiSRAEnabled: set at pre-compile, origin=Vector Informatik, default-value=false  # Register Access Via OS Functions
      boolean SpiSRAOnlyForWrite: set at pre-compile, origin=Vector Informatik, default-value=false  # Special Register Access Only For Write
      boolean SpiSRAOnlyForPrivilegedMode: set at pre-compile, origin=Vector Informatik, default-value=false  # Special Register Access Only For Privileged Mode Registers
      boolean SpiSRANotInInit: set at pre-compile, origin=Vector Informatik, default-value=false  # Special Register Access Not During Initialization
      reference SpiIrqHandling: set at pre-compile, origin=Vector Informatik, destination=InterruptFunctionSet  # Critical section handling | Preprocessor switch to determine the IRQ function set which is used to protect critical sections.
    container VectorCommonData  # This configuration container contains Vector specific vendor data, which are relevant for configuration management purposes.
      string BswmdVersion: set at published-information, origin=Vector Informatik, default-value=1.05.01  # Version of this description file | This parameter specifies the version of this bswmd file.
  bsw implementation Spi_Impl: code-generator=MicrosarGen, programming-language=C, sw-major-version=1, sw-minor-version=5, sw-patch-version=0, vendor-id=30, ar-major-version=2, ar-minor-version=3, ar-patch-version=0, preconfigured-configuration=Spi_Pre, recommended-configuration=Spi_Rec, vendor-specific-module-def=Spi
