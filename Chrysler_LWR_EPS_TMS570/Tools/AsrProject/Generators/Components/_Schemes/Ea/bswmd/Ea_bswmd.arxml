AUTOSAR XML (schema 3.0.1)
package /MICROSAR
  module definition Ea [0..1]: refined-module-def=Ea, variants pre-compile  # Configuration of the Ea (EEPROM Abstraction) module. The module shall abstract from the device specific addressing scheme and segmentation and provide the upper layers with a virtual addressing scheme and segmentation as well as a "virtually" unlimited number of erase cycles.
    container EaBlockConfiguration [1..*]  # Configuration of block specific parameters for the EEPROM abstraction module.
      integer EaBlockNumber: 1..65534, set at link, origin=AUTOSAR_ECUC V1.0.0, symbolic-name-value=true, default-value=2  # Number of logical block.
      integer EaBlockSize: 0..65533, set at link, origin=AUTOSAR_ECUC V1.0.0, default-value=1  # Size of a logical block in bytes.
      boolean EaImmediateData: set at link, origin=AUTOSAR_ECUC V1.0.0, default-value=false  # Marker for high priority data.
      integer EaNumberOfWriteCycles: 1..10000000, set at link, origin=AUTOSAR_ECUC V1.0.0, default-value=10000  # Number of write cycles required for this block.
      string EaNvMBlockName: set at link, origin=Vector Informatik  # Description of the block name which is configured in the NvM module.
      integer EaBlockAddress: 0..65533, set at link, origin=Vector Informatik, default-value=8  # Determines the physical start address of the block.
      integer EaNumberOfDatasets: 1..255, set at link, origin=Vector Informatik, default-value=1  # Determines the number of datasets/clones how often an individual block exists.
      integer EaVirtualPages: 1..65535, set at link, origin=Vector Informatik, default-value=3  # Determines the number of virtual pages used for one block.
      integer EaNumberOfInstances: 1..255, set at link, origin=Vector Informatik, default-value=1  # Determines the number of instances needed for one dataset/clone. The value depends on the number of write cycles the EEPROM supports and the number of write cycles of the specific dataset/clone.
      boolean EaVerifyWrittenData: set at link, origin=Vector Informatik, default-value=false  # Determines whether the written data shall be verified for consistency.
      symbolic name reference EaDeviceIndex: set at pre-compile, origin=AUTOSAR_ECUC V1.0.0, destination=EepGeneral
    container EaGeneral  # General configuration of the EEPROM abstraction module. This container lists block independent configuration parameters.
      boolean EaDevErrorDetect: set at pre-compile, origin=AUTOSAR_ECUC V1.0.0, default-value=false  # Preprocessor switch to enable and disable development error detection.
      boolean EaPollingMode: set at pre-compile, origin=AUTOSAR_ECUC V1.0.0, default-value=true  # Preprocessor switch to enable and disable the polling mode for this module (regarding EEPROM).
      boolean EaVersionInfoApi: set at pre-compile, origin=AUTOSAR_ECUC V1.0.0, default-value=true  # Preprocessor switch to enable and disable the API to read out the modules version information.
      integer EaVirtualPageSize: 1..65535, set at pre-compile, origin=AUTOSAR_ECUC V1.0.0, default-value=1  # The size in bytes to which logical blocks shall be aligned.
      boolean EaCfgChkUninit: set at pre-compile, origin=Vector Informatik, default-value=true  # Preprocessor switch to enable/disable the check of an initialized mode before using any API service of the EEPROM Abstraction (expect Ea_GetVersionInfo).
      boolean EaCfgChkImmediateData: set at pre-compile, origin=Vector Informatik, default-value=true  # Preprocessor switch to enable/disable the check of a block which shall be erased that shall contain immediate data.
      boolean EaCfgDoParamChk: set at pre-compile, origin=Vector Informatik, default-value=true  # Preprocessor switch to enable/disable the check of the parameters of API services for valid value.
      boolean EaCfgChkParamBlockNumber: set at pre-compile, origin=Vector Informatik, default-value=true  # Preprocessor switch to enable/disable the detection of development errors if an Ea API service has been called with an invalid block number.
      boolean EaCfgChkParamLengthOffset: set at pre-compile, origin=Vector Informatik, default-value=true  # Preprocessor switch to enable/disable the detection of development errors if an Ea API service has been called with an invalid length or offset value.
      boolean EaCfgChkParamDatabufferptr: set at pre-compile, origin=Vector Informatik, default-value=true  # Preprocessor switch to enable/disable the detection of development errors if an Ea API service has been called with an invalid pointer to a data buffer.
      boolean EaCfgChkParamMode: set at pre-compile, origin=Vector Informatik, default-value=true  # Preprocessor switch to enable/disable the detection of development errors if the Ea API service Ea_SetMode() has been called with an invalid mode value.
      boolean EaCfgChkParamVinfo: set at pre-compile, origin=Vector Informatik, default-value=true  # Preprocessor switch to enable/disable the detection of development errors if the Ea API service Ea_GetVersionInfo() has been called with an invalid parameter.
      string EaDetIncludeFile: set at pre-compile, origin=Vector Informatik, default-value=Det.h  # Preprocessor switch to determine the include file of the Det. Shall be used to specify a special Det module.
      boolean EaNvMPollingMode: set at pre-compile, origin=Vector Informatik, default-value=false  # Preprocessor switch to enable and disable the polling mode for this module (regarding NvM).
      string EaNvMCallbackIncludeFile: set at pre-compile, origin=Vector Informatik, default-value=NvM_Cbk.h  # Preprocessor switch to determine the include file of the callback functions declaration of the NvM.
      boolean EaCorrectSingleBitFlips: set at pre-compile, origin=Vector Informatik, default-value=true  # Preprocessor switch to enable/disable the correction of single bit flips.
      boolean EaUseRecoveryMechanism: set at pre-compile, origin=Vector Informatik, default-value=true  # Preprocessor switch to enable/disable the recovery mechanism. The Ea tries to reconstitue a consistent state of the EEPROM memory by erasing them if the memory could not be read.
      integer EaEepEraseUnitSize: 1..128, set at pre-compile, origin=Vector Informatik, default-value=1  # Preprocessor value which determines the number of bytes which are erased of the EEPROM at once.
      function name EaDetErrorhook: set at pre-compile, origin=Vector Informatik, default-value=Det_ReportError  # Preprocessor switch to determine the API error reporting service of the Det. Shall be used to specify a special error reporting service name of the Det.
      integer EaDatasetSelectionBits: 1..8, set at pre-compile, origin=Vector Informatik, default-value=1  # Determines the number of dataset selection bits to separate the BlockNumber parameter into two parts, the real block number and the dataset of the correspondig block.
      enumeration EaCfgAddressType: {uint16, uint32}, set at pre-compile, origin=Vector Informatik, default-value=uint16  # Type of address variables.
      enumeration EaCfgLengthType: {uint16, uint32}, set at pre-compile, origin=Vector Informatik, default-value=uint16  # Type of length variables.
      integer EaIndex: 0..1, set at pre-compile, origin=AUTOSAR_ECUC V1.0.0, default-value=0  # Specifies the InstanceId of this module instance. If only one instance is present it shall have the Id 0.
      function name EaNvmJobEndNotification: set at link, origin=AUTOSAR_ECUC V1.0.0, default-value=NvM_JobEndNotification  # Mapped to the job end notification routine provided by the upper layer module (NvM_JobEndNotification).
      function name EaNvmJobErrorNotification: set at link, origin=AUTOSAR_ECUC V1.0.0, default-value=NvM_JobErrorNotification  # Mapped to the job error notification routine provided by the upper layer module (NvM_JobErrorNotification).
      boolean EaDevErrorReport: set at pre-compile, origin=Vector Informatik, default-value=true  # Preprocessor switch to enable and disable development error reporting.
      reference EaIrqHandling: set at pre-compile, origin=Vector Informatik, destination=InterruptFunctionSet  # Preprocessor switch to determine the IRQ function set which is used to protect critical sections.
    container EaPublishedInformation  # Additional published parameters not covered by CommonPublishedInformation container. Note that these parameters do not have any configuration class setting, since they are published information.
      integer EaBlockOverhead: set at published-information, origin=AUTOSAR_ECUC V1.0.0, default-value=2  # Management overhead per logical block in bytes. Note: If the management overhead depends on the block size or block location a formula has to be provided that allows the configurator to calculate the management overhead correctly.
      integer EaPageOverhead: set at published-information, origin=AUTOSAR_ECUC V1.0.0, default-value=0  # Management overhead per page in bytes. Note: If the management overhead depends on the block size or block location a formula has to be provided that allows the configurator to calculate the management overhead correctly.
      string EaIncludeFile: set at pre-compile, origin=Vector Informatik, default-value=Ea.h  # Determines the include file of the Ea which declares the API service names.
      string EaCbkIncludeFile: set at pre-compile, origin=Vector Informatik, default-value=Ea_Cbk.h  # Determines the callback include file of the Ea which declares the callback service names.
      function name EaSetMode: set at pre-compile, origin=Vector Informatik, default-value=Ea_SetMode  # Determines the API service name of the Ea which is used to set the mode of the Eep driver.
      function name EaRead: set at pre-compile, origin=Vector Informatik, default-value=Ea_Read  # Determines the API service name of the Ea which is used to read data from the EEPROM.
      function name EaWrite: set at pre-compile, origin=Vector Informatik, default-value=Ea_Write  # Determines the API service name of the Ea which is used to write data to the EEPROM.
      function name EaGetStatus: set at pre-compile, origin=Vector Informatik, default-value=Ea_GetStatus  # Determines the API service name of the Ea which is used to get the current status of the Ea.
      function name EaGetJobResult: set at pre-compile, origin=Vector Informatik, default-value=Ea_GetJobResult  # Determines the API service name of the Ea which is used to get the result of the last requested job.
      function name EaEraseImmediateBlock: set at pre-compile, origin=Vector Informatik, default-value=Ea_EraseImmediateBlock  # Determines the API service name of the Ea which is used to erase a block on the EEPROM which is configured to hold high priority data.
      function name EaInvalidateBlock: set at pre-compile, origin=Vector Informatik, default-value=Ea_InvalidateBlock  # Determines the API service name of the Ea which is used to invalidate a block on the EEPROM.
      function name EaCancel: set at pre-compile, origin=Vector Informatik, default-value=Ea_Cancel  # Determines the API service name of the Ea which is used to cancel a current job.
      float EaMaximumBlockingTime: 0.0.., set at pre-compile, origin=AUTOSAR_ECUC V1.0.0, default-value=0.0  # The maximum time the EA module's API routines shall be blocked (delayed) by internal operations. (EA070) Note: Internal operations in that case means operations that are not explicitly invoked from the upper layer module but need to be handled for proper operation of this module or the underlying memory driver.
  module config Ea_Pre: definition=Ea
  bsw implementation Ea_Impl: code-generator=cMICROSAR, programming-language=C, sw-major-version=2, sw-minor-version=1, sw-patch-version=0, vendor-id=30, ar-major-version=1, ar-minor-version=2, ar-patch-version=0, preconfigured-configuration=Ea_Pre, recommended-configuration=Ea_Rec, vendor-specific-module-def=Ea
  module config Ea_Rec: definition=Ea
