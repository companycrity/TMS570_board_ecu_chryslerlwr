AUTOSAR XML (schema 3.0.2)
# COPYRIGHT
# Copyright (c) 2010 by Vector Informatik GmbH. All rights reserved.
# This software is copyright protected and proprietary to Vector Informatik GmbH.
# Vector Informatik GmbH grants to you only those rights as set out in the license conditions.
package /MICROSAR
  bsw implementation Eep_Impl: code-generator=cMICROSAR, programming-language=C, sw-major-version=4, sw-minor-version=0, sw-patch-version=0, vendor-id=30, ar-major-version=2, ar-minor-version=2, ar-patch-version=0, preconfigured-configuration=EepAt25128_Pre, recommended-configuration=EepAt25128_Rec, vendor-api-infix=At25128, vendor-specific-module-def=EepAt25128
  module definition EepAt25128 [0..*]: refined-module-def=Eep, variants post-build  # Configuration of the Eep (internal or external EEPROM driver) module. Its multiplicity describes the number of EEPROM drivers present, so there will be one container for each EEPROM driver in the ECUC template. When no EEPROM driver is present then the multiplicity is 0.
    container EepGeneral  # Container for general configuration parameters of the EEPROM driver. These parameters are always pre-compile.
      boolean EepDevErrorDetect: set at pre-compile, default-value=true  # Development Mode | Pre-processor switch to enable and disable development error detection. true: Development error detection enabled. false: Development error detection disabled.
      integer EepDriverIndex: 0..254, set at pre-compile, symbolic-name-value=true  # EepDriverIndex is not used | Index of the driver, used by EA. Not used.
      boolean EepUseInterrupts: set at pre-compile, default-value=false  # EepUseInterrupts is not supported | Switches to activate or deactivate interrupt controlled job processing. Not used (within external EEPROM).
      boolean EepVersionInfoApi: set at pre-compile, default-value=false  # Enable Eep_GetVersionInfo API | Pre-processor switch to enable / disable the API to read out the modules version information. true: Version info API enabled. false: Version info API disabled.
      boolean EepWriteCycleReduction: set at pre-compile, default-value=false  # EepWriteCycleReduction is not supported | Switches to activate or deactivate write cycle reduction (EEPROM value is read and compared before being overwritten). Not used (always deactivated).
      boolean EepCfgDoParamChk: set at pre-compile, origin=Vector Informatik GmbH, default-value=true  # Check Parameter | Preprocessor switch to enable/disable the parameter check of the API services.
      boolean EepCfgChkParamConfig: set at pre-compile, origin=Vector Informatik GmbH, default-value=true  # Check Parameter Configuration Pointer | Preprocessor switch to enable/disable the check of the Configuration pointer.
      boolean EepCfgChkParamData: set at pre-compile, origin=Vector Informatik GmbH, default-value=true  # Check Parameter Data | Preprocessor switch to enable/disable the check of the data buffer parameters which points to the corresponding buffer.
      boolean EepCfgChkParamLength: set at pre-compile, origin=Vector Informatik GmbH, default-value=true  # Check Parameter Length | Preprocessor switch to enable/disable the check of the Length parameter of the correspondig API services whether value is in range.
      boolean EepCfgChkParamAddress: set at pre-compile, origin=Vector Informatik GmbH, default-value=true  # Check Parameter Address | Preprocessor switch to enable/disable the check of Address parameter of the correspondign API services whether value is in range.
      boolean EepCfgChkUninit: set at pre-compile, origin=Vector Informatik GmbH, default-value=true  # Check Uninitialised Module | Preprocessor switch to enable/disable the check whether Eep module is inititialized before using it.
      boolean EepDebugReporting: set at pre-compile, origin=Vector Informatik GmbH, default-value=true  # Report Development Errors | Preprocessor switch to enable/disable reporting of development errors.
      function name EepErrorhook: set at pre-compile, origin=Vector Informatik GmbH, default-value=Det_ReportError  # Errorhook | Specifies the name of the debug error hook function (Det).
      string EepCfgIncludeDet: set at pre-compile, origin=Vector Informatik GmbH, default-value=Det.h  # Include File | Specifies the include file which contains the Debug error hook function (Det).
      boolean EepCfgProdReporting: set at pre-compile, origin=Vector Informatik GmbH, default-value=true  # Report Production Errors | Preprocessor switch to enable/disable production error reporting. Shall be used to remove unneeded code segments regarding DEM features.
      function name EepSetError: set at pre-compile, origin=Vector Informatik GmbH, default-value=Dem_ReportErrorStatus  # Errorhook | Specifies the name of the Error Manager´s (Dem) error function.
      string EepCfgIncludeDem: set at pre-compile, origin=Vector Informatik GmbH, default-value=Dem.h  # Include File | Specifies the include file which contains the Error Manager´s (Dem) error function.
      integer EepLocalBufferSize: 1..255, set at link, origin=Vector Informatik GmbH, default-value=16  # Compare Buffer Size [Bytes] | The local buffer size specifies the size in bytes of the buffer, which temporarily stores the data for compare jobs. The higher the buffer size the more data can be compared in one cycle (limited by configuration of parameter ReadSize)
      boolean EepCfgChkParamVInfo: set at pre-compile, origin=Vector Informatik GmbH, default-value=true  # Check Parameter Version Info | Preprocessor switch to enable/disable checking of the parameter versioninof in API service Eep_30_At25128_GetVersionInfo().
      boolean EepTestEeprom: set at pre-compile, origin=Vector Informatik GmbH, default-value=true  # Test EEPROM communication after initialisation | Enables a simple communication test with the EEPROM after initialisation. This test is performed during some of the first calls to Eep_30_At25128_MainFunction(). Hence it is possible, that although the first job is accepted right after initialisation, it is delayed some mainfunction cycles by this test.
      reference EepGlobalIrqS: set at pre-compile, origin=Vector Informatik GmbH, destination=InterruptFunctionSet  # Critical Section Handling | This specifies the functions used to handle critical sections.
      reference EepDeviceInformationRef: set at link, origin=Vector Informatik GmbH, destination=EepDeviceInformation  # Select EEPROM Device | Select a EEPROM device from the list or pick "custom" in case none of the listed EEPROM devices are compatible. In the latter case it is necessary to enter the device's properties manually.
    container EepInitConfiguration [1..*]: post-build-changeable=true, multiple-configuration-container=true  # Container for runtime configuration parameters of the EEPROM driver. Implementation Type: Eep_ConfigType.
      integer EepBaseAddress: 0..4294967295, set at post-build, default-value=0  # EepBaseAddress is not used | This parameter is the EEPROM device base address. Implementation Type: Eep_AddressType. Not used.
      enumeration EepDefaultMode: set at post-build, default-value=MEMIF_MODE_FAST  # Default Mode after Eep_Init() | This parameter is the default EEPROM device mode after initialization. Implementation Type: MemIf_ModeType.
        MEMIF_MODE_FAST  # fast
        MEMIF_MODE_SLOW  # slow
      integer EepFastReadBlockSize: 1..65536, set at post-build, default-value=64  # Read Block Size | Number of bytes read within one job processing cycle Implementation Type: Eep_LengthType.
      integer EepFastWriteBlockSize [0..1]: 0..4294967295, set at post-build, default-value=64  # EepFastWriteBlockSize is not used | This parameter is the number of bytes written within one job processing cycle in fast mode. Implementation Type: Eep_LengthType. Not used.
      float EepJobCallCycle: set at post-build  # EepJobCallCycle is not used | This parameter is the call cycle of the job processing function during write/erase operations. Unit: [s] Not used (no use case).
      function name EepJobEndNotification: set at post-build, default-value=Ea_JobEndNotification  # Job End Notification | This parameter is a reference to a callback function for positive job result (see EEP045).
      function name EepJobErrorNotification: set at post-build, default-value=Ea_JobErrorNotification  # Job Error Notification | This parameter is a reference to a callback function for negative job result (see EEP046).
      integer EepNormalReadBlockSize: set at post-build  # EepNormalReadBlockSize is not used | This parameter is the number of bytes read within one job processing cycle in normal mode. Implementation Type: Eep_LengthType. Not used.
      integer EepNormalWriteBlockSize [0..1]: set at post-build  # EepNormalWriteBlockSize is not used | Number of bytes written within one job processing cycle in normal mode. Implementation Type: Eep_LengthType. Not used.
      integer EepSize: 1..65536, set at post-build, default-value=65536  # EepSize is not used | This parameter is the used size of EEPROM device in bytes. Implementation Type: Eep_LengthType. Not used.
      integer EepJobTimeoutNormal: 0..65535, set at post-build, origin=Vector Informatik GmbH, default-value=0  # Time Out in Normal Mode | Time out value for normal mode operation in number of SPI communication attempts. If this number of attempts is exceeded connection to the external device is assumed to be broken and the error EEP_E_COM_FAILURE is reported to DEM. Zero means, that timeout supervision is disabled.
      integer EepJobTimeoutFast: 0..65535, set at post-build, origin=Vector Informatik GmbH, default-value=0  # Time Out in Fast Mode | Time out value for fast mode operation in number of SPI communication attempts. If this number of attempts is exceeded connection to the external device is assumed to be broken and the error EEP_E_COM_FAILURE is reported to DEM. Zero means, that timeout supervision is disabled.
      string EepCfgIncludeList: set at post-build, origin=Vector Informatik GmbH  # Include File | Specify header files containing the prototypes of notification functions.
      container EepExternalDriver  # This container is present for external EEPROM drivers only. Internal EEPROM drivers do not use the parameter listed in this container, hence its multiplicity is 0 for internal drivers.
        symbolic name reference SpiReference [2..2]: set at post-build, destination=SpiSequence  # Spi Sequences | This parameter specifies the two Spi sequences which are necessary to communicate with the external EEPROM device. One sequence is used for data transmission, a second is used to exchange status information with the EEPROM device.
    container EepPublishedInformation  # Additional published parameters not covered by CommonPublishedInformation container. Note that these parameters do not have any configuration class setting, since they are published information.
      integer EepAllowedWriteCycles: 1..1000000, set at published-information, default-value=100000  # Maximum allowed write cycles per EEPROM cell | Specified maximum number of write cycles under worst case conditions of specific EEPROM hardware (e.g. +90°C)
      float EepEraseTime: 1.0..20000.0, set at published-information, default-value=10000.0  # Time for erasing one EEPROM data unit.
      integer EepEraseUnitSize: 1..65536, set at published-information, default-value=1  # Size of smallest erasable EEPROM data unit in bytes.
      integer EepEraseValue: 255..255, set at published-information, default-value=255  # EEPROM Erase Value | Value of an erased EEPROM cell.
      integer EepMinimumAddressType: 8..32, set at published-information, default-value=16  # Minimum expected size of Eep_AddressType.
      integer EepMinimumLengthType: 8..32, set at published-information, default-value=16  # Minimum expected size of Eep_LengthType.
      integer EepReadUnitSize: 1..65356, set at published-information, default-value=1  # Size of smallest readable EEPROM data unit in bytes.
      integer EepSpecifiedEraseCycles: 1..1000000, set at published-information, default-value=100000  # Maximum number of erase cycles | Number of erase cycles specified for the EEP device (usually given in the device data sheet).
      integer EepTotalSize: 1..65536, set at published-information, default-value=65536  # Total size of EEPROM in bytes. Implementation Type: Eep_LengthType.
      float EepWriteTime: 1..20000.0, set at published-information, default-value=10000.0  # Time for writing one EEPROM data unit.
      integer EepWriteUnitSize: 1..65536, set at published-information, default-value=1  # Size of smallest writeable EEPROM data unit in bytes.
      string EepIncludeFile: set at published-information, origin=Vector Informatik GmbH, default-value=Eep_30_At25128.h  # Header File of the Driver | This header file has to be included in order to use the driver's API services.
      function name EepSetMode: set at published-information, origin=Vector Informatik GmbH, default-value=Eep_30_At25128_SetMode  # Eep_SetMode() API Service
      function name EepRead: set at published-information, origin=Vector Informatik GmbH, default-value=Eep_30_At25128_Read  # Eep_Read() API Service
      function name EepWrite: set at published-information, origin=Vector Informatik GmbH, default-value=Eep_30_At25128_Write  # Eep_Write() API Service
      function name EepErase: set at published-information, origin=Vector Informatik GmbH, default-value=Eep_30_At25128_Erase  # Eep_Erase() API Service
      function name EepCompare: set at published-information, origin=Vector Informatik GmbH, default-value=Eep_30_At25128_Compare  # Eep_Compare() API Service
      function name EepCancel: set at published-information, origin=Vector Informatik GmbH, default-value=Eep_30_At25128_Cancel  # Eep_Cancel() API Service
      function name EepGetStatus: set at published-information, origin=Vector Informatik GmbH, default-value=Eep_30_At25128_GetStatus  # Eep_GetStatus() API Service
      function name EepGetJobResult: set at published-information, origin=Vector Informatik GmbH, default-value=Eep_30_At25128_GetJobResult  # Eep_GetJobResult() API Service
    container EepDeviceInformation [1..*]  # EEPROM Device Information | Information about a supported EEPROM device used for automated configuration.
      integer EepChipSize: 0..65536, set at link, origin=Vector Informatik GmbH, default-value=16384  # Size [bytes] | EEPROM device's memory size in bytes.
      enumeration EepAddressBitWidth: set at link, origin=Vector Informatik GmbH, default-value=EepAddressing16Bit  # Addressing [bits] | Number of bits building up an address as it is expected by the EEPROM device.
        EepAddressing8Bit  # 8
        EepAddressing9Bit  # 9
        EepAddressing16Bit  # 16
      integer EepChipOffset: 0..65536, set at link, origin=Vector Informatik GmbH, default-value=0  # Offset [bytes] | This offset may be used for EEPROM devices which have some special memory areas at the beginning of their address spaces.
      enumeration EepPageSize: set at link, origin=Vector Informatik GmbH, default-value=EepPageSize32  # Page Size [bytes] | Page size supported by the EEPROM device.
        EepPageSize16  # 16
        EepPageSize32  # 32
        EepPageSize64  # 64
        EepPageSize128  # 128
    container VectorCommonData  # Vector Informatik GmbH internal management data
      string BswmdVersion: set at published-information, origin=Vector Informatik GmbH, default-value=4.00.00  # This parameter specifies the version of this bswmd file.
  module config EepAt25128_Rec: definition=EepAt25128, implementation-config-variant=VARIANT-POST-BUILD
