AUTOSAR XML (schema 3.0.2)
package /MICROSAR
  bsw implementation Adc_Impl: code-generator=MicrosarGen.exe, programming-language=C, sw-major-version=1, sw-minor-version=02, sw-patch-version=01, vendor-id=30, ar-major-version=3, ar-minor-version=0, ar-patch-version=1, preconfigured-configuration=Adc_Pre, recommended-configuration=Adc_Rec, vendor-specific-module-def=Adc
  module definition Adc [0..1]: refined-module-def=Adc, variants post-build  # Configuration of the Adc (Analog Digital Conversion) module.
    container AdcConfigSet [1..10]: multiple-configuration-container=true  # Configuration Set | This is the base container that contains the post-build selectable configuration parameters
      container AdcHwUnit [1..2]  # Hardware Unit | This container contains the Driver configuration (parameters).
        integer AdcClockSource [0..1]: 0..0, set at post-build, default-value=0  # [NOT USED]
        integer AdcHwUnitId: 0..1, set at post-build, symbolic-name-value=true, default-value=0  # HW Unit Id | Numeric ID of the HW Unit. Configure 0 for the first Hardware Unit and 1 for the second Hardware Unit.
        integer AdcPrescale: 1..32, set at post-build, default-value=32  # Prescale Factor | ADC module specific clock prescale factor.
        container AdcChannel [1..24]  # Channel | This container contains the channel configuration (parameters).
          integer AdcChannelConvTime [0..1]: 0..0, set at post-build, default-value=0  # Conversion Time | [NOT USED]
          integer AdcChannelId: 0..23, set at post-build, symbolic-name-value=true, default-value=0  # Channel Id | Channel input pin. Select on which physical channel this software channel is going to be mapped. Select a value between 0 and 23 on hardware unit 0 and between 0 and 15 on hardware unit 1.
          integer AdcChannelRefVoltsrcHigh [0..1]: 0..0, set at post-build, default-value=0  # [NOT USED]
          integer AdcChannelRefVoltsrcLow [0..1]: 0..0, set at post-build, default-value=0  # [NOT USED]
          integer AdcChannelResolution: 8..12, set at post-build, default-value=12  # Resolution | Channel resolution in bits. Limitation: This parameter has to be equal for all channels of a group.
          integer AdcChannelSampTime: 2..4095, set at post-build, default-value=4095  # Sample Time | Configuration of sampling time, i.e. the time during which the value is sampled, (in clock cycles) for each channel. Limitation: This parameter has to be equal for all channels of a group.
        container AdcGroup [1..255]  # This container contains the Group configuration (parameters). Use this symbolic group name on the API. Example: Adc_StartGroupConversion(AdcGroup);
          enumeration AdcGroupAccessMode: {ADC_ACCESS_MODE_SINGLE, ADC_ACCESS_MODE_STREAMING}, set at post-build, default-value=ADC_ACCESS_MODE_SINGLE  # Access Mode | Type of access mode to group conversion results. Single Access: Only one result per ADC channel is stored in application result buffer Streaming Access: Several results per ADC channel are stored in application result buffer. Select the number of results in 'Number of Samples'-field Limitation: Streaming access mode is not available for software triggered oneshot groups.
          enumeration AdcGroupConversionMode: {ADC_CONV_MODE_CONTINUOUS, ADC_CONV_MODE_ONESHOT}, set at post-build, default-value=ADC_CONV_MODE_ONESHOT  # Conversion Mode | Selects if a conversion is performed once or continuously after a single start event (API call / HW trigger signal).
          integer AdcGroupId: 0..254, set at post-build, symbolic-name-value=true, default-value=0  # [NOT USED]
          integer AdcGroupPriority: 0..1, set at post-build, default-value=0  # Priority | Priority level of the AdcGroup. Limitation: HW-triggered groups with HW Trigger Timer = 0 (MibAdc event pin) have to be set to priority 1.
          enumeration AdcGroupReplacement: {ADC_GROUP_REPL_ABORT_RESTART, ADC_GROUP_REPL_SUSPEND_RESUME}, set at post-build, default-value=ADC_GROUP_REPL_SUSPEND_RESUME  # Replacement | [NOT USED]
          enumeration AdcGroupTriggSrc: {ADC_TRIGG_SRC_HW, ADC_TRIGG_SRC_SW}, set at post-build, default-value=ADC_TRIGG_SRC_SW  # Trigger Source | Type of event that starts a conversion. Events are either triggered by API call (software) or by trigger event (hardware). Limitation: Hardware triggered conversions are only available for oneshot groups
          enumeration AdcHwTrigSignal: {ADC_HW_TRIG_FALLING_EDGE, ADC_HW_TRIG_RISING_EDGE, ADC_HW_TRIG_BOTH_EDGES}, set at post-build, default-value=ADC_HW_TRIG_FALLING_EDGE  # Trigger Signal | Configures on which edge of the hardware trigger signal the driver should react, i.e. start the conversion
          integer AdcHwTrigTimer: 0..7, set at post-build, default-value=0  # Trigger Timer | Select group hw trigger source. Choose 0 to 7 to get one of the following trigger: 0: MibAdc event pin 1: NHET[8] 2: NHET[10] 3: RTI compare 0 4: NHET[17] 5: NHET[19] 6: GIOB[0] 7: GIOB[1]
          function name AdcNotification [0..1]: set at post-build  # Notification Function | Callback function name for this groups notification function. Leave empty to avoid notification for this group.
          linker symbol def AdcResultBufferPointer: lower-multiplicity=0, upper-multiplicity=1, set at post-build, default-value=NULL_PTR  # [NOT USED]
          enumeration AdcStreamingBufferMode: {ADC_STREAM_BUFFER_CIRCULAR, ADC_STREAM_BUFFER_LINEAR}, set at post-build, default-value=ADC_STREAM_BUFFER_LINEAR  # Streaming Buffer Mode | Configure streaming buffer as "linear buffer" (i.e. the ADC Driver stops the conversion as soon as the stream buffer is full) or as "ring buffer" (wraps around if the end of the stream buffer is reached).
          integer AdcStreamingNumSamples: 1..65535, set at post-build, default-value=1  # Number Of Samples | Number of ADC values to be acquired per channel in streaming access mode. Note: In single access mode this parameter assumes value 1, since only one sample per channel is processed.
          reference AdcGroupDefinition [1..*]: set at post-build, destination=AdcChannel  # Group Definition | Assignment of AdcChannels to a AdcGroup.
    container AdcGeneral  # General configuration (parameters) of the ADC Driver software module.
      boolean AdcDeInitApi: set at pre-compile, default-value=true  # Enable Adc_DeInit | Adds / removes the service Adc_DeInit() from the code. true: Adc_DeInit() can be used. false: Adc_DeInit() can not be used.
      boolean AdcDevErrorDetect: set at pre-compile, default-value=true  # Development Mode | Switches the Development Error Detection and Notification ON or OFF. true: Enabled. false: Disabled.
      boolean AdcEnableQueuing: set at pre-compile, default-value=false  # [NOT USED]
      boolean AdcEnableStartStopGroupApi: set at pre-compile, default-value=true  # Enable Start/StopGroupConversion | Adds / removes the services Adc_StartGroupConversion() and Adc_StopGroupConversion() from the code. true: Adc_StartGroupConversion() and Adc_StopGroupConversion() can be used. false: Adc_StartGroupConversion() and Adc_StopGroupConversion() can not be used.
      boolean AdcGrpNotifCapability: set at pre-compile, default-value=true  # Enable Notification Feature | Determines, if the group notification mechanism (the functions to enable and disable the notifications) is available at runtime. true: Enabled. false: Disabled.
      boolean AdcHwTriggerApi: set at pre-compile, default-value=true  # Enable HwTrigger Feature | Adds / removes the services Adc_EnableHardwareTrigger() and Adc_DisableHardwareTrigger() from the code. true: Adc_EnableHardwareTrigger() and Adc_DisableHardwareTrigger() can be used. false: Adc_EnableHardwareTrigger() and Adc_DisableHardwareTrigger() can not be used.
      enumeration AdcPriorityImplementation: {ADC_PRIORITY_HW, ADC_PRIORITY_HW_SW, ADC_PRIORITY_NONE}, set at pre-compile, default-value=ADC_PRIORITY_HW  # [NOT USED]
      boolean AdcReadGroupApi: set at pre-compile, default-value=true  # Enable Adc_ReadGroup | Adds / removes the service Adc_ReadGroup() and from the code. true: Adc_ReadGroup() can be used. false: Adc_ReadGroup() can not be used.
      boolean AdcVersionInfoApi: set at pre-compile, default-value=false  # Enable Adc_GetVersionInfo | Adds / removes the service Adc_GetVersionInfo() from the code. true: Adc_GetVersionInfo() can be used. false: Adc_GetVersionInfor() can not be used.
      boolean AdcCfgDebugReporting: set at pre-compile, origin=Vector Informatik, default-value=true  # Development Error Reporting | Switches development error reporting on or off true: detected development error is reported false: detected development error is not reported
      boolean AdcCfgChkUninit: set at pre-compile, origin=Vector Informatik, default-value=true  # Check Uninit status | Enables or disables development error detection of error ADC_E_UNINIT True: Error detection for this development error is active False: Error detection for this development error is inactive
      boolean AdcCfgChkBusy: set at pre-compile, origin=Vector Informatik, default-value=true  # Check Busy status | Enables or disables development error detection of error ADC_E_BUSY True: Error detection for this development error is active False: Error detection for this development error is inactive
      boolean AdcCfgChkIdle: set at pre-compile, origin=Vector Informatik, default-value=true  # Check Idle status | Enables or disables development error detection of error ADC_E_IDLE True: Error detection for this development error is active False: Error detection for this development error is inactive
      boolean AdcCfgChkAlreadyInitialized: set at pre-compile, origin=Vector Informatik, default-value=true  # Check AlreadyInitialized | Enables or disables development error detection of error ADC_E_ALREADY_INITIALIZED True: Error detection for this development error is active False: Error detection for this development error is inactive
      boolean AdcCfgChkParamConfig: set at pre-compile, origin=Vector Informatik, default-value=true  # Param. ConfigPtr | Enables or disables development error detection of error ADC_E_PARAM_CONFIG True: Error detection for this development error is active False: Error detection for this development error is inactive
      boolean AdcCfgChkParamGroup: set at pre-compile, origin=Vector Informatik, default-value=true  # Param. Group | Enables or disables development error detection of error ADC_E_PARAM_GROUP True: Error detection for this development error is active False: Error detection for this development error is inactive
      boolean AdcCfgChkWrongConvMode: set at pre-compile, origin=Vector Informatik, default-value=true  # Check WrongConvMode | Enables or disables development error detection of error ADC_E_WRONG_CONV_MODE True: Error detection for this development error is active False: Error detection for this development error is inactive
      boolean AdcCfgChkWrongTriggSrc: set at pre-compile, origin=Vector Informatik, default-value=true  # Check WrongTriggSrc | Enables or disables development error detection of error ADC_E_WRONG_TRIGG_SRC True: Error detection for this development error is active False: Error detection for this development error is inactive
      boolean AdcCfgChkNotifCapability: set at pre-compile, origin=Vector Informatik, default-value=true  # Check NotifCapability | Enables or disables development error detection of error ADC_E_NOTIF_CAPABILITY True: Error detection for this development error is active False: Error detection for this development error is inactive
      boolean AdcCfgChkBufferUninit: set at pre-compile, origin=Vector Informatik, default-value=true  # Check BufferUninit | Enables or disables development error detection of error ADC_E_BUFFER_UNINIT True: Error detection for this development error is active False: Error detection for this development error is inactive
      boolean AdcCfgChkParamReadBuffer: set at pre-compile, origin=Vector Informatik, default-value=true  # Param. DataBufferPtr (ReadGroup) | Enables or disables development error detection of error ADC_E_PARAM_READ_BUFFER True: Error detection for this development error is active False: Error detection for this development error is inactive
      boolean AdcCfgChkParamResultBuffer: set at pre-compile, origin=Vector Informatik, default-value=true  # Param. DataBufferPtr (ResultBuffer) | Enables or disables development error detection of error ADC_E_PARAM_RESULT_BUFFER True: Error detection for this development error is active False: Error detection for this development error is inactive
      boolean AdcCfgChkParamStreamPtr: set at pre-compile, origin=Vector Informatik, default-value=true  # Param. PtrToSamplePtr | Enables or disables development error detection of error ADC_E_PARAM_STREAM_PTR True: Error detection for this development error is active False: Error detection for this development error is inactive
      boolean AdcCfgChkParamVinfo: set at pre-compile, origin=Vector Informatik, default-value=true  # Param. versioninfo | Enables or disables development error detection of error ADC_E_PARAM_VINFO True: Error detection for this development error is active False: Error detection for this development error is inactive
      boolean AdcCfgDoParamCheck: set at pre-compile, origin=Vector Informatik, default-value=true  # Check function parameter | Switches development error detection for function parameters on or off true: enable function parameter checking false: disable function parameter checking
      string AdcCfgIncludeDet: set at pre-compile, origin=Vector Informatik, default-value=Det.h  # Include File | File name of the header file that contains declaration of development error reporting function.
      function name AdcReportDet: set at pre-compile, origin=Vector Informatik, default-value=Det_ReportError  # Error Report Function | Function name of development error report function
      string AdcCfgIncludeListCbk [1..*]: set at post-build, origin=Vector Informatik  # Include Files for Notification Callbacks
      enumeration AdcNativeIsr: {ADC_ISR_VOID, ADC_ISR_CAT1, ADC_ISR_CAT2}, set at pre-compile, origin=Vector Informatik, default-value=ADC_ISR_CAT2  # ISR implementation
      boolean AdcCfg12BitModeSupported: set at pre-compile, origin=Vector Informatik, default-value=true  # Enable 12-Bit Conversion Feature | Enable this switch for supporting 12 bit conversions. Otherwise only 10 and 8 bit conversions are configurable. True: 12 bit conversions are supported False: 12 bit conversions are not supported
      reference AdcIrqHandling: set at pre-compile, origin=Vector Informatik, destination=InterruptFunctionSet  # Crit. Sect. Handling | Determines the IRQ function set which is used to protect critical sections.
    container AdcPublishedInformation  # Additional published parameters not covered by CommonPublishedInformation container. Note that these parameters do not have any configuration class setting, since they are published information.
      boolean AdcChannelValueSigned: set at published-information, default-value=false  # Information whether the result value of the ADC driver has sign information (true) or not (false). If the result shall be interpreted as signed value it shall apply to C-language rules.
      boolean AdcGroupFirstChannelFixed: set at published-information, default-value=false  # Information whether the first channel of an ADC Channel group can be configured (false) or is fixed (true) to a value determined by the ADC HW Unit.
      integer AdcMaxChannelResolution: 12..12, set at published-information, default-value=12  # Maximum Channel resolution in bits (does not specify accuracy).
    container VectorCommonData  # This configuration container contains Vector specific vendor data, which are relevant for configuration management purposes.
      string BswmdVersion: set at published-information, origin=Vector Informatik, default-value=1.03.01  # This parameter specifies the version of this bswmd file.
  module config Adc_Pre: definition=Adc
  module config Adc_Rec: definition=Adc
