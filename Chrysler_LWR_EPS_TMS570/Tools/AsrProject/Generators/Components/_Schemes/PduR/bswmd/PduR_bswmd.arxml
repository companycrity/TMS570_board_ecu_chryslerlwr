AUTOSAR XML (schema 3.0.1)
package /MICROSAR
  bsw implementation PduR_Impl: code-generator=GENy, programming-language=C, sw-major-version=3, sw-minor-version=13, sw-patch-version=3, vendor-id=30, ar-major-version=2, ar-minor-version=2, ar-patch-version=1, preconfigured-configuration=PduR_Pre, recommended-configuration=PduR_Rec, vendor-specific-module-def=PduR
  module definition PduR [0..1]: refined-module-def=PduR, variants link-time/post-build  # Configuration of the PduR (PDU Router) module.
    container PduRGeneral  # This container is a subcontainer of PduR and specifies the general configuration parameters of the PDU Router.
      boolean PduRCanIfSupport: set at pre-compile  # This Parameter is not used in Gw_AsrPduR. Configuration parameter to enable or disable PDU Router support for CAN interface.
      boolean PduRCanTpSupport: set at pre-compile  # This Parameter is not used in Gw_AsrPduR. Configuration parameter to enable or disable PDU Router support for CAN TP.
      boolean PduRMostTpSupport: set at pre-compile, origin=Vector Informatik  # This Parameter is not used in Gw_AsrPduR. Configuration parameter to enable or disable PDU Router support for MOST TP.
      boolean PduRMostIfSupport: set at pre-compile, origin=Vector Informatik  # This Parameter is not used in Gw_AsrPduR. Configuration parameter to enable or disable PDU Router support for MOST interface.
      boolean PduRComSupport: set at pre-compile  # This Parameter is not used in Gw_AsrPduR. Configuration parameter to enable or disable PDU Router support for COM.
      boolean PduRDcmSupport: set at pre-compile  # This Parameter is not used in Gw_AsrPduR. Configuration parameter to enable or disable PDU Router support for DCM.
      boolean PduRDevErrorDetect: set at pre-compile  # Switches the Development Error Detection and Notification ON or OFF.
      boolean PduRFifoTxBufferSupport: set at pre-compile  # Configuration parameter to enable or disable PDU Router support for FIFOs as PDU transmit buffers; if PDUR_GATEWAY_OPERATION is disabled, this parameter has to be disabled.
      boolean PduRFrIfSupport: set at pre-compile  # This Parameter is not used in Gw_AsrPduR. Configuration parameter to enable or disable PDU Router support for FlexRay interface.
      boolean PduRFrTpSupport: set at pre-compile  # This Parameter is not used in Gw_AsrPduR. Configuration parameter to enable or disable PDU Router support for FlexRay TP.
      boolean PduRGatewayOperation: set at pre-compile  # Configuration parameter to enable or disable PDU Router gateway operation; if PDUR_ZERO_COST_OPERATION is enabled, this parameter has to be disabled.
      boolean PduRIpduMSupport: set at pre-compile  # This Parameter is not used in Gw_AsrPduR. Configuration parameter to enable or disable PDU Router support for IPDUM; if PDUR_ZERO_COST_OPERATION is enabled, this parameter has to be disabled.
      boolean PduROptimizedIpdumSupport [0..1]: set at pre-compile, origin=Vector Informatik  # Configuration parameter to enable or disable optimized PDU Router support for IPDUM; if PDUR_ZERO_COST_OPERATION is enabled, this parameter has to be disabled.
      boolean PduRLinIfSupport: set at pre-compile  # This Parameter is not used in Gw_AsrPduR. Configuration parameter to enable or disable PDU Router support for LIN interface.
      boolean PduRLinTpSupport: set at pre-compile  # This Parameter is not used in Gw_AsrPduR. Configuration parameter to enable or disable PDU Router support for LIN TP.
      integer PduRMemorySize: 0.., set at link, default-value=0  # Memory size reserved for PDU Router buffers. Only required for gateway operation.
      enumeration PduRMinimumRoutingLoModule [0..1]: {CAN_IF, CAN_TP, FR_IF, FR_TP, LIN_IF, LIN_TP}, set at pre-compile in variant link-time / link in variant post-build  # not used. Lower layer module to be used for minimum routing; this parameter shall be used if PDUR_ZERO_COST_OPERATION is disabled; otherwise it shall not be used.
      integer PduRMinimumRoutingLoRxPduId [0..1]: 0..65535, set at link in variant post-build / pre-compile in variant link-time  # not used. Receive PDU identifier of the lower layer module which shall be used at the PDU Router interface to the lower layer module specified by PDUR_MINIMUM_ROUTING_LO_MODULE for minimum routing; this parameter shall be used if PDUR_ZERO_COST_OPERATION is disabled; otherwise it shall not be used.
      integer PduRMinimumRoutingLoTxPduId [0..1]: 0..65535, set at link in variant post-build / pre-compile in variant link-time  # not used. Transmit PDU identifier of the lower layer module which shall be used at the PDU Router interface to the lower layer module specified by PDUR_MINIMUM_ROUTING_LO_MODULE for minimum routing; this parameter shall be used if PDUR_ZERO_COST_OPERATION is disabled; otherwise it shall not be used.
      enumeration PduRMinimumRoutingUpModule [0..1]: {COM, DCM}, set at link in variant post-build / pre-compile in variant link-time  # This Parameter is not used in Gw_AsrPduR. Upper layer module to be used for minimum routing; this parameter shall be used if PDUR_ZERO_COST_OPERATION is disabled; otherwise it shall not be used.
      integer PduRMinimumRoutingUpRxPduId [0..1]: 0..65535, set at link in variant post-build / pre-compile in variant link-time  # This Parameter is not used in Gw_AsrPduR. Receive PDU identifier of the upper layer module which shall be used at the PDU Router interface to the upper layer module specified by PDUR_MINIMUM_ROUTING_UP_MODULE for minimum routing; this parameter shall be used if PDUR_ZERO_COST_OPERATION is disabled; otherwise it shall not be used.
      integer PduRMinimumRoutingUpTxPduId [0..1]: 0..65535, set at link in variant post-build / pre-compile in variant link-time  # This Parameter is not used in Gw_AsrPduR. Transmit PDU identifier of the upper layer module which shall be used at the PDU Router interface to the upper layer module specified by PDUR_MINIMUM_ROUTING_UP_MODULE for minimum routing; this parameter shall be used if PDUR_ZERO_COST_OPERATION is disabled; otherwise it shall not be used.
      boolean PduRMulticastFromIfSupport: set at pre-compile  # This Parameter is not used in Gw_AsrPduR. Configuration parameter to enable or disable PDU Router support for multicasts from an interface module to upper layer modules or lower layer interface modules; if PDUR_ZERO_COST_OPERATION is enabled, this parameter has to be disabled.
      boolean PduRMulticastFromTpSupport: set at pre-compile  # This Parameter is not used in Gw_AsrPduR. Configuration parameter to enable or disable PDU Router support for multicasts from a TP module to upper layer modules or lower layer TP modules; if PDUR_ZERO_COST_OPERATION is enabled, this parameter has to be disabled.
      boolean PduRMulticastToIfSupport: set at pre-compile, default-value=false  # This Parameter is not used in Gw_AsrPduR. Configuration parameter to enable or disable PDU Router support for multicasts from an upper layer module to interface modules; if PDUR_ZERO_COST_OPERATION is enabled, this parameter has to be disabled.
      boolean PduRMulticastToTpSupport: set at pre-compile, default-value=false  # This Parameter is not used in Gw_AsrPduR. Configuration parameter to enable or disable PDU Router support for multicasts from an upper layer module to TP modules; if PDUR_ZERO_COST_OPERATION is enabled, this parameter has to be disabled.
      boolean PduRSbTxBufferSupport: set at pre-compile  # This Parameter is not used in Gw_AsrPduR. Configuration parameter to enable or disable PDU Router support for single buffers as PDU transmit buffers; if PDUR_GATEWAY_OPERATION is disabled, this parameter has to be disabled.
      enumeration PduRSingleIf [0..1]: {CAN_IF, FR_IF, LIN_IF}, set at pre-compile  # not used. Single interface module in case zero cost operation is enabled (PDUR_ZERO_COST_OPERATION).
      enumeration PduRSingleTp [0..1]: {CAN_TP, FR_TP, LIN_TP}, set at pre-compile  # not used. Single transport protocol module in case zero cost operation is enabled (PDUR_ZERO_COST_OPERATION).
      boolean PduRVersionInfoApi: set at pre-compile  # Activates/Deactivates the Version Info API.
      boolean PduRZeroCostOperation: set at pre-compile  # This Parameter is not used in Gw_AsrPduR. All routing paths are implicitly defined and the communication modules directly above or below the PDU Router shall directly call each other without using PDU Router functions (zero cost operation). The configuration parameters PDUR_SINGLE_IF and PDUR_SINGLE_TP are used to specify the related lower layer module.
      integer PduRPBStartAddress [0..1]: set at link, origin=Vector Informatik  # This is the start address of the memory block in ROM where the post build configuration data is located. Required for variant post-build only.
      boolean PduRProdErrorDetect [0..1]: set at pre-compile, origin=Vector Informatik, default-value=true  # If 'Production Error Detection' is enabled, production relevant errors are reported to the Diagnostics Event Manager (DEM). Disable this option, if no DEM is present in your system.
      boolean PduRRouting2CSFSupport [0..1]: set at pre-compile, origin=Vector Informatik, default-value=false  # Configuration parameter to enable or disable PDU Router support to receive a second routing request (SF) while the previous is not finished yet for the CanTp 4.0 API
      string PduRUserConfigurationFile [0..1]: set at pre-compile, origin=Vector Informatik  # The PDU Router configuration file (PduR_Cfg.h) is generated by GENy. In order to overwrite settings in the generated configuration file, the content of a user defined file can be appended to PduR_Cfg.h.
      integer PduRMaxNumberOfRxCanTpPdus [0..1]: 1..65535, set at link, origin=Vector Informatik  # Define the number of possible CanTp Routings. Required for variant post-build only.
      boolean PduRJ1939Support [0..1]: set at pre-compile, origin=Vector Informatik, default-value=false  # Configuration parameter to enable or disable PDU Router support for J1939 interface.
      boolean PduRApplIfSupport [0..1]: set at pre-compile, origin=Vector Informatik, default-value=false  # Configuration parameter to enable or disable PDU Router support for an application interface to access IF layer PDUs.
      boolean PduRApplTpSupport [0..1]: set at pre-compile, origin=Vector Informatik, default-value=false  # Configuration parameter to enable or disable PDU Router support for an application interface to access TP layer PDUs.
      boolean PduRSoAdTpSupport [0..1]: set at pre-compile, origin=Vector Informatik, default-value=false  # Configuration parameter to enable or disable PDU Router support for an SoAd interface to access TP layer PDUs.
    container PduRGlobalConfig: multiple-configuration-container=true  # This container contains the global configuration parameter of the PduR. It is a MultipleConfigurationContainer, i.e. this container and its sub-containers exit once per configuration set.
      integer PduRConfigurationId [0..1]: set at link in variant link-time / post-build in variant post-build  # unique configuration identifier of post-build time configuration; this parameter shall be used if PDUR_ZERO_COST_OPERATION is disabled; otherwise it shall not be used.
      container PduRRoutingTable  # PDU Router routing table is a subcontainer ofPduR. This container shall only be considered by the PDU Router Configuration Generator if PduRGeneral/PDUR_ZERO_COST_OPERATION is disabled.
        container PduRRoutingPath [0..*]: post-build-changeable=true  # This container is a subcontainer of PduRRoutingTable and specifies the routing path of a PDU.
          integer SduLength [0..1]: 0..255, set at link in variant link-time / post-build in variant post-build  # Length of PDU data (SDU). Only required if a TX buffer is configured.
          integer TpChunkSize [0..1]: 1..65535, set at link in variant link-time / post-build in variant post-build, default-value=7  # Chunk size for routing on the fly. Defines the number of bytes which shall be received before transmission on the destination bus may start. Only required for TP gateway PDUs. The TpChunkSize shall not be larger than the length of the related TP Buffer.
          container PduRDefaultValue [0..1]: post-build-changeable=true  # This container is a subcontainer of PduRRoutingPath and specifies the default value of the I-PDU. Only required for gateway operation and if at least one PDU specified by PduRDestPdu uses TriggerTransmit Data provision. Represented as an array of IntegerParamDef.
            container PduRDefaultValueElement [0..*]  # Each value element is represented by the element and the position in an array.
              integer DefaultValueElement: 0..255, set at link in variant link-time / post-build in variant post-build  # The default value consists of a number of elements. Each element is one byte long and the number of elements is specified by SduLength. The position of this parameter in the container is specified by the ElementBytePosition parameter.
              integer ElementBytePosition: set at link in variant link-time / post-build in variant post-build  # This parameter specifies the byte position of the element within the default value
          container PduRDestPdu [1..*]: post-build-changeable=true  # This container is a subcontainer of PduRRoutingPath and specifies one destination for the PDU to be routed.
            enumeration DataProvision [0..1]: {DIRECT, TRIGGER_TRANSMIT}, set at link in variant link-time / post-build in variant post-build  # Specifies how data are provided: direct (as part of the Transmit call) or via the TriggerTransmit callback function. Only required for non-TP gateway PDUs.
            function name RoutingCallout [0..1]: set at link, origin=Vector Informatik  # The callout function can be specified for Interface Layer routing relations only. The function will be invoked before routing to the destination I-PDU is executed. The return value can be used to control routing activity.
            boolean DisableRouting [0..1]: set at link in variant link-time / post-build in variant post-build, origin=Vector Informatik, default-value=false  # This parameter allows to temporarily suspend a routing relation without deleting it. If the parameter is not present or set to false, the routing will be generated. This parameter is evaluated for TP- and interface layer routing relations only.
            boolean PduRCddDobtSwitch [0..1]: set at link in variant link-time / post-build in variant post-build, origin=Vector Informatik, default-value=false  # True, if the Tx CanTp Port can be used by CddDobt.
            reference DestPduRef: set at link in variant link-time / post-build in variant post-build, destination=Pdu  # Destination PDU reference; reference to unique PDU identifier which shall be used by the PDU Router instead of the source PDU ID when calling the related function of the destination module.
            reference TxBufferRef [0..1]: set at link in variant link-time / post-build in variant post-build, destination=PduRTxBuffer  # Specifies the assigned transmit buffer. Only required for specific non-TP gateway PDUs.
          container PduRSrcPdu: post-build-changeable=true  # This container is a subcontainer of PduRRoutingPath and specifies the source of the PDU to be routed.
            integer HandleId: 0..65535, set at link in variant link-time / post-build in variant post-build, symbolic-name-value=true  # PDU identifier assigned by PDU Router.
            boolean PduRCddDobtSwitch [0..1]: set at link in variant link-time / post-build in variant post-build, origin=Vector Informatik, default-value=false  # True, if the Rx CanTp Port can be used by CddDobt.
            reference SrcPduRef: set at link in variant link-time / post-build in variant post-build, destination=Pdu  # Source PDU reference; reference to unique PDU identifier which shall be used for the requested PDU Router operation.
      container PduRTpBufferTable [0..1]: post-build-changeable=true  # This container is a subcontainer of PduR and contains the definition of all TP buffers (only required for PDU Router gateway operation). This container shall only be considered by the PDU Router Configuration Generator if PduRGeneral/PDUR_GATEWAY_OPERATION is enabled.
        integer PduRMaxTpBufferNumber: 0..65535, set at link  # maximum number of TP buffers.
        container PduRTpBuffer [0..*]: post-build-changeable=true  # This container is a subcontainer of PduRTpBufferTable and specifies a TP buffer.
          integer Length: 1..65535, set at link in variant link-time / post-build in variant post-build  # Length of the buffer.
      container PduRTxBufferTable [0..1]: post-build-changeable=true  # This container is a subcontainer of PduR and contains the definition of all transmit buffers (used by specific non-TP PDUs; only required for PDU Router gateway operation). This container shall only be considered by the PDU Router Configuration Generator if PduRGeneral/PDUR_GATEWAY_OPERATION is enabled.
        integer PduRMaxTxBufferNumber: 0..65535, set at link  # maximum number of transmit buffers
        container PduRTxBuffer [0..*]: post-build-changeable=true  # This container is a subcontainer of PduRTxBufferTable and specifies a transmit buffer for a non-TP PDU.
          integer Depth: 0..255, set at link in variant link-time / post-build in variant post-build  # Specifies the depth of the buffer
          integer Length: 1..255, set at link in variant link-time / post-build in variant post-build  # Length of the buffer.
      container PduRApplicationAccess [0..1]: post-build-changeable=true  # Provides Rx and Tx PDUs that can be accessed by the application directly from the PDU Router. For any Rx and Tx PDU the reference to the global PDU and the PDU ID has to be specified. This feature is an optional Vector Informatik extension to the AUTOSAR standard. Please note that this feature can only be used if it has been licensed in the configuration tool.
        container PduRApplicationPdu [0..*]: post-build-changeable=true
          choice container PduRApplicationPduType
            container PduRRxIfApplicationPdu [0..1]: post-build-changeable=true
              integer PduRHandleId: 0..65535, set at link in variant link-time / post-build in variant post-build, origin=Vector Informatik, default-value=0  # Handle ID that is used by the application to access this PDU. The handle space must be contineous and zero based.
              reference PduRPduRef: set at link in variant link-time / post-build in variant post-build, origin=Vector Informatik, destination=Pdu  # Reference to the global PDU. Establishes a link to the PduRRoutingPaths source PDU.
            container PduRTxIfApplicationPdu [0..1]: post-build-changeable=true  # The handle ID of this routing path is configured by the related PduRRoutingPath that can be found by means of the
              integer PduRHandleId: 0..65535, set at pre-compile, origin=Vector Informatik, default-value=0  # Handle ID that is used by the application to access this PDU. The handle space must be contineous and zero based.
              reference PduRPduRef: set at pre-compile, origin=Vector Informatik, destination=Pdu  # Reference to the global PDU. Establishes a link to the PduRRoutingPaths destination PDU
            container PduRRxTpApplicationPdu [0..1]: post-build-changeable=true
              integer PduRHandleId: 0..65535, set at link in variant link-time / post-build in variant post-build, origin=Vector Informatik, default-value=0  # Handle ID that is used by the application to access this PDU. The handle space must be contineous and zero based.
              reference PduRPduRef: set at link in variant link-time / post-build in variant post-build, origin=Vector Informatik, destination=Pdu  # Reference to the global PDU. Establishes a link to the PduRRoutingPaths source PDU.
            container PduRTxTpApplicationPdu [0..1]: post-build-changeable=true
              integer PduRHandleId: 0..65535, set at link in variant link-time / post-build in variant post-build, origin=Vector Informatik, default-value=0  # Handle ID that is used by the application to access this PDU. The handle space must be contineous and zero based.
              reference PduRPduRef: set at link in variant link-time / post-build in variant post-build, origin=Vector Informatik, destination=Pdu  # Reference to the global PDU. Establishes a link to the PduRRoutingPaths source PDU.
    container VectorCommonData
      string BswmdVersion: configuration-class-affection=affection-kind=NO-AFFECT, set at published-information, origin=Vector Informatik, default-value=3.13.02  # Version of the BSWMD file that has been used to set up the ECU configuration
  module config PduR_Rec: definition=PduR
  module config PduR_Pre: definition=PduR
