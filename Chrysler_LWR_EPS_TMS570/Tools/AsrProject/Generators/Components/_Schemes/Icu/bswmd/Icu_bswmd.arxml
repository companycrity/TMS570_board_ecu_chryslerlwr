AUTOSAR XML (schema 3.0.2)
# Copyright (c) 2008 by Vector Informatik GmbH. All rights reserved.
# This software is copyright protected and proprietary to Vector Informatik GmbH.
# Vector Informatik GmbH grants to you only those rights as set out in the license conditions.
package /MICROSAR
  bsw implementation Icu_Impl: code-generator=cMICROSAR, programming-language=C, sw-major-version=1, sw-minor-version=1, sw-patch-version=0, vendor-id=30, ar-major-version=3, ar-minor-version=0, ar-patch-version=0, preconfigured-configuration=Icu_Pre, recommended-configuration=Icu_Rec, vendor-specific-module-def=Icu
  module definition Icu [0..1]: refined-module-def=Icu, variants post-build  # Configuration of the Icu (Input Capture Unit) module.
    container IcuConfigSet [1..*]: multiple-configuration-container=true  # This container is the base for a multiple configuration set
      derived integer IcuMaxChannel: 0..100, set at post-build, default-value=0, calculation-formula=number of configured icu channels, calculation-language=INFORMAL  # [NOT USED]
      container IcuChannel [0..15]  # Channel Name | Configuration of an individual ICU channel.
        integer IcuChannelId: 0..100, set at pre-compile, symbolic-name-value=true, default-value=0  # [NOT USED]
        enumeration IcuDefaultStartEdge: set at post-build, default-value=ICU_RISING_EDGE  # Default Start Edge | Configures the default-activation-edge which shall be used for this channel if there was no activation-edge configured by the call of service Icu_SetActivationCondition(). In case the Measurement Mode is "IcuSignalMeasurement" and the properties "DutyCycle" or "Period" are set, the edge configured here is used as Default Period Start Edge. Implementation Type: Icu_ActivationType
          ICU_BOTH_EDGES  # Both Edges
          ICU_FALLING_EDGE  # Falling Edge
          ICU_RISING_EDGE  # Rising Edge
        enumeration IcuMeasurementMode: set at post-build, default-value=ICU_MODE_SIGNAL_EDGE_DETECT  # Measurement Mode | Configures the measurement mode of this channel. Implementation Type: Icu_MeasurementModeType
          ICU_MODE_TIMESTAMP  # Timestamping
          ICU_MODE_SIGNAL_MEASUREMENT  # Signal Measurement
          ICU_MODE_SIGNAL_EDGE_DETECT  # Signal Edge Detection
          ICU_MODE_EDGE_COUNTER  # Edge Counting
        boolean IcuWakeupCapability: set at post-build, default-value=false  # Wakeup Capability | Information about the wakeup-capability of this channel. true: Channel is wakeup capable. false: Channel is not wakeup capable.
        enumeration IcuPin: set at post-build, origin=Vector Informatik, default-value=HET0  # Pin | Configures the hardware pin to be used by an ICU channel.
          HET{0..31}  # NHET{0..31}
        container IcuSignalEdgeDetection [0..1]  # This container contains the configuration (parameters) in case the measurement mode is "IcuSignalEdgeDetection"
          function name IcuSignalNotification: set at post-build  # Notification | Notification function for signal notification.
        container IcuSignalMeasurement [0..1]  # This container contains the configuration (parameters) in case the measurement mode is "IcuSignalMeasurement"
          enumeration IcuSignalMeasurementProperty: set at post-build, default-value=ICU_DUTY_CYCLE  # Measurement Property | Configures the property that could be measured in case the mode is "IcuSignalMeasurement". This property can not be changed during runtime. Implementation Type: Icu_SignalMeasurementPropertyType
            ICU_DUTY_CYCLE  # Duty Cycle
            ICU_HIGH_TIME  # High Time
            ICU_LOW_TIME  # Low Time
            ICU_PERIOD_TIME  # Period Time
          function name IcuSignalMeasurementNotification: set at post-build, origin=Vector Informatik  # Notification | This parameter contains the identifier name of a notification callback that will be called if a period is successfully captured.
        container IcuTimestampMeasurement [0..1]  # This container contains the configuration (parameters) in case the measurement mode is "IcuTimestamp"
          enumeration IcuTimestampMeasurementProperty: set at post-build, default-value=ICU_CIRCULAR_BUFFER  # Measurement Property | Configures the handling of the buffer in case the mode is "Timestamp" Implementation Type: Icu_TimestampBufferType
            ICU_CIRCULAR_BUFFER  # Circular Buffer
            ICU_LINEAR_BUFFER  # Linear Buffer
          function name IcuTimestampNotification: set at post-build  # Notification | Notification function if the number of requested timestamps (Notification interval > 0) are acquired.
        container IcuWakeup [0..1]  # This container contains the configuration (parameters) needed to configure a wakeup capable channel
          symbolic name reference IcuChannelWakeupInfo: set at pre-compile, destination=EcuMWakeupSource  # Wakeup Source Identifier | If the wakeup-capability is true the wakeup source referenced is transmitted to the ECU State Manager (EcuM) . Implementation Type: reference to EcuM_WakeupSourceType
        container IcuEdgeCounterMeasurement
    container IcuGeneral  # Configuration of general ICU parameters.
      boolean IcuDevErrorDetect: set at pre-compile, default-value=false  # Development Mode | Switches the Development Error Detection and Notification on or off. true: Enabled. false: Disabled.
      integer IcuIndex: 0..0, set at pre-compile, default-value=0  # Specifies the InstanceId of this module instance. If only one instance is present it shall have the Id 0.
      boolean IcuReportWakeupSource: set at pre-compile, default-value=false  # Report Wakeup Source | Switch for enabling Wakeup source reporting. true: Report Wakeup source. false: Do not report Wakeup source.
      function name IcuWakeupNotification: set at pre-compile, origin=Vector Informatik  # Wakeup Notification | This parameter contains the identifier name of the global wakeup notification function.
      string IcuIncludeList [0..*]: set at pre-compile, origin=Vector Informatik, default-value=EcuM_Cbk.h  # Additional Include Files | Include List for callback functions
      enumeration IcuIsrType: set at pre-compile, origin=Vector Informatik, default-value=ICU_ISR_CAT2  # ISR Implementation | ISR Implementation - here the user can choose, which kind of interrupt he wants to use: - Category 1: use compilers interrupt declaration mechanism - Category 2: use OSEK interrupts - void Functions
        ICU_ISR_CAT1  # Category 1
        ICU_ISR_CAT2  # Category 2
        ICU_ISR_VOID  # Void function
      string IcuIncludeDet: set at pre-compile, origin=Vector Informatik, default-value=Det.h  # Include File | Name of the include-file which contains the Errorhook function.
      function name IcuErrorhook: set at pre-compile, origin=Vector Informatik, default-value=Det_ReportError  # Errorhook Function | This parameter contains the identifier name of the errorhook function to use.
      function name IcuGlobalOvNotification: set at pre-compile, origin=Vector Informatik  # Overflow Notification | This parameter contains the identifier name of the global overflow notification function to use.
      reference IcuIrqHandling: set at pre-compile, origin=Vector Informatik, destination=InterruptFunctionSet  # Critical Section Handling | This specifies the used functions to handle Interrupt locking and unlocking.
      container IcuErrorChecks
        boolean IcuCfgDoParamChk: set at pre-compile, origin=Vector Informatik, default-value=true  # Check Parameters | This parameter switches service parameter checks on or off. true: Enabled. false: Disabled.
        boolean IcuCfgChkParamConfig: set at pre-compile, origin=Vector Informatik, default-value=true  # Check Configuration Pointer | This parameter switches the runtime check of the configuration pointer parameter on or off. true: Enabled. false: Disabled.
        boolean IcuCfgChkParamChannel: set at pre-compile, origin=Vector Informatik, default-value=true  # Check Channel Identifier | This parameter switches the runtime check of the channel identifier parameter on or off. true: Enabled. false: Disabled.
        boolean IcuCfgChkParamActivation: set at pre-compile, origin=Vector Informatik, default-value=true  # Check Activation | This parameter switches the runtime check of the activation parameter on or off. true: Enabled. false: Disabled.
        boolean IcuCfgChkBufferPtr: set at pre-compile, origin=Vector Informatik, default-value=true  # Check Buffer Pointer | This parameter switches the runtime check of the buffer pointer parameter on or off. true: Enabled. false: Disabled.
        boolean IcuCfgChkBufferSize: set at pre-compile, origin=Vector Informatik, default-value=true  # Check Buffer Size | This parameter switches the runtime check of the buffer size parameter on or off. true: Enabled. false: Disabled.
        boolean IcuCfgChkParamMode: set at pre-compile, origin=Vector Informatik, default-value=true  # Check Mode | This parameter switches the runtime check of the mode parameter on or off. true: Enabled. false: Disabled.
        boolean IcuCfgChkUninit: set at pre-compile, origin=Vector Informatik, default-value=true  # Check Uninitialized State | This parameter switches the runtime uninit check on or off. true: Enabled. false: Disabled.
        boolean IcuCfgChkNotStarted: set at pre-compile, origin=Vector Informatik, default-value=true  # Check Channel Run State | This parameter switches the runtime check if a channel is already started on or off. true: Enabled. false: Disabled.
        boolean IcuCfgChkBusyOperation: set at pre-compile, origin=Vector Informatik, default-value=true  # Check Busy State On Mode Change | This parameter switches the runtime check for Icu_SetMode is being called during a running operation on or off. true: Enabled. false: Disabled.
        boolean IcuCfgChkAlreadyInitialized: set at pre-compile, origin=Vector Informatik, default-value=true  # Check For Multiple Initialization | This parameter switches the runtime check for Icu_Init being called in initialized state on or off. true: Enabled. false: Disabled.
        boolean IcuCfgDebugReporting: set at pre-compile, origin=Vector Informatik, default-value=true  # Development Error Reporting | This parameter switches the reporting of development errors to the DET (or another configured error tracking software) on or off. true: Enabled. false: Disabled.
        boolean IcuCfgChkParamVInfo: set at pre-compile, origin=Vector Informatik, default-value=true  # Check VersionInfo Pointer | This parameter switches the runtime check of the versioninfo parameter on or off. true: Enabled. false: Disabled.
    container IcuOptionalApis  # This container contains all configuration switches for configuring optional API services of the ICU driver.
      boolean IcuDeInitApi: set at pre-compile, default-value=true  # Enable Icu_DeInit | Adds / removes the service Icu_DeInit() from the code. true: Icu_DeInit() can be used. false: Icu_DeInit() can not be used.
      boolean IcuDisableWakeupApi: set at pre-compile, default-value=true  # Enable Icu_DisableWakeup | Adds / removes the service Icu_DisableWakeup() from the code. true: Icu_DisableWakeup() can be used. false: Icu_DisableWakeup() can not be used.
      boolean IcuEdgeCountApi: set at pre-compile, default-value=true  # Enable Edge Counting | Adds / removes all services related to the edge counting functionality as listed below, from the code: Icu_ResetEdgeCount(), Icu_EnableEdgeCount(), Icu_DisableEdgeCount(), Icu_GetEdgeNumbers(). true: The services listed above can be used. false: The services listed above can not be used.
      boolean IcuEnableWakeupApi: set at pre-compile, default-value=true  # Enable Icu_EnableWakeup | Adds / removes the service Icu_EnableWakeup() from the code. true: Icu_EnableWakeup() can be used. false: Icu_EnableWakeup() can not be used.
      boolean IcuGetDutyCycleValuesApi: set at pre-compile, default-value=true  # Enable Icu_GetDutyCycleValues | Adds / removes the service Icu_GetDutyCycleValues() from the code. true: Icu_GetDutyCycleValues() can be used. false: Icu_GetDutyCycleValues() can not be used.
      boolean IcuGetInputStateApi: set at pre-compile, default-value=true  # Enable Icu_GetInputState | Adds / removes the service Icu_GetInputState() from the code. true: Icu_GetInputState() can be used. false: Icu_GetInputState() can not be used.
      boolean IcuGetTimeElapsedApi: set at pre-compile, default-value=true  # Enable Icu_GetTimeElapsed | Adds / removes the service Icu_GetTimeElapsed() from the code. true: Icu_GetTimeElapsed() can be used. false: Icu_GetTimeElapsed() can not be used.
      boolean IcuGetVersionInfoApi: set at pre-compile, default-value=true  # Enable Icu_GetVersionInfo | Adds / removes the service Icu_GetVersionInfo() from the code. true: Icu_GetVersionInfo() can be used. false: Icu_GetVersionInfo() can not be used.
      boolean IcuSetModeApi: set at pre-compile, default-value=true  # Enable Icu_SetMode | Adds / removes the service Icu_SetMode() from the code. true: Icu_SetMode() can be used. false: Icu_SetMode() can not be used.
      boolean IcuSignalMeasurementApi: set at pre-compile, default-value=true  # Enable Signal Measurement | Adds / removes the services Icu_StartSignalMeasurement() and Icu_StopSignalMeasurement() from the code. true: Icu_StartSignalMeasurement() and Icu_StopSignalMeasurement() can be used. false: Icu_StartSignalMeasurement() and Icu_StopSignalMeasurement() can not be used.
      boolean IcuTimestampApi: set at pre-compile, default-value=true  # Enable Timestamping | Adds / removes all services related to the timestamping functionality as listed below from the code: Icu_StartTimestamp(), Icu_StopTimestamp(), Icu_GetTimestampIndex(). true: The services listed above can be used. false: The services listed above can not be used.
      boolean IcuWakeupFunctionalityApi: set at pre-compile, origin=Vector Informatik, default-value=true  # Enable Wakeup Functionality | Adds / removes all services related to the wakeup functionality as listed below, from the code: Icu_SetMode(), Icu_EnableWakeup(), Icu_DisableWakeup() This switch affects the switches IcuEnableWakeupApi, IcuDisableWakeupApi and IcuSetModeApi
      boolean IcuEdgeDetectionApi: set at pre-compile, origin=Vector Informatik, default-value=true  # Enable Edge Detection
  module config Icu_Pre: definition=Icu
    Icu_Runtime (IcuConfigSet): IcuMaxChannel=(unset)
    IcuGeneral:
      IcuDevErrorDetect = (unset)
      IcuIndex = (unset)
      IcuReportWakeupSource = (unset)
      IcuWakeupNotification = (unset)
      IcuIncludeList = (unset)
      IcuIsrType = (unset)
      IcuIncludeDet = (unset)
      IcuErrorhook = (unset)
      IcuPrescaler = (unset)
      IcuSetTimerControl = (unset)
      IcuIrqHandling = (unset)
      IcuErrorChecks:
        IcuCfgDoParamChk = (unset)
        IcuCfgChkParamConfig = (unset)
        IcuCfgChkParamChannel = (unset)
        IcuCfgChkParamActivation = (unset)
        IcuCfgChkBufferPtr = (unset)
        IcuCfgChkBufferSize = (unset)
        IcuCfgChkParamMode = (unset)
        IcuCfgChkUninit = (unset)
        IcuCfgChkNotStarted = (unset)
        IcuCfgChkBusyOperation = (unset)
        IcuCfgChkAlreadyInitialized = (unset)
    IcuOptionalApis:
      IcuDeInitApi = (unset)
      IcuDisableWakeupApi = (unset)
      IcuEdgeCountApi = (unset)
      IcuEnableWakeupApi = (unset)
      IcuGetDutyCycleValuesApi = (unset)
      IcuGetInputStateApi = (unset)
      IcuGetTimeElapsedApi = (unset)
      IcuGetVersionInfoApi = (unset)
      IcuSetModeApi = (unset)
      IcuSignalMeasurementApi = (unset)
      IcuTimestampApi = (unset)
      IcuWakeupFunctionalityApi = (unset)
      IcuEdgeDetectionApi = (unset)
  module config Icu_Rec: definition=Icu
    Icu_Runtime (IcuConfigSet): IcuMaxChannel=(unset)
    IcuGeneral:
      IcuDevErrorDetect = (unset)
      IcuIndex = (unset)
      IcuReportWakeupSource = (unset)
      IcuWakeupNotification = (unset)
      IcuIncludeList = (unset)
      IcuIsrType = (unset)
      IcuIncludeDet = (unset)
      IcuErrorhook = (unset)
      IcuPrescaler = (unset)
      IcuSetTimerControl = (unset)
      IcuIrqHandling = (unset)
      IcuErrorChecks:
        IcuCfgDoParamChk = (unset)
        IcuCfgChkParamConfig = (unset)
        IcuCfgChkParamChannel = (unset)
        IcuCfgChkParamActivation = (unset)
        IcuCfgChkBufferPtr = (unset)
        IcuCfgChkBufferSize = (unset)
        IcuCfgChkParamMode = (unset)
        IcuCfgChkUninit = (unset)
        IcuCfgChkNotStarted = (unset)
        IcuCfgChkBusyOperation = (unset)
        IcuCfgChkAlreadyInitialized = (unset)
    IcuOptionalApis:
      IcuDeInitApi = (unset)
      IcuDisableWakeupApi = (unset)
      IcuEdgeCountApi = (unset)
      IcuEnableWakeupApi = (unset)
      IcuGetDutyCycleValuesApi = (unset)
      IcuGetInputStateApi = (unset)
      IcuGetTimeElapsedApi = (unset)
      IcuGetVersionInfoApi = (unset)
      IcuSetModeApi = (unset)
      IcuSignalMeasurementApi = (unset)
      IcuTimestampApi = (unset)
      IcuWakeupFunctionalityApi = (unset)
      IcuEdgeDetectionApi = (unset)
