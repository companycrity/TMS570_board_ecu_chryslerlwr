AUTOSAR XML (schema 314)
package /PortInterface
  client server interface HwTrq_SCom  # Serial communication port for setting and getting a sdoftware component parameter. The parameter is typically an EOL parameter.
    9 x operation:
      ClrHwTrqScale: possible-error=ConditionsNotCorrect
      ClrHwTrqTrim: possible-error=ConditionsNotCorrect
      ManualSetHwTrqTrim: possible-error=ConditionsNotCorrect
        arg HwTrqTrimDataPtr: type=HwTrqTrim_Datatype, direction=IN
      ReadEOLTrqStep
        arg TrqStep_HwNm_T_f32: type=EOLTrqStepType, direction=OUT
      ReadHwTrqScale
        arg HwTrqScaleDataPtr: type=HwTrqScale_Datatype, direction=OUT
      ReadHwTrqTrim
        arg HwTrqTrimDatPtr: type=HwTrqTrim_Datatype, direction=OUT
      SetEOLTrqStep
        arg TrqStep_HwNm_T_f32: type=EOLTrqStepType, direction=IN
      SetHwTrqScale: possible-error=ConditionsNotCorrect
        arg ScaleValue: type=Float, direction=IN
      SetHwTrqTrim: possible-error=ConditionsNotCorrect
    error ConditionsNotCorrect: error-code=34
  client server interface NvM_AC3_SRBS_Srv: is-service=true  # Port Interface for NVRAM Blocks of Management Types "NATIVE" or "REDUNDANT" without default values.
    6 x operation:
      EraseBlock: possible-error=NvM_AC3_SRBS_Srv/E_NOT_OK
      GetErrorStatus
        arg ErrorStatus: type=NvM_RequestResultType, direction=OUT
      InvalidateNvBlock: possible-error=NvM_AC3_SRBS_Srv/E_NOT_OK
      ReadBlock: possible-error=NvM_AC3_SRBS_Srv/E_NOT_OK
        arg DstPtr: type=NvM_DestPtr, direction=OUT
      SetRamBlockStatus
        arg RamBlockStatus: type=Boolean, direction=IN
      WriteBlock: possible-error=NvM_AC3_SRBS_Srv/E_NOT_OK
        arg DstPtr: type=NvM_DestPtr, direction=IN
    error E_NOT_OK: error-code=1
  client server interface NxtrDiagMgr
    4 x operation, all with possible-error=NxtrDiagMgr/E_NOT_OK:
      GetNTCActive
        arg NTC_Cnt_T_enum: type=NTCNumber, direction=IN
        arg NTCActive_Ptr_T_lgc: type=Boolean, direction=OUT
      GetNTCFailed
        arg NTC_Cnt_T_enum: type=NTCNumber, direction=IN
        arg NTCFailed_Ptr_T_lgc: type=Boolean, direction=OUT
      GetNTCStatus
        arg NTC_Cnt_T_enum: type=NTCNumber, direction=IN
        arg Status_Ptr_T_u08: type=UInt8, direction=OUT
      SetNTCStatus
        arg NTC_Cnt_T_enum: type=NTCNumber, direction=IN
        arg Param_Cnt_T_u08: type=UInt8, direction=IN
        arg Status_Cnt_T_enum: type=NxtrDiagMgrStatus, direction=IN
    error E_NOT_OK: error-code=1
  9 x sender receiver interface:
    BoolStatusFlag_Cnt_lgc
      data Cnt_lgc: sw-calibration-access=READ-ONLY, type=Boolean
    Count_Cnt_u08
      data Cnt_u08: sw-calibration-access=READ-ONLY, type=UInt8
    HwTrq_HwNm_f32
      data HwNm_f32: sw-calibration-access=READ-ONLY, type=Float
    HwTrqScale_VoltsPerDeg_f32
      data VoltsPerDeg_f32: sw-calibration-access=READ-ONLY, type=Float
    HwTrqSq_HwNmSq_f32
      data HwNmSq_f32: type=Float
    HwTrqStatus_Cnt_enum
      data Cnt_enum: type=HwTrqStatusType
    ManufModes_Cnt_enum
      data Cnt_enum: sw-calibration-access=READ-ONLY, type=ManufModeType
    Validity_Cnt_lgc
      data Cnt_lgc: sw-calibration-access=READ-ONLY, type=Boolean
    Voltage_Volt_f32
      data Volt_f32: sw-calibration-access=READ-ONLY, range raw >0..<31, type=Float  # This signal is intended to communicate any type voltage signal measured by the ecu. This signal has a lower limit of 0 which reequires users of the signal to provide divide by 0 protection if it is used as a denominator in a calculation. See Vecu port prototype if a port with a lower limit is desired.
