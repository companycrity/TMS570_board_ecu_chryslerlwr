AUTOSAR XML (schema 314)
package /Constant
  7 x constant specification:
    D_2MS_SEC_F32
      value:
        real literal D_2MS_SEC_F32: type=Float, value=0.002
    D_FALSE_CNT_LGC
      value:
        boolean literal D_FALSE_CNT_LGC: type=Boolean, value=false
    D_FLOATZERO_ULS_F32
      value:
        real literal D_FLOATZERO_ULS_F32: type=Float, value=0
    D_MSECPERSEC_ULS_F32
      value:
        real literal D_MSECPERSEC_ULS_F32: type=Float, value=1000
    D_PIOVR180_ULS_F32
      value:
        real literal D_PIOVR180_ULS_F32: type=Float, value=0.0174532925199
    D_RADPERREV_ULS_F32
      value:
        real literal D_RADPERREV_ULS_F32: type=Float, value=6.28318530718
    D_ZERO_CNT_S8
      value:
        integer literal D_ZERO_CNT_S8: type=SInt8, value=0
