AUTOSAR XML (schema 314)
package /Constant
  constant specification D_ZERO_ULS_F32
    value:
      real literal D_ZERO_ULS_F32: type=Float, value=0
